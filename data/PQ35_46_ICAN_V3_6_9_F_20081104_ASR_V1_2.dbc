VERSION "HNNBNNNYNNNNNNNNNNNNNNNNNNNNNNNNNNNNNNNNNN/4/%%%/4/'%**4NNN///"

NS_ :

BS_:

BU_: BAP_Tester Booster_AMP DSP_SKODA Gateway_PQ35 Gateway_PQ46 GSM_Pager Kompassmodul MDI Radio_2DIN Radio_Modul Radio_SKODA Rearview RNS_300_NF RNS_MFD2 RNS_midline SDARS_Tuner Sprachbedienung Standheizung Tastatur Telematik_Basis TV_hybrid UHV_High UHV_low UHV_NAR UHV_Premium UHV_UMTS

BO_ 657 mZKE_1: 5 Gateway_PQ35
 SG_ ZK1_Funkschl_Nr : 0|3@1+ (1,0) [0|7] ""  Telematik_Basis
 SG_ ZK1_433_MHz : 3|1@1+ (1,0) [0|1] ""  Telematik_Basis
 SG_ ZK1_Taste_HDF : 4|1@1+ (1,0) [0|1] ""  Telematik_Basis
 SG_ ZK1_Taste_Panik : 5|1@1+ (1,0) [0|1] ""  Telematik_Basis
 SG_ ZK1_Taste_Auf : 6|1@1+ (1,0) [0|1] ""  Radio_Modul,RNS_300_NF,RNS_midline,Telematik_Basis
 SG_ ZK1_Taste_Zu : 7|1@1+ (1,0) [0|1] ""  Telematik_Basis
 SG_ ZK1_FT_verriegeln : 8|1@1+ (1,0) [0|1] "" Vector__XXX
 SG_ ZK1_FT_entriegeln : 9|1@1+ (1,0) [0|1] ""  Radio_Modul,RNS_300_NF,RNS_midline,Telematik_Basis
 SG_ ZK1_BT_verriegeln : 10|1@1+ (1,0) [0|1] "" Vector__XXX
 SG_ ZK1_BT_entriegeln : 11|1@1+ (1,0) [0|1] "" Vector__XXX
 SG_ ZK1_HL_verriegeln : 12|1@1+ (1,0) [0|1] "" Vector__XXX
 SG_ ZK1_HL_entriegeln : 13|1@1+ (1,0) [0|1] "" Vector__XXX
 SG_ ZK1_HR_verriegeln : 14|1@1+ (1,0) [0|1] "" Vector__XXX
 SG_ ZK1_HR_entriegeln : 15|1@1+ (1,0) [0|1] "" Vector__XXX
 SG_ ZK1_Zent_safen : 16|1@1+ (1,0) [0|1] ""  GSM_Pager
 SG_ ZK1_Zent_entsafen : 17|1@1+ (1,0) [0|1] ""  GSM_Pager
 SG_ ZK1_HD_verriegeln : 18|1@1+ (1,0) [0|1] "" Vector__XXX
 SG_ ZK1_HD_entriegeln : 19|1@1+ (1,0) [0|1] "" Vector__XXX
 SG_ ZK1_HD_oeffnen : 20|1@1+ (1,0) [0|1] "" Vector__XXX
 SG_ ZK1_HD_schliessen : 21|1@1+ (1,0) [0|1] "" Vector__XXX
 SG_ ZK1_LED_Steuerung : 22|1@1+ (1,0) [0|1] "" Vector__XXX
 SG_ ZK1_LED_Uebernahme : 23|1@1+ (1,0) [0|1] "" Vector__XXX
 SG_ ZK1_Dongle_Nr : 24|3@1+ (1,0) [0|7] "" Vector__XXX
 SG_ ZK1_Dongle_Freq : 27|2@1+ (1,0) [0|3] "" Vector__XXX
 SG_ ZK1_Verdeck_auf : 29|1@1+ (1,0) [0|1] "" Vector__XXX
 SG_ ZK1_Verdeck_zu : 30|1@1+ (1,0) [0|1] "" Vector__XXX
 SG_ ZK1_LeaveHome_aktiv : 31|1@1+ (1,0) [0|1] "" Vector__XXX
 SG_ ZK1_HL_Tuer_offen : 36|1@1+ (1,0) [0|1] "" Vector__XXX
 SG_ ZK1_HR_Tuer_offen : 37|1@1+ (1,0) [0|1] "" Vector__XXX
 SG_ ZK1_SL_Anf : 38|1@1+ (1,0) [0|1] "" Vector__XXX
 SG_ ZK1_SR_Anf : 39|1@1+ (1,0) [0|1] "" Vector__XXX

BO_ 1075 NWM_DSP: 8 Booster_AMP
 SG_ NWM_DSP_Receiver : 0|8@1+ (1,0) [0|255] ""  Booster_AMP,DSP_SKODA,Gateway_PQ35,Gateway_PQ46,GSM_Pager,Kompassmodul,MDI,Radio_2DIN,Radio_Modul,Radio_SKODA,Rearview,RNS_300_NF,RNS_MFD2,RNS_midline,SDARS_Tuner,Sprachbedienung,Standheizung,Tastatur,Telematik_Basis,TV_hybrid,UHV_High,UHV_low,UHV_NAR,UHV_Premium,UHV_UMTS
 SG_ NWM_DSP_CmdRing : 8|1@1+ (1,0) [0|1] ""  Booster_AMP,DSP_SKODA,Gateway_PQ35,Gateway_PQ46,GSM_Pager,Kompassmodul,MDI,Radio_2DIN,Radio_Modul,Radio_SKODA,Rearview,RNS_300_NF,RNS_MFD2,RNS_midline,SDARS_Tuner,Sprachbedienung,Standheizung,Tastatur,Telematik_Basis,TV_hybrid,UHV_High,UHV_low,UHV_NAR,UHV_Premium,UHV_UMTS
 SG_ NWM_DSP_CmdAlive : 9|1@1+ (1,0) [0|1] ""  Booster_AMP,DSP_SKODA,Gateway_PQ35,Gateway_PQ46,GSM_Pager,Kompassmodul,MDI,Radio_2DIN,Radio_Modul,Radio_SKODA,Rearview,RNS_300_NF,RNS_MFD2,RNS_midline,SDARS_Tuner,Sprachbedienung,Standheizung,Tastatur,Telematik_Basis,TV_hybrid,UHV_High,UHV_low,UHV_NAR,UHV_Premium,UHV_UMTS
 SG_ NWM_DSP_CmdLimpHome : 10|1@1+ (1,0) [0|1] ""  Booster_AMP,DSP_SKODA,Gateway_PQ35,Gateway_PQ46,GSM_Pager,Kompassmodul,MDI,Radio_2DIN,Radio_Modul,Radio_SKODA,Rearview,RNS_300_NF,RNS_MFD2,RNS_midline,SDARS_Tuner,Sprachbedienung,Standheizung,Tastatur,Telematik_Basis,TV_hybrid,UHV_High,UHV_low,UHV_NAR,UHV_Premium,UHV_UMTS
 SG_ NWM_DSP_SleepInd : 12|1@1+ (1,0) [0|1] ""  Booster_AMP,DSP_SKODA,Gateway_PQ35,Gateway_PQ46,GSM_Pager,Kompassmodul,MDI,Radio_2DIN,Radio_Modul,Radio_SKODA,Rearview,RNS_300_NF,RNS_MFD2,RNS_midline,SDARS_Tuner,Sprachbedienung,Standheizung,Tastatur,Telematik_Basis,TV_hybrid,UHV_High,UHV_low,UHV_NAR,UHV_Premium,UHV_UMTS
 SG_ NWM_DSP_SleepAck : 13|1@1+ (1,0) [0|1] ""  Booster_AMP,DSP_SKODA,Gateway_PQ35,Gateway_PQ46,GSM_Pager,Kompassmodul,MDI,Radio_2DIN,Radio_Modul,Radio_SKODA,Rearview,RNS_300_NF,RNS_MFD2,RNS_midline,SDARS_Tuner,Sprachbedienung,Standheizung,Tastatur,Telematik_Basis,TV_hybrid,UHV_High,UHV_low,UHV_NAR,UHV_Premium,UHV_UMTS
 SG_ NWM_DSP_Per_WakeUp : 16|5@1+ (1,0) [0|31] "" Vector__XXX
 SG_ NWM_DSP_Fkt_WakeUp : 21|3@1+ (1,0) [0|7] "" Vector__XXX
 SG_ NWM_DSP_Klemme_15 : 24|1@1+ (1,0) [0|1] "" Vector__XXX
 SG_ NWM_DSP_Diagnose : 25|1@1+ (1,0) [0|1] "" Vector__XXX
 SG_ NWM_DSP_MindestAktivZeit : 26|1@1+ (1,0) [0|1] "" Vector__XXX
 SG_ NWM_DSP_Ursache_4 : 27|1@1+ (1,0) [0|1] "" Vector__XXX
 SG_ NWM_DSP_Ursache_5 : 28|1@1+ (1,0) [0|1] "" Vector__XXX
 SG_ NWM_DSP_Ursache_6 : 29|1@1+ (1,0) [0|1] "" Vector__XXX
 SG_ NWM_DSP_Ursache_7 : 30|1@1+ (1,0) [0|1] "" Vector__XXX
 SG_ NWM_DSP_Ursache_8 : 31|1@1+ (1,0) [0|1] "" Vector__XXX
 SG_ NWM_DSP_Nachlauf_1 : 32|1@1+ (1,0) [0|1] "" Vector__XXX
 SG_ NWM_DSP_Nachlauf_2 : 33|1@1+ (1,0) [0|1] "" Vector__XXX
 SG_ NWM_DSP_Nachlauf_3 : 34|1@1+ (1,0) [0|1] "" Vector__XXX
 SG_ NWM_DSP_Nachlauf_4 : 35|1@1+ (1,0) [0|1] "" Vector__XXX
 SG_ NWM_DSP_Nachlauf_5 : 36|1@1+ (1,0) [0|1] "" Vector__XXX
 SG_ NWM_DSP_Nachlauf_6 : 37|1@1+ (1,0) [0|1] "" Vector__XXX
 SG_ NWM_DSP_Nachlauf_7 : 38|1@1+ (1,0) [0|1] "" Vector__XXX
 SG_ NWM_DSP_Nachlauf_8 : 39|1@1+ (1,0) [0|1] "" Vector__XXX
 SG_ NWM_DSP_TimeOut_Fehler : 41|1@1+ (1,0) [0|1] "" Vector__XXX
 SG_ NWM_DSP_CAN_Diag_deaktiv : 42|1@1+ (1,0) [0|1] "" Vector__XXX
 SG_ NWM_DSP_KompSchutz : 43|1@1+ (1,0) [0|1] "" Vector__XXX
 SG_ NWM_DSP_Mute_Mode : 44|1@1+ (1,0) [0|1] "" Vector__XXX
 SG_ NWM_DSP_Transport_Mode : 45|1@1+ (1,0) [0|1] "" Vector__XXX
 SG_ NWM_DSP_Abschaltst_aktiv : 46|1@1+ (1,0) [0|1] "" Vector__XXX
 SG_ NWM_DSP_Eindraht_Fehler : 47|1@1+ (1,0) [0|1] "" Vector__XXX
 SG_ NWM_DSP_Anf_1 : 48|1@1+ (1,0) [0|1] "" Vector__XXX
 SG_ NWM_DSP_Anf_2 : 49|1@1+ (1,0) [0|1] "" Vector__XXX
 SG_ NWM_DSP_Anf_3 : 50|1@1+ (1,0) [0|1] "" Vector__XXX
 SG_ NWM_DSP_Anf_4 : 51|1@1+ (1,0) [0|1] "" Vector__XXX
 SG_ NWM_DSP_Anf_5 : 52|1@1+ (1,0) [0|1] "" Vector__XXX
 SG_ NWM_DSP_Anf_6 : 53|1@1+ (1,0) [0|1] "" Vector__XXX
 SG_ NWM_DSP_Anf_7 : 54|1@1+ (1,0) [0|1] "" Vector__XXX
 SG_ NWM_DSP_Anf_8 : 55|1@1+ (1,0) [0|1] "" Vector__XXX
 SG_ NWM_DSP_Anf_9 : 56|1@1+ (1,0) [0|1] "" Vector__XXX
 SG_ NWM_DSP_Anf_10 : 57|1@1+ (1,0) [0|1] "" Vector__XXX
 SG_ NWM_DSP_Anf_11 : 58|1@1+ (1,0) [0|1] "" Vector__XXX
 SG_ NWM_DSP_Anf_12 : 59|1@1+ (1,0) [0|1] "" Vector__XXX
 SG_ NWM_DSP_Anf_13 : 60|1@1+ (1,0) [0|1] "" Vector__XXX
 SG_ NWM_DSP_Anf_14 : 61|1@1+ (1,0) [0|1] "" Vector__XXX
 SG_ NWM_DSP_Anf_15 : 62|1@1+ (1,0) [0|1] "" Vector__XXX
 SG_ NWM_DSP_Anf_16 : 63|1@1+ (1,0) [0|1] "" Vector__XXX

BO_ 1077 NWM_MDI: 8 MDI
 SG_ NWM_MDI_Receiver : 0|8@1+ (1,0) [0|255] ""  Booster_AMP,DSP_SKODA,Gateway_PQ35,Gateway_PQ46,GSM_Pager,Kompassmodul,MDI,Radio_2DIN,Radio_Modul,Radio_SKODA,Rearview,RNS_300_NF,RNS_MFD2,RNS_midline,SDARS_Tuner,Sprachbedienung,Standheizung,Tastatur,Telematik_Basis,TV_hybrid,UHV_High,UHV_low,UHV_NAR,UHV_Premium,UHV_UMTS
 SG_ NWM_MDI_CmdRing : 8|1@1+ (1,0) [0|1] ""  Booster_AMP,DSP_SKODA,Gateway_PQ35,Gateway_PQ46,GSM_Pager,Kompassmodul,MDI,Radio_2DIN,Radio_Modul,Radio_SKODA,Rearview,RNS_300_NF,RNS_MFD2,RNS_midline,SDARS_Tuner,Sprachbedienung,Standheizung,Tastatur,Telematik_Basis,TV_hybrid,UHV_High,UHV_low,UHV_NAR,UHV_Premium,UHV_UMTS
 SG_ NWM_MDI_CmdAlive : 9|1@1+ (1,0) [0|1] ""  Booster_AMP,DSP_SKODA,Gateway_PQ35,Gateway_PQ46,GSM_Pager,Kompassmodul,MDI,Radio_2DIN,Radio_Modul,Radio_SKODA,Rearview,RNS_300_NF,RNS_MFD2,RNS_midline,SDARS_Tuner,Sprachbedienung,Standheizung,Tastatur,Telematik_Basis,TV_hybrid,UHV_High,UHV_low,UHV_NAR,UHV_Premium,UHV_UMTS
 SG_ NWM_MDI_CmdLimpHome : 10|1@1+ (1,0) [0|1] ""  Booster_AMP,DSP_SKODA,Gateway_PQ35,Gateway_PQ46,GSM_Pager,Kompassmodul,MDI,Radio_2DIN,Radio_Modul,Radio_SKODA,Rearview,RNS_300_NF,RNS_MFD2,RNS_midline,SDARS_Tuner,Sprachbedienung,Standheizung,Tastatur,Telematik_Basis,TV_hybrid,UHV_High,UHV_low,UHV_NAR,UHV_Premium,UHV_UMTS
 SG_ NWM_MDI_SleepInd : 12|1@1+ (1,0) [0|1] ""  Booster_AMP,DSP_SKODA,Gateway_PQ35,Gateway_PQ46,GSM_Pager,Kompassmodul,MDI,Radio_2DIN,Radio_Modul,Radio_SKODA,Rearview,RNS_300_NF,RNS_MFD2,RNS_midline,SDARS_Tuner,Sprachbedienung,Standheizung,Tastatur,Telematik_Basis,TV_hybrid,UHV_High,UHV_low,UHV_NAR,UHV_Premium,UHV_UMTS
 SG_ NWM_MDI_SleepAck : 13|1@1+ (1,0) [0|1] ""  Booster_AMP,DSP_SKODA,Gateway_PQ35,Gateway_PQ46,GSM_Pager,Kompassmodul,MDI,Radio_2DIN,Radio_Modul,Radio_SKODA,Rearview,RNS_300_NF,RNS_MFD2,RNS_midline,SDARS_Tuner,Sprachbedienung,Standheizung,Tastatur,Telematik_Basis,TV_hybrid,UHV_High,UHV_low,UHV_NAR,UHV_Premium,UHV_UMTS
 SG_ NWM_MDI_Per_WakeUp : 16|5@1+ (1,0) [0|31] "" Vector__XXX
 SG_ NWM_MDI_Fkt_WakeUp : 21|3@1+ (1,0) [0|7] "" Vector__XXX
 SG_ NWM_MDI_Klemme_15 : 24|1@1+ (1,0) [0|1] "" Vector__XXX
 SG_ NWM_MDI_Diagnose : 25|1@1+ (1,0) [0|1] "" Vector__XXX
 SG_ NWM_MDI_MindestAktivZeit : 26|1@1+ (1,0) [0|1] "" Vector__XXX
 SG_ NWM_MDI_Ursache_4 : 27|1@1+ (1,0) [0|1] "" Vector__XXX
 SG_ NWM_MDI_Ursache_5 : 28|1@1+ (1,0) [0|1] "" Vector__XXX
 SG_ NWM_MDI_Ursache_6 : 29|1@1+ (1,0) [0|1] "" Vector__XXX
 SG_ NWM_MDI_Ursache_7 : 30|1@1+ (1,0) [0|1] "" Vector__XXX
 SG_ NWM_MDI_Ursache_8 : 31|1@1+ (1,0) [0|1] "" Vector__XXX
 SG_ NWM_MDI_Nachlauf_1 : 32|1@1+ (1,0) [0|1] "" Vector__XXX
 SG_ NWM_MDI_Nachlauf_2 : 33|1@1+ (1,0) [0|1] "" Vector__XXX
 SG_ NWM_MDI_Nachlauf_3 : 34|1@1+ (1,0) [0|1] "" Vector__XXX
 SG_ NWM_MDI_Nachlauf_4 : 35|1@1+ (1,0) [0|1] "" Vector__XXX
 SG_ NWM_MDI_Nachlauf_5 : 36|1@1+ (1,0) [0|1] "" Vector__XXX
 SG_ NWM_MDI_Nachlauf_6 : 37|1@1+ (1,0) [0|1] "" Vector__XXX
 SG_ NWM_MDI_Nachlauf_7 : 38|1@1+ (1,0) [0|1] "" Vector__XXX
 SG_ NWM_MDI_Nachlauf_8 : 39|1@1+ (1,0) [0|1] "" Vector__XXX
 SG_ NWM_MDI_TimeOut_Fehler : 41|1@1+ (1,0) [0|1] "" Vector__XXX
 SG_ NWM_MDI_CAN_Diag_deaktiv : 42|1@1+ (1,0) [0|1] "" Vector__XXX
 SG_ NWM_MDI_KompSchutz : 43|1@1+ (1,0) [0|1] "" Vector__XXX
 SG_ NWM_MDI_Mute_Mode : 44|1@1+ (1,0) [0|1] "" Vector__XXX
 SG_ NWM_MDI_Transport_Mode : 45|1@1+ (1,0) [0|1] "" Vector__XXX
 SG_ NWM_MDI_Abschaltst_aktiv : 46|1@1+ (1,0) [0|1] "" Vector__XXX
 SG_ NWM_MDI_Eindraht_Fehler : 47|1@1+ (1,0) [0|1] "" Vector__XXX
 SG_ NWM_MDI_Anf_1 : 48|1@1+ (1,0) [0|1] "" Vector__XXX
 SG_ NWM_MDI_Anf_2 : 49|1@1+ (1,0) [0|1] "" Vector__XXX
 SG_ NWM_MDI_Anf_3 : 50|1@1+ (1,0) [0|1] "" Vector__XXX
 SG_ NWM_MDI_Anf_4 : 51|1@1+ (1,0) [0|1] "" Vector__XXX
 SG_ NWM_MDI_Anf_5 : 52|1@1+ (1,0) [0|1] "" Vector__XXX
 SG_ NWM_MDI_Anf_6 : 53|1@1+ (1,0) [0|1] "" Vector__XXX
 SG_ NWM_MDI_Anf_7 : 54|1@1+ (1,0) [0|1] "" Vector__XXX
 SG_ NWM_MDI_Anf_8 : 55|1@1+ (1,0) [0|1] "" Vector__XXX
 SG_ NWM_MDI_Anf_9 : 56|1@1+ (1,0) [0|1] "" Vector__XXX
 SG_ NWM_MDI_Anf_10 : 57|1@1+ (1,0) [0|1] "" Vector__XXX
 SG_ NWM_MDI_Anf_11 : 58|1@1+ (1,0) [0|1] "" Vector__XXX
 SG_ NWM_MDI_Anf_12 : 59|1@1+ (1,0) [0|1] "" Vector__XXX
 SG_ NWM_MDI_Anf_13 : 60|1@1+ (1,0) [0|1] "" Vector__XXX
 SG_ NWM_MDI_Anf_14 : 61|1@1+ (1,0) [0|1] "" Vector__XXX
 SG_ NWM_MDI_Anf_15 : 62|1@1+ (1,0) [0|1] "" Vector__XXX
 SG_ NWM_MDI_Anf_16 : 63|1@1+ (1,0) [0|1] "" Vector__XXX

BO_ 1081 NWM_Radio: 8 Radio_2DIN
 SG_ NWM_Radio_Receiver : 0|8@1+ (1,0) [0|255] ""  Booster_AMP,DSP_SKODA,Gateway_PQ35,Gateway_PQ46,GSM_Pager,Kompassmodul,MDI,Radio_2DIN,Radio_Modul,Radio_SKODA,Rearview,RNS_300_NF,RNS_MFD2,RNS_midline,SDARS_Tuner,Sprachbedienung,Standheizung,Tastatur,Telematik_Basis,TV_hybrid,UHV_High,UHV_low,UHV_NAR,UHV_Premium,UHV_UMTS
 SG_ NWM_Radio_CmdRing : 8|1@1+ (1,0) [0|1] ""  Booster_AMP,DSP_SKODA,Gateway_PQ35,Gateway_PQ46,GSM_Pager,Kompassmodul,MDI,Radio_2DIN,Radio_Modul,Radio_SKODA,Rearview,RNS_300_NF,RNS_MFD2,RNS_midline,SDARS_Tuner,Sprachbedienung,Standheizung,Tastatur,Telematik_Basis,TV_hybrid,UHV_High,UHV_low,UHV_NAR,UHV_Premium,UHV_UMTS
 SG_ NWM_Radio_CmdAlive : 9|1@1+ (1,0) [0|1] ""  Booster_AMP,DSP_SKODA,Gateway_PQ35,Gateway_PQ46,GSM_Pager,Kompassmodul,MDI,Radio_2DIN,Radio_Modul,Radio_SKODA,Rearview,RNS_300_NF,RNS_MFD2,RNS_midline,SDARS_Tuner,Sprachbedienung,Standheizung,Tastatur,Telematik_Basis,TV_hybrid,UHV_High,UHV_low,UHV_NAR,UHV_Premium,UHV_UMTS
 SG_ NWM_Radio_CmdLimpHome : 10|1@1+ (1,0) [0|1] ""  Booster_AMP,DSP_SKODA,Gateway_PQ35,Gateway_PQ46,GSM_Pager,Kompassmodul,MDI,Radio_2DIN,Radio_Modul,Radio_SKODA,Rearview,RNS_300_NF,RNS_MFD2,RNS_midline,SDARS_Tuner,Sprachbedienung,Standheizung,Tastatur,Telematik_Basis,TV_hybrid,UHV_High,UHV_low,UHV_NAR,UHV_Premium,UHV_UMTS
 SG_ NWM_Radio_SleepInd : 12|1@1+ (1,0) [0|1] ""  Booster_AMP,DSP_SKODA,Gateway_PQ35,Gateway_PQ46,GSM_Pager,Kompassmodul,MDI,Radio_2DIN,Radio_Modul,Radio_SKODA,Rearview,RNS_300_NF,RNS_MFD2,RNS_midline,SDARS_Tuner,Sprachbedienung,Standheizung,Tastatur,Telematik_Basis,TV_hybrid,UHV_High,UHV_low,UHV_NAR,UHV_Premium,UHV_UMTS
 SG_ NWM_Radio_SleepAck : 13|1@1+ (1,0) [0|1] ""  Booster_AMP,DSP_SKODA,Gateway_PQ35,Gateway_PQ46,GSM_Pager,Kompassmodul,MDI,Radio_2DIN,Radio_Modul,Radio_SKODA,Rearview,RNS_300_NF,RNS_MFD2,RNS_midline,SDARS_Tuner,Sprachbedienung,Standheizung,Tastatur,Telematik_Basis,TV_hybrid,UHV_High,UHV_low,UHV_NAR,UHV_Premium,UHV_UMTS
 SG_ NWM_Radio_Per_WakeUp : 16|5@1+ (1,0) [0|31] "" Vector__XXX
 SG_ NWM_Radio_Fkt_WakeUp : 21|3@1+ (1,0) [0|7] "" Vector__XXX
 SG_ NWM_Radio_Klemme_15 : 24|1@1+ (1,0) [0|1] "" Vector__XXX
 SG_ NWM_Radio_Diagnose : 25|1@1+ (1,0) [0|1] "" Vector__XXX
 SG_ NWM_Radio_MindestAktivZeit : 26|1@1+ (1,0) [0|1] "" Vector__XXX
 SG_ NWM_Radio_Ursache_4 : 27|1@1+ (1,0) [0|1] "" Vector__XXX
 SG_ NWM_Radio_Ursache_5 : 28|1@1+ (1,0) [0|1] "" Vector__XXX
 SG_ NWM_Radio_Ursache_6 : 29|1@1+ (1,0) [0|1] "" Vector__XXX
 SG_ NWM_Radio_Ursache_7 : 30|1@1+ (1,0) [0|1] "" Vector__XXX
 SG_ NWM_Radio_Ursache_8 : 31|1@1+ (1,0) [0|1] "" Vector__XXX
 SG_ NWM_Radio_Nachlauf_1 : 32|1@1+ (1,0) [0|1] "" Vector__XXX
 SG_ NWM_Radio_Nachlauf_2 : 33|1@1+ (1,0) [0|1] "" Vector__XXX
 SG_ NWM_Radio_Nachlauf_3 : 34|1@1+ (1,0) [0|1] "" Vector__XXX
 SG_ NWM_Radio_Nachlauf_4 : 35|1@1+ (1,0) [0|1] "" Vector__XXX
 SG_ NWM_Radio_Nachlauf_5 : 36|1@1+ (1,0) [0|1] "" Vector__XXX
 SG_ NWM_Radio_Nachlauf_6 : 37|1@1+ (1,0) [0|1] "" Vector__XXX
 SG_ NWM_Radio_Nachlauf_7 : 38|1@1+ (1,0) [0|1] "" Vector__XXX
 SG_ NWM_Radio_Nachlauf_8 : 39|1@1+ (1,0) [0|1] "" Vector__XXX
 SG_ NWM_Radio_TimeOut_Fehler : 41|1@1+ (1,0) [0|1] "" Vector__XXX
 SG_ NWM_Radio_CAN_Diag_deaktiv : 42|1@1+ (1,0) [0|1] "" Vector__XXX
 SG_ NWM_Radio_KompSchutz : 43|1@1+ (1,0) [0|1] "" Vector__XXX
 SG_ NWM_Radio_Mute_Mode : 44|1@1+ (1,0) [0|1] "" Vector__XXX
 SG_ NWM_Radio_Transport_Mode : 45|1@1+ (1,0) [0|1] "" Vector__XXX
 SG_ NWM_Radio_Abschaltst_aktiv : 46|1@1+ (1,0) [0|1] "" Vector__XXX
 SG_ NWM_Radio_Eindraht_Fehler : 47|1@1+ (1,0) [0|1] "" Vector__XXX
 SG_ NWM_Radio_Anf_1 : 48|1@1+ (1,0) [0|1] "" Vector__XXX
 SG_ NWM_Radio_Anf_2 : 49|1@1+ (1,0) [0|1] "" Vector__XXX
 SG_ NWM_Radio_Anf_3 : 50|1@1+ (1,0) [0|1] "" Vector__XXX
 SG_ NWM_Radio_Anf_4 : 51|1@1+ (1,0) [0|1] "" Vector__XXX
 SG_ NWM_Radio_Anf_5 : 52|1@1+ (1,0) [0|1] "" Vector__XXX
 SG_ NWM_Radio_Anf_6 : 53|1@1+ (1,0) [0|1] "" Vector__XXX
 SG_ NWM_Radio_Anf_7 : 54|1@1+ (1,0) [0|1] "" Vector__XXX
 SG_ NWM_Radio_Anf_8 : 55|1@1+ (1,0) [0|1] "" Vector__XXX
 SG_ NWM_Radio_Anf_9 : 56|1@1+ (1,0) [0|1] "" Vector__XXX
 SG_ NWM_Radio_Anf_10 : 57|1@1+ (1,0) [0|1] "" Vector__XXX
 SG_ NWM_Radio_Anf_11 : 58|1@1+ (1,0) [0|1] "" Vector__XXX
 SG_ NWM_Radio_Anf_12 : 59|1@1+ (1,0) [0|1] "" Vector__XXX
 SG_ NWM_Radio_Anf_13 : 60|1@1+ (1,0) [0|1] "" Vector__XXX
 SG_ NWM_Radio_Anf_14 : 61|1@1+ (1,0) [0|1] "" Vector__XXX
 SG_ NWM_Radio_Anf_15 : 62|1@1+ (1,0) [0|1] "" Vector__XXX
 SG_ NWM_Radio_Anf_16 : 63|1@1+ (1,0) [0|1] "" Vector__XXX

BO_ 1065 NWM_Rearview: 8 Rearview
 SG_ NWM_RV_Receiver : 0|8@1+ (1,0) [0|255] ""  Booster_AMP,DSP_SKODA,Gateway_PQ35,Gateway_PQ46,GSM_Pager,Kompassmodul,MDI,Radio_2DIN,Radio_Modul,Radio_SKODA,Rearview,RNS_300_NF,RNS_MFD2,RNS_midline,SDARS_Tuner,Sprachbedienung,Standheizung,Tastatur,Telematik_Basis,TV_hybrid,UHV_High,UHV_low,UHV_NAR,UHV_Premium,UHV_UMTS
 SG_ NWM_RV_CmdRing : 8|1@1+ (1,0) [0|1] ""  Booster_AMP,DSP_SKODA,Gateway_PQ35,Gateway_PQ46,GSM_Pager,Kompassmodul,MDI,Radio_2DIN,Radio_Modul,Radio_SKODA,Rearview,RNS_300_NF,RNS_MFD2,RNS_midline,SDARS_Tuner,Sprachbedienung,Standheizung,Tastatur,Telematik_Basis,TV_hybrid,UHV_High,UHV_low,UHV_NAR,UHV_Premium,UHV_UMTS
 SG_ NWM_RV_CmdAlive : 9|1@1+ (1,0) [0|1] ""  Booster_AMP,DSP_SKODA,Gateway_PQ35,Gateway_PQ46,GSM_Pager,Kompassmodul,MDI,Radio_2DIN,Radio_Modul,Radio_SKODA,Rearview,RNS_300_NF,RNS_MFD2,RNS_midline,SDARS_Tuner,Sprachbedienung,Standheizung,Tastatur,Telematik_Basis,TV_hybrid,UHV_High,UHV_low,UHV_NAR,UHV_Premium,UHV_UMTS
 SG_ NWM_RV_CmdLimpHome : 10|1@1+ (1,0) [0|1] ""  Booster_AMP,DSP_SKODA,Gateway_PQ35,Gateway_PQ46,GSM_Pager,Kompassmodul,MDI,Radio_2DIN,Radio_Modul,Radio_SKODA,Rearview,RNS_300_NF,RNS_MFD2,RNS_midline,SDARS_Tuner,Sprachbedienung,Standheizung,Tastatur,Telematik_Basis,TV_hybrid,UHV_High,UHV_low,UHV_NAR,UHV_Premium,UHV_UMTS
 SG_ NWM_RV_SleepInd : 12|1@1+ (1,0) [0|1] ""  Booster_AMP,DSP_SKODA,Gateway_PQ35,Gateway_PQ46,GSM_Pager,Kompassmodul,MDI,Radio_2DIN,Radio_Modul,Radio_SKODA,Rearview,RNS_300_NF,RNS_MFD2,RNS_midline,SDARS_Tuner,Sprachbedienung,Standheizung,Tastatur,Telematik_Basis,TV_hybrid,UHV_High,UHV_low,UHV_NAR,UHV_Premium,UHV_UMTS
 SG_ NWM_RV_SleepAck : 13|1@1+ (1,0) [0|1] ""  Booster_AMP,DSP_SKODA,Gateway_PQ35,Gateway_PQ46,GSM_Pager,Kompassmodul,MDI,Radio_2DIN,Radio_Modul,Radio_SKODA,Rearview,RNS_300_NF,RNS_MFD2,RNS_midline,SDARS_Tuner,Sprachbedienung,Standheizung,Tastatur,Telematik_Basis,TV_hybrid,UHV_High,UHV_low,UHV_NAR,UHV_Premium,UHV_UMTS
 SG_ NWM_RV_Per_WakeUp : 16|5@1+ (1,0) [0|31] "" Vector__XXX
 SG_ NWM_RV_Fkt_WakeUp : 21|3@1+ (1,0) [0|7] "" Vector__XXX
 SG_ NWM_RV_Klemme_15 : 24|1@1+ (1,0) [0|1] "" Vector__XXX
 SG_ NWM_RV_Diagnose : 25|1@1+ (1,0) [0|1] "" Vector__XXX
 SG_ NWM_RV_MindestAktivZeit : 26|1@1+ (1,0) [0|1] "" Vector__XXX
 SG_ NWM_RV_Ursache_4 : 27|1@1+ (1,0) [0|1] "" Vector__XXX
 SG_ NWM_RV_Ursache_5 : 28|1@1+ (1,0) [0|1] "" Vector__XXX
 SG_ NWM_RV_Ursache_6 : 29|1@1+ (1,0) [0|1] "" Vector__XXX
 SG_ NWM_RV_Ursache_7 : 30|1@1+ (1,0) [0|1] "" Vector__XXX
 SG_ NWM_RV_Ursache_8 : 31|1@1+ (1,0) [0|1] "" Vector__XXX
 SG_ NWM_RV_Nachlauf_1 : 32|1@1+ (1,0) [0|1] "" Vector__XXX
 SG_ NWM_RV_Nachlauf_2 : 33|1@1+ (1,0) [0|1] "" Vector__XXX
 SG_ NWM_RV_Nachlauf_3 : 34|1@1+ (1,0) [0|1] "" Vector__XXX
 SG_ NWM_RV_Nachlauf_4 : 35|1@1+ (1,0) [0|1] "" Vector__XXX
 SG_ NWM_RV_Nachlauf_5 : 36|1@1+ (1,0) [0|1] "" Vector__XXX
 SG_ NWM_RV_Nachlauf_6 : 37|1@1+ (1,0) [0|1] "" Vector__XXX
 SG_ NWM_RV_Nachlauf_7 : 38|1@1+ (1,0) [0|1] "" Vector__XXX
 SG_ NWM_RV_Nachlauf_8 : 39|1@1+ (1,0) [0|1] "" Vector__XXX
 SG_ NWM_RV_TimeOut_Fehler : 41|1@1+ (1,0) [0|1] "" Vector__XXX
 SG_ NWM_RV_CAN_Diag_deaktiv : 42|1@1+ (1,0) [0|1] "" Vector__XXX
 SG_ NWM_RV_KompSchutz : 43|1@1+ (1,0) [0|1] "" Vector__XXX
 SG_ NWM_RV_Mute_Mode : 44|1@1+ (1,0) [0|1] "" Vector__XXX
 SG_ NWM_RV_Transport_Mode : 45|1@1+ (1,0) [0|1] "" Vector__XXX
 SG_ NWM_RV_Abschaltst_aktiv : 46|1@1+ (1,0) [0|1] "" Vector__XXX
 SG_ NWM_RV_Eindraht_Fehler : 47|1@1+ (1,0) [0|1] "" Vector__XXX
 SG_ NWM_RV_Anf_1 : 48|1@1+ (1,0) [0|1] "" Vector__XXX
 SG_ NWM_RV_Anf_2 : 49|1@1+ (1,0) [0|1] "" Vector__XXX
 SG_ NWM_RV_Anf_3 : 50|1@1+ (1,0) [0|1] "" Vector__XXX
 SG_ NWM_RV_Anf_4 : 51|1@1+ (1,0) [0|1] "" Vector__XXX
 SG_ NWM_RV_Anf_5 : 52|1@1+ (1,0) [0|1] "" Vector__XXX
 SG_ NWM_RV_Anf_6 : 53|1@1+ (1,0) [0|1] "" Vector__XXX
 SG_ NWM_RV_Anf_7 : 54|1@1+ (1,0) [0|1] "" Vector__XXX
 SG_ NWM_RV_Anf_8 : 55|1@1+ (1,0) [0|1] "" Vector__XXX
 SG_ NWM_RV_Anf_9 : 56|1@1+ (1,0) [0|1] "" Vector__XXX
 SG_ NWM_RV_Anf_10 : 57|1@1+ (1,0) [0|1] "" Vector__XXX
 SG_ NWM_RV_Anf_11 : 58|1@1+ (1,0) [0|1] "" Vector__XXX
 SG_ NWM_RV_Anf_12 : 59|1@1+ (1,0) [0|1] "" Vector__XXX
 SG_ NWM_RV_Anf_13 : 60|1@1+ (1,0) [0|1] "" Vector__XXX
 SG_ NWM_RV_Anf_14 : 61|1@1+ (1,0) [0|1] "" Vector__XXX
 SG_ NWM_RV_Anf_15 : 62|1@1+ (1,0) [0|1] "" Vector__XXX
 SG_ NWM_RV_Anf_16 : 63|1@1+ (1,0) [0|1] "" Vector__XXX

BO_ 1078 NWM_RNS: 8 RNS_300_NF
 SG_ NWM_RNS_Receiver : 0|8@1+ (1,0) [0|255] ""  Booster_AMP,DSP_SKODA,Gateway_PQ35,Gateway_PQ46,GSM_Pager,Kompassmodul,MDI,Radio_2DIN,Radio_Modul,Radio_SKODA,Rearview,RNS_300_NF,RNS_MFD2,RNS_midline,SDARS_Tuner,Sprachbedienung,Standheizung,Tastatur,Telematik_Basis,TV_hybrid,UHV_High,UHV_low,UHV_NAR,UHV_Premium,UHV_UMTS
 SG_ NWM_RNS_CmdRing : 8|1@1+ (1,0) [0|1] ""  Booster_AMP,DSP_SKODA,Gateway_PQ35,Gateway_PQ46,GSM_Pager,Kompassmodul,MDI,Radio_2DIN,Radio_Modul,Radio_SKODA,Rearview,RNS_300_NF,RNS_MFD2,RNS_midline,SDARS_Tuner,Sprachbedienung,Standheizung,Tastatur,Telematik_Basis,TV_hybrid,UHV_High,UHV_low,UHV_NAR,UHV_Premium,UHV_UMTS
 SG_ NWM_RNS_CmdAlive : 9|1@1+ (1,0) [0|1] ""  Booster_AMP,DSP_SKODA,Gateway_PQ35,Gateway_PQ46,GSM_Pager,Kompassmodul,MDI,Radio_2DIN,Radio_Modul,Radio_SKODA,Rearview,RNS_300_NF,RNS_MFD2,RNS_midline,SDARS_Tuner,Sprachbedienung,Standheizung,Tastatur,Telematik_Basis,TV_hybrid,UHV_High,UHV_low,UHV_NAR,UHV_Premium,UHV_UMTS
 SG_ NWM_RNS_CmdLimpHome : 10|1@1+ (1,0) [0|1] ""  Booster_AMP,DSP_SKODA,Gateway_PQ35,Gateway_PQ46,GSM_Pager,Kompassmodul,MDI,Radio_2DIN,Radio_Modul,Radio_SKODA,Rearview,RNS_300_NF,RNS_MFD2,RNS_midline,SDARS_Tuner,Sprachbedienung,Standheizung,Tastatur,Telematik_Basis,TV_hybrid,UHV_High,UHV_low,UHV_NAR,UHV_Premium,UHV_UMTS
 SG_ NWM_RNS_SleepInd : 12|1@1+ (1,0) [0|1] ""  Booster_AMP,DSP_SKODA,Gateway_PQ35,Gateway_PQ46,GSM_Pager,Kompassmodul,MDI,Radio_2DIN,Radio_Modul,Radio_SKODA,Rearview,RNS_300_NF,RNS_MFD2,RNS_midline,SDARS_Tuner,Sprachbedienung,Standheizung,Tastatur,Telematik_Basis,TV_hybrid,UHV_High,UHV_low,UHV_NAR,UHV_Premium,UHV_UMTS
 SG_ NWM_RNS_SleepAck : 13|1@1+ (1,0) [0|1] ""  Booster_AMP,DSP_SKODA,Gateway_PQ35,Gateway_PQ46,GSM_Pager,Kompassmodul,MDI,Radio_2DIN,Radio_Modul,Radio_SKODA,Rearview,RNS_300_NF,RNS_MFD2,RNS_midline,SDARS_Tuner,Sprachbedienung,Standheizung,Tastatur,Telematik_Basis,TV_hybrid,UHV_High,UHV_low,UHV_NAR,UHV_Premium,UHV_UMTS
 SG_ NWM_RNS_Per_WakeUp : 16|5@1+ (1,0) [0|31] "" Vector__XXX
 SG_ NWM_RNS_Fkt_WakeUp : 21|3@1+ (1,0) [0|7] "" Vector__XXX
 SG_ NWM_RNS_Klemme_15 : 24|1@1+ (1,0) [0|1] "" Vector__XXX
 SG_ NWM_RNS_Diagnose : 25|1@1+ (1,0) [0|1] "" Vector__XXX
 SG_ NWM_RNS_MindestAktivZeit : 26|1@1+ (1,0) [0|1] "" Vector__XXX
 SG_ NWM_RNS_Ursache_4 : 27|1@1+ (1,0) [0|1] "" Vector__XXX
 SG_ NWM_RNS_Ursache_5 : 28|1@1+ (1,0) [0|1] "" Vector__XXX
 SG_ NWM_RNS_Ursache_6 : 29|1@1+ (1,0) [0|1] "" Vector__XXX
 SG_ NWM_RNS_Ursache_7 : 30|1@1+ (1,0) [0|1] "" Vector__XXX
 SG_ NWM_RNS_Ursache_8 : 31|1@1+ (1,0) [0|1] "" Vector__XXX
 SG_ NWM_RNS_Nachlauf_1 : 32|1@1+ (1,0) [0|1] "" Vector__XXX
 SG_ NWM_RNS_Nachlauf_2 : 33|1@1+ (1,0) [0|1] "" Vector__XXX
 SG_ NWM_RNS_Nachlauf_3 : 34|1@1+ (1,0) [0|1] "" Vector__XXX
 SG_ NWM_RNS_Nachlauf_4 : 35|1@1+ (1,0) [0|1] "" Vector__XXX
 SG_ NWM_RNS_Nachlauf_5 : 36|1@1+ (1,0) [0|1] "" Vector__XXX
 SG_ NWM_RNS_Nachlauf_6 : 37|1@1+ (1,0) [0|1] "" Vector__XXX
 SG_ NWM_RNS_Nachlauf_7 : 38|1@1+ (1,0) [0|1] "" Vector__XXX
 SG_ NWM_RNS_Nachlauf_8 : 39|1@1+ (1,0) [0|1] "" Vector__XXX
 SG_ NWM_RNS_TimeOut_Fehler : 41|1@1+ (1,0) [0|1] "" Vector__XXX
 SG_ NWM_RNS_CAN_Diag_deaktiv : 42|1@1+ (1,0) [0|1] "" Vector__XXX
 SG_ NWM_RNS_KompSchutz : 43|1@1+ (1,0) [0|1] "" Vector__XXX
 SG_ NWM_RNS_Mute_Mode : 44|1@1+ (1,0) [0|1] "" Vector__XXX
 SG_ NWM_RNS_Transport_Mode : 45|1@1+ (1,0) [0|1] "" Vector__XXX
 SG_ NWM_RNS_Abschaltst_aktiv : 46|1@1+ (1,0) [0|1] "" Vector__XXX
 SG_ NWM_RNS_Eindraht_Fehler : 47|1@1+ (1,0) [0|1] "" Vector__XXX
 SG_ NWM_RNS_Anf_1 : 48|1@1+ (1,0) [0|1] "" Vector__XXX
 SG_ NWM_RNS_Anf_2 : 49|1@1+ (1,0) [0|1] "" Vector__XXX
 SG_ NWM_RNS_Anf_3 : 50|1@1+ (1,0) [0|1] "" Vector__XXX
 SG_ NWM_RNS_Anf_4 : 51|1@1+ (1,0) [0|1] "" Vector__XXX
 SG_ NWM_RNS_Anf_5 : 52|1@1+ (1,0) [0|1] "" Vector__XXX
 SG_ NWM_RNS_Anf_6 : 53|1@1+ (1,0) [0|1] "" Vector__XXX
 SG_ NWM_RNS_Anf_7 : 54|1@1+ (1,0) [0|1] "" Vector__XXX
 SG_ NWM_RNS_Anf_8 : 55|1@1+ (1,0) [0|1] "" Vector__XXX
 SG_ NWM_RNS_Anf_9 : 56|1@1+ (1,0) [0|1] "" Vector__XXX
 SG_ NWM_RNS_Anf_10 : 57|1@1+ (1,0) [0|1] "" Vector__XXX
 SG_ NWM_RNS_Anf_11 : 58|1@1+ (1,0) [0|1] "" Vector__XXX
 SG_ NWM_RNS_Anf_12 : 59|1@1+ (1,0) [0|1] "" Vector__XXX
 SG_ NWM_RNS_Anf_13 : 60|1@1+ (1,0) [0|1] "" Vector__XXX
 SG_ NWM_RNS_Anf_14 : 61|1@1+ (1,0) [0|1] "" Vector__XXX
 SG_ NWM_RNS_Anf_15 : 62|1@1+ (1,0) [0|1] "" Vector__XXX
 SG_ NWM_RNS_Anf_16 : 63|1@1+ (1,0) [0|1] "" Vector__XXX

BO_ 1082 NWM_Telefon: 8 UHV_High
 SG_ NWM_TEL_Receiver : 0|8@1+ (1,0) [0|255] ""  Booster_AMP,DSP_SKODA,Gateway_PQ35,Gateway_PQ46,GSM_Pager,Kompassmodul,MDI,Radio_2DIN,Radio_Modul,Radio_SKODA,Rearview,RNS_300_NF,RNS_MFD2,RNS_midline,SDARS_Tuner,Sprachbedienung,Standheizung,Tastatur,Telematik_Basis,TV_hybrid,UHV_High,UHV_low,UHV_NAR,UHV_Premium,UHV_UMTS
 SG_ NWM_TEL_CmdRing : 8|1@1+ (1,0) [0|1] ""  Booster_AMP,DSP_SKODA,Gateway_PQ35,Gateway_PQ46,GSM_Pager,Kompassmodul,MDI,Radio_2DIN,Radio_Modul,Radio_SKODA,Rearview,RNS_300_NF,RNS_MFD2,RNS_midline,SDARS_Tuner,Sprachbedienung,Standheizung,Tastatur,Telematik_Basis,TV_hybrid,UHV_High,UHV_low,UHV_NAR,UHV_Premium,UHV_UMTS
 SG_ NWM_TEL_CmdAlive : 9|1@1+ (1,0) [0|1] ""  Booster_AMP,DSP_SKODA,Gateway_PQ35,Gateway_PQ46,GSM_Pager,Kompassmodul,MDI,Radio_2DIN,Radio_Modul,Radio_SKODA,Rearview,RNS_300_NF,RNS_MFD2,RNS_midline,SDARS_Tuner,Sprachbedienung,Standheizung,Tastatur,Telematik_Basis,TV_hybrid,UHV_High,UHV_low,UHV_NAR,UHV_Premium,UHV_UMTS
 SG_ NWM_TEL_CmdLimpHome : 10|1@1+ (1,0) [0|1] ""  Booster_AMP,DSP_SKODA,Gateway_PQ35,Gateway_PQ46,GSM_Pager,Kompassmodul,MDI,Radio_2DIN,Radio_Modul,Radio_SKODA,Rearview,RNS_300_NF,RNS_MFD2,RNS_midline,SDARS_Tuner,Sprachbedienung,Standheizung,Tastatur,Telematik_Basis,TV_hybrid,UHV_High,UHV_low,UHV_NAR,UHV_Premium,UHV_UMTS
 SG_ NWM_TEL_SleepInd : 12|1@1+ (1,0) [0|1] ""  Booster_AMP,DSP_SKODA,Gateway_PQ35,Gateway_PQ46,GSM_Pager,Kompassmodul,MDI,Radio_2DIN,Radio_Modul,Radio_SKODA,Rearview,RNS_300_NF,RNS_MFD2,RNS_midline,SDARS_Tuner,Sprachbedienung,Standheizung,Tastatur,Telematik_Basis,TV_hybrid,UHV_High,UHV_low,UHV_NAR,UHV_Premium,UHV_UMTS
 SG_ NWM_TEL_SleepAck : 13|1@1+ (1,0) [0|1] ""  Booster_AMP,DSP_SKODA,Gateway_PQ35,Gateway_PQ46,GSM_Pager,Kompassmodul,MDI,Radio_2DIN,Radio_Modul,Radio_SKODA,Rearview,RNS_300_NF,RNS_MFD2,RNS_midline,SDARS_Tuner,Sprachbedienung,Standheizung,Tastatur,Telematik_Basis,TV_hybrid,UHV_High,UHV_low,UHV_NAR,UHV_Premium,UHV_UMTS
 SG_ NWM_TEL_Per_WakeUp : 16|5@1+ (1,0) [0|31] "" Vector__XXX
 SG_ NWM_TEL_Fkt_WakeUp : 21|3@1+ (1,0) [0|7] "" Vector__XXX
 SG_ NWM_TEL_Klemme_15 : 24|1@1+ (1,0) [0|1] "" Vector__XXX
 SG_ NWM_TEL_Diagnose : 25|1@1+ (1,0) [0|1] "" Vector__XXX
 SG_ NWM_TEL_MindestAktivZeit : 26|1@1+ (1,0) [0|1] "" Vector__XXX
 SG_ NWM_TEL_Ursache_4 : 27|1@1+ (1,0) [0|1] "" Vector__XXX
 SG_ NWM_TEL_Ursache_5 : 28|1@1+ (1,0) [0|1] "" Vector__XXX
 SG_ NWM_TEL_Ursache_6 : 29|1@1+ (1,0) [0|1] "" Vector__XXX
 SG_ NWM_TEL_Ursache_7 : 30|1@1+ (1,0) [0|1] "" Vector__XXX
 SG_ NWM_TEL_Ursache_8 : 31|1@1+ (1,0) [0|1] "" Vector__XXX
 SG_ NWM_TEL_Nachlauf_1 : 32|1@1+ (1,0) [0|1] "" Vector__XXX
 SG_ NWM_TEL_Nachlauf_2 : 33|1@1+ (1,0) [0|1] "" Vector__XXX
 SG_ NWM_TEL_Nachlauf_3 : 34|1@1+ (1,0) [0|1] "" Vector__XXX
 SG_ NWM_TEL_Nachlauf_4 : 35|1@1+ (1,0) [0|1] "" Vector__XXX
 SG_ NWM_TEL_Nachlauf_5 : 36|1@1+ (1,0) [0|1] "" Vector__XXX
 SG_ NWM_TEL_Nachlauf_6 : 37|1@1+ (1,0) [0|1] "" Vector__XXX
 SG_ NWM_TEL_Nachlauf_7 : 38|1@1+ (1,0) [0|1] "" Vector__XXX
 SG_ NWM_TEL_Nachlauf_8 : 39|1@1+ (1,0) [0|1] "" Vector__XXX
 SG_ NWM_TEL_TimeOut_Fehler : 41|1@1+ (1,0) [0|1] "" Vector__XXX
 SG_ NWM_TEL_CAN_Diag_deaktiv : 42|1@1+ (1,0) [0|1] "" Vector__XXX
 SG_ NWM_TEL_KompSchutz : 43|1@1+ (1,0) [0|1] "" Vector__XXX
 SG_ NWM_TEL_Mute_Mode : 44|1@1+ (1,0) [0|1] "" Vector__XXX
 SG_ NWM_TEL_Transport_Mode : 45|1@1+ (1,0) [0|1] "" Vector__XXX
 SG_ NWM_TEL_Abschaltst_aktiv : 46|1@1+ (1,0) [0|1] "" Vector__XXX
 SG_ NWM_TEL_Eindraht_Fehler : 47|1@1+ (1,0) [0|1] "" Vector__XXX
 SG_ NWM_TEL_Anf_1 : 48|1@1+ (1,0) [0|1] "" Vector__XXX
 SG_ NWM_TEL_Anf_2 : 49|1@1+ (1,0) [0|1] "" Vector__XXX
 SG_ NWM_TEL_Anf_3 : 50|1@1+ (1,0) [0|1] "" Vector__XXX
 SG_ NWM_TEL_Anf_4 : 51|1@1+ (1,0) [0|1] "" Vector__XXX
 SG_ NWM_TEL_Anf_5 : 52|1@1+ (1,0) [0|1] "" Vector__XXX
 SG_ NWM_TEL_Anf_6 : 53|1@1+ (1,0) [0|1] "" Vector__XXX
 SG_ NWM_TEL_Anf_7 : 54|1@1+ (1,0) [0|1] "" Vector__XXX
 SG_ NWM_TEL_Anf_8 : 55|1@1+ (1,0) [0|1] "" Vector__XXX
 SG_ NWM_TEL_Anf_9 : 56|1@1+ (1,0) [0|1] "" Vector__XXX
 SG_ NWM_TEL_Anf_10 : 57|1@1+ (1,0) [0|1] "" Vector__XXX
 SG_ NWM_TEL_Anf_11 : 58|1@1+ (1,0) [0|1] "" Vector__XXX
 SG_ NWM_TEL_Anf_12 : 59|1@1+ (1,0) [0|1] "" Vector__XXX
 SG_ NWM_TEL_Anf_13 : 60|1@1+ (1,0) [0|1] "" Vector__XXX
 SG_ NWM_TEL_Anf_14 : 61|1@1+ (1,0) [0|1] "" Vector__XXX
 SG_ NWM_TEL_Anf_15 : 62|1@1+ (1,0) [0|1] "" Vector__XXX
 SG_ NWM_TEL_Anf_16 : 63|1@1+ (1,0) [0|1] "" Vector__XXX

BO_ 1079 NWM_TV: 8 TV_hybrid
 SG_ NWM_TV_Receiver : 0|8@1+ (1,0) [0|255] ""  Booster_AMP,DSP_SKODA,Gateway_PQ35,Gateway_PQ46,GSM_Pager,Kompassmodul,MDI,Radio_2DIN,Radio_Modul,Radio_SKODA,Rearview,RNS_300_NF,RNS_MFD2,RNS_midline,SDARS_Tuner,Sprachbedienung,Standheizung,Tastatur,Telematik_Basis,TV_hybrid,UHV_High,UHV_low,UHV_NAR,UHV_Premium,UHV_UMTS
 SG_ NWM_TV_CmdRing : 8|1@1+ (1,0) [0|1] ""  Booster_AMP,DSP_SKODA,Gateway_PQ35,Gateway_PQ46,GSM_Pager,Kompassmodul,MDI,Radio_2DIN,Radio_Modul,Radio_SKODA,Rearview,RNS_300_NF,RNS_MFD2,RNS_midline,SDARS_Tuner,Sprachbedienung,Standheizung,Tastatur,Telematik_Basis,TV_hybrid,UHV_High,UHV_low,UHV_NAR,UHV_Premium,UHV_UMTS
 SG_ NWM_TV_CmdAlive : 9|1@1+ (1,0) [0|1] ""  Booster_AMP,DSP_SKODA,Gateway_PQ35,Gateway_PQ46,GSM_Pager,Kompassmodul,MDI,Radio_2DIN,Radio_Modul,Radio_SKODA,Rearview,RNS_300_NF,RNS_MFD2,RNS_midline,SDARS_Tuner,Sprachbedienung,Standheizung,Tastatur,Telematik_Basis,TV_hybrid,UHV_High,UHV_low,UHV_NAR,UHV_Premium,UHV_UMTS
 SG_ NWM_TV_CmdLimpHome : 10|1@1+ (1,0) [0|1] ""  Booster_AMP,DSP_SKODA,Gateway_PQ35,Gateway_PQ46,GSM_Pager,Kompassmodul,MDI,Radio_2DIN,Radio_Modul,Radio_SKODA,Rearview,RNS_300_NF,RNS_MFD2,RNS_midline,SDARS_Tuner,Sprachbedienung,Standheizung,Tastatur,Telematik_Basis,TV_hybrid,UHV_High,UHV_low,UHV_NAR,UHV_Premium,UHV_UMTS
 SG_ NWM_TV_SleepInd : 12|1@1+ (1,0) [0|1] ""  Booster_AMP,DSP_SKODA,Gateway_PQ35,Gateway_PQ46,GSM_Pager,Kompassmodul,MDI,Radio_2DIN,Radio_Modul,Radio_SKODA,Rearview,RNS_300_NF,RNS_MFD2,RNS_midline,SDARS_Tuner,Sprachbedienung,Standheizung,Tastatur,Telematik_Basis,TV_hybrid,UHV_High,UHV_low,UHV_NAR,UHV_Premium,UHV_UMTS
 SG_ NWM_TV_SleepAck : 13|1@1+ (1,0) [0|1] ""  Booster_AMP,DSP_SKODA,Gateway_PQ35,Gateway_PQ46,GSM_Pager,Kompassmodul,MDI,Radio_2DIN,Radio_Modul,Radio_SKODA,Rearview,RNS_300_NF,RNS_MFD2,RNS_midline,SDARS_Tuner,Sprachbedienung,Standheizung,Tastatur,Telematik_Basis,TV_hybrid,UHV_High,UHV_low,UHV_NAR,UHV_Premium,UHV_UMTS
 SG_ NWM_TV_Per_WakeUp : 16|5@1+ (1,0) [0|31] "" Vector__XXX
 SG_ NWM_TV_Fkt_WakeUp : 21|3@1+ (1,0) [0|7] "" Vector__XXX
 SG_ NWM_TV_Klemme_15 : 24|1@1+ (1,0) [0|1] "" Vector__XXX
 SG_ NWM_TV_Diagnose : 25|1@1+ (1,0) [0|1] "" Vector__XXX
 SG_ NWM_TV_MindestAktivZeit : 26|1@1+ (1,0) [0|1] "" Vector__XXX
 SG_ NWM_TV_Ursache_4 : 27|1@1+ (1,0) [0|1] "" Vector__XXX
 SG_ NWM_TV_Ursache_5 : 28|1@1+ (1,0) [0|1] "" Vector__XXX
 SG_ NWM_TV_Ursache_6 : 29|1@1+ (1,0) [0|1] "" Vector__XXX
 SG_ NWM_TV_Ursache_7 : 30|1@1+ (1,0) [0|1] "" Vector__XXX
 SG_ NWM_TV_Ursache_8 : 31|1@1+ (1,0) [0|1] "" Vector__XXX
 SG_ NWM_TV_Nachlauf_1 : 32|1@1+ (1,0) [0|1] "" Vector__XXX
 SG_ NWM_TV_Nachlauf_2 : 33|1@1+ (1,0) [0|1] "" Vector__XXX
 SG_ NWM_TV_Nachlauf_3 : 34|1@1+ (1,0) [0|1] "" Vector__XXX
 SG_ NWM_TV_Nachlauf_4 : 35|1@1+ (1,0) [0|1] "" Vector__XXX
 SG_ NWM_TV_Nachlauf_5 : 36|1@1+ (1,0) [0|1] "" Vector__XXX
 SG_ NWM_TV_Nachlauf_6 : 37|1@1+ (1,0) [0|1] "" Vector__XXX
 SG_ NWM_TV_Nachlauf_7 : 38|1@1+ (1,0) [0|1] "" Vector__XXX
 SG_ NWM_TV_Nachlauf_8 : 39|1@1+ (1,0) [0|1] "" Vector__XXX
 SG_ NWM_TV_TimeOut_Fehler : 41|1@1+ (1,0) [0|1] "" Vector__XXX
 SG_ NWM_TV_CAN_Diag_deaktiv : 42|1@1+ (1,0) [0|1] "" Vector__XXX
 SG_ NWM_TV_KompSchutz : 43|1@1+ (1,0) [0|1] "" Vector__XXX
 SG_ NWM_TV_Mute_Mode : 44|1@1+ (1,0) [0|1] "" Vector__XXX
 SG_ NWM_TV_Transport_Mode : 45|1@1+ (1,0) [0|1] "" Vector__XXX
 SG_ NWM_TV_Abschaltst_aktiv : 46|1@1+ (1,0) [0|1] "" Vector__XXX
 SG_ NWM_TV_Eindraht_Fehler : 47|1@1+ (1,0) [0|1] "" Vector__XXX
 SG_ NWM_TV_Anf_1 : 48|1@1+ (1,0) [0|1] "" Vector__XXX
 SG_ NWM_TV_Anf_2 : 49|1@1+ (1,0) [0|1] "" Vector__XXX
 SG_ NWM_TV_Anf_3 : 50|1@1+ (1,0) [0|1] "" Vector__XXX
 SG_ NWM_TV_Anf_4 : 51|1@1+ (1,0) [0|1] "" Vector__XXX
 SG_ NWM_TV_Anf_5 : 52|1@1+ (1,0) [0|1] "" Vector__XXX
 SG_ NWM_TV_Anf_6 : 53|1@1+ (1,0) [0|1] "" Vector__XXX
 SG_ NWM_TV_Anf_7 : 54|1@1+ (1,0) [0|1] "" Vector__XXX
 SG_ NWM_TV_Anf_8 : 55|1@1+ (1,0) [0|1] "" Vector__XXX
 SG_ NWM_TV_Anf_9 : 56|1@1+ (1,0) [0|1] "" Vector__XXX
 SG_ NWM_TV_Anf_10 : 57|1@1+ (1,0) [0|1] "" Vector__XXX
 SG_ NWM_TV_Anf_11 : 58|1@1+ (1,0) [0|1] "" Vector__XXX
 SG_ NWM_TV_Anf_12 : 59|1@1+ (1,0) [0|1] "" Vector__XXX
 SG_ NWM_TV_Anf_13 : 60|1@1+ (1,0) [0|1] "" Vector__XXX
 SG_ NWM_TV_Anf_14 : 61|1@1+ (1,0) [0|1] "" Vector__XXX
 SG_ NWM_TV_Anf_15 : 62|1@1+ (1,0) [0|1] "" Vector__XXX
 SG_ NWM_TV_Anf_16 : 63|1@1+ (1,0) [0|1] "" Vector__XXX

BO_ 1175 Parkhilfe_01: 8 Gateway_PQ35
 SG_ PH_Abschaltursache : 13|3@1+ (1,0) [0|7] ""  Rearview
 SG_ PH_Opt_Anzeige_V_ein : 16|1@1+ (1,0) [0|1] ""  Rearview
 SG_ PH_Opt_Anzeige_H_ein : 17|1@1+ (1,0) [0|1] ""  Rearview
 SG_ PH_Opt_Anz_V_Hindernis : 18|1@1+ (1,0) [0|1] "" Vector__XXX
 SG_ PH_Opt_Anz_H_Hindernis : 19|1@1+ (1,0) [0|1] "" Vector__XXX
 SG_ PH_Tongeber_V_aktiv : 20|1@1+ (1,0) [0|1] "" Vector__XXX
 SG_ PH_Tongeber_H_aktiv : 21|1@1+ (1,0) [0|1] "" Vector__XXX
 SG_ PH_Tongeber_mute : 22|1@1+ (1,0) [0|1] "" Vector__XXX
 SG_ PH_Anf_Audioabsenkung : 23|1@1+ (1,0) [0|1] ""  Radio_Modul,RNS_300_NF,RNS_midline
 SG_ PH_Frequenz_hinten : 32|4@1+ (1,0) [0|15] "" Vector__XXX
 SG_ PH_Lautstaerke_hinten : 36|4@1+ (1,0) [0|15] "" Vector__XXX
 SG_ PH_Frequenz_vorn : 40|4@1+ (1,0) [0|15] "" Vector__XXX
 SG_ PH_Lautstaerke_vorn : 44|4@1+ (1,0) [0|15] "" Vector__XXX
 SG_ PH_Trigger_Bildaufschaltung : 48|1@1+ (1,0) [0|1] "" Vector__XXX
 SG_ PH_StartStopp_Info : 49|2@1+ (1,0) [0|3] "" Vector__XXX
 SG_ PH_Aufbauten_erk : 51|1@1+ (1,0) [0|1] "" Vector__XXX
 SG_ PH_BerErk_vorn : 52|2@1+ (1,0) [0|3] "" Vector__XXX
 SG_ PH_BerErk_hinten : 54|2@1+ (1,0) [0|3] "" Vector__XXX
 SG_ PH_defekt : 56|1@1+ (1,0) [0|1] "" Vector__XXX
 SG_ PH_gestoert : 57|1@1+ (1,0) [0|1] "" Vector__XXX
 SG_ PH_Systemzustand : 58|3@1+ (1,0) [0|7] ""  Radio_Modul,Rearview,RNS_midline
 SG_ PH_Display_Kundenwunsch : 61|2@1+ (1,0) [0|3] "" Vector__XXX
 SG_ PH_KD_Fehler : 63|1@1+ (1,0) [0|1] "" Vector__XXX

BO_ 929 PSD_01: 8 RNS_midline
 SG_ PSD_Pos_Segment_ID : 0|6@1+ (1,0) [2|63] ""  Gateway_PQ35
 SG_ PSD_Pos_Segmentlaenge : 6|7@1+ (2,0) [0|254] "Unit_Meter"  Gateway_PQ35
 SG_ PSD_Pos_Inhibitzeit : 13|5@1+ (10,0) [0|310] "Unit_MilliSecon"  Gateway_PQ35
 SG_ PSD_Pos_Standort : 18|1@1+ (1,0) [0|1] ""  Gateway_PQ35
 SG_ PSD_Pos_Laengsfehler : 19|3@1+ (1,0) [0|7] ""  Gateway_PQ35
 SG_ PSD_Segment_ID : 22|6@1+ (1,0) [2|63] ""  Gateway_PQ35
 SG_ PSD_Vorgaenger_Segment_ID : 28|6@1+ (1,0) [2|63] ""  Gateway_PQ35
 SG_ PSD_Strassenklasse : 34|2@1+ (1,0) [0|3] ""  Gateway_PQ35
 SG_ PSD_Segmentlaenge : 36|7@1+ (2,0) [0|254] "Unit_Meter"  Gateway_PQ35
 SG_ PSD_Rampe : 43|2@1+ (1,0) [0|3] ""  Gateway_PQ35
 SG_ PSD_Endkruemmung : 45|8@1+ (1,0) [0|254] "Unit_None"  Gateway_PQ35
 SG_ PSD_Endkruemmung_Vorz : 53|1@1+ (1,0) [0|1] ""  Gateway_PQ35
 SG_ PSD_Endsteigung : 54|5@1+ (0.5,0) [0|14.5] "Unit_PerCent"  Gateway_PQ35
 SG_ PSD_Endsteigung_Vorz : 59|1@1+ (1,0) [0|1] ""  Gateway_PQ35
 SG_ PSD_ADAS_Qualitaet : 60|1@1+ (1,0) [0|1] ""  Gateway_PQ35
 SG_ PSD_Fahrspuren : 61|2@1+ (1,0) [0|3] ""  Gateway_PQ35
 SG_ PSD_wahrscheinlichster_Pfad : 63|1@1+ (1,0) [0|1] ""  Gateway_PQ35

BO_ 930 PSD_02: 8 RNS_midline
 SG_ PSD_Multiplex M : 0|2@1+ (1,0) [0|3] ""  Gateway_PQ35
 SG_ PSD_Sys_Segment_ID m0 : 2|6@1+ (1,0) [2|63] ""  Gateway_PQ35
 SG_ PSD_Abz_Segment_ID m1 : 2|6@1+ (1,0) [2|63] ""  Gateway_PQ35
 SG_ PSD_Ges_Segment_ID m2 : 2|6@1+ (1,0) [2|63] ""  Gateway_PQ35
 SG_ PSD_Ort_Laenge_VZ m3 : 2|1@1+ (1,0) [0|1] ""  Gateway_PQ35
 SG_ PSD_Ort_Laenge m3 : 3|25@1+ (1E-005,0) [0|180] "Unit_DegreOfArc"  Gateway_PQ35
 SG_ PSD_Sys_Laendercode m0 : 8|8@1+ (1,0) [0|255] ""  Gateway_PQ35
 SG_ PSD_Abz_Segmentlaenge m1 : 8|7@1+ (2,0) [0|254] "Unit_Meter"  Gateway_PQ35
 SG_ PSD_Ges_Geschwindigkeit m2 : 8|5@1+ (1,0) [0|31] ""  Gateway_PQ35
 SG_ PSD_Ges_Geschwindigkeit_Typ m2 : 13|1@1+ (1,0) [0|1] ""  Gateway_PQ35
 SG_ PSD_Ges_Geschwindigkeit_Gespann m2 : 14|2@1+ (1,0) [0|3] ""  Gateway_PQ35
 SG_ PSD_Abz_Vorgaenger_Segment_ID m1 : 15|6@1+ (1,0) [2|63] ""  Gateway_PQ35
 SG_ PSD_Sys_Geschwindigkeit_Einheit m0 : 16|1@1+ (1,0) [0|1] ""  Gateway_PQ35
 SG_ PSD_Ges_Geschwindigkeit_Witter m2 : 16|2@1+ (1,0) [0|3] ""  Gateway_PQ35
 SG_ PSD_Sys_Verkehrsrichtung m0 : 17|1@1+ (1,0) [0|1] ""  Gateway_PQ35
 SG_ PSD_Sys_Release_Monat m0 : 18|4@1+ (1,0) [0|12] "Unit_Month"  Gateway_PQ35
 SG_ PSD_Ges_Geschwindigkeit_Tag_Anf m2 : 18|3@1+ (1,0) [0|7] ""  Gateway_PQ35
 SG_ PSD_Abz_Geschwindigkeit m1 : 21|5@1+ (1,0) [0|31] ""  Gateway_PQ35
 SG_ PSD_Ges_Geschwindigkeit_Tag_Ende m2 : 21|3@1+ (1,0) [0|7] ""  Gateway_PQ35
 SG_ PSD_Sys_Release_Jahr m0 : 22|5@1+ (1,2000) [2000|2031] "Unit_Year"  Gateway_PQ35
 SG_ PSD_Ges_Geschwindigkeit_Std_Anf m2 : 24|5@1+ (1,0) [0|24] "Unit_Hours"  Gateway_PQ35
 SG_ PSD_Abz_Geschwindigkeit_Typ m1 : 26|1@1+ (1,0) [0|1] ""  Gateway_PQ35
 SG_ PSD_Sys_Tunnel m0 : 27|1@1+ (1,0) [0|1] ""  Gateway_PQ35
 SG_ PSD_Abz_Strassenklasse m1 : 27|2@1+ (1,0) [0|3] ""  Gateway_PQ35
 SG_ PSD_Sys_Bruecke m0 : 28|1@1+ (1,0) [0|1] ""  Gateway_PQ35
 SG_ PSD_Ort_Breite_VZ m3 : 28|1@1+ (1,0) [0|1] ""  Gateway_PQ35
 SG_ PSD_Sys_Fahrsp_Gegenr m0 : 29|2@1+ (1,0) [0|3] ""  Gateway_PQ35
 SG_ PSD_Abz_ADAS_Qualitaet m1 : 29|1@1+ (1,0) [0|1] ""  Gateway_PQ35
 SG_ PSD_Ges_Geschwindigkeit_Std_Ende m2 : 29|5@1+ (1,0) [0|24] "Unit_Hours"  Gateway_PQ35
 SG_ PSD_Ort_Breite m3 : 29|24@1+ (1E-005,0) [0|90] "Unit_DegreOfArc"  Gateway_PQ35
 SG_ PSD_Abz_Abzweigerichtung m1 : 30|1@1+ (1,0) [0|1] ""  Gateway_PQ35
 SG_ PSD_Sys_TMC_Baustelle m0 : 31|1@1+ (1,0) [0|1] ""  Gateway_PQ35
 SG_ PSD_Abz_Abzweigewinkel m1 : 31|4@1+ (1,0) [0|15] ""  Gateway_PQ35
 SG_ PSD_Sys_TMC_Stau m0 : 32|1@1+ (1,0) [0|1] ""  Gateway_PQ35
 SG_ PSD_Ges_alter_Geschw m2 : 34|5@1+ (1,0) [0|31] ""  Gateway_PQ35
 SG_ PSD_Abz_Rampe m1 : 35|2@1+ (1,0) [0|3] ""  Gateway_PQ35
 SG_ PSD_Abz_Anfangskruemmung m1 : 37|8@1+ (1,0) [0|254] "Unit_None"  Gateway_PQ35
 SG_ PSD_Ges_alter_Geschw_Gespann m2 : 39|2@1+ (1,0) [0|3] ""  Gateway_PQ35
 SG_ PSD_Ges_alter_Geschw_Witter m2 : 41|2@1+ (1,0) [0|3] ""  Gateway_PQ35
 SG_ PSD_Ges_alter_Geschw_Tag_Anf m2 : 43|3@1+ (1,0) [0|7] ""  Gateway_PQ35
 SG_ PSD_Abz_Anfangskruemmung_Vorz m1 : 45|1@1+ (1,0) [0|1] ""  Gateway_PQ35
 SG_ PSD_Sys_Anfangskruemmung m0 : 46|8@1+ (1,0) [0|254] "Unit_None"  Gateway_PQ35
 SG_ PSD_Abz_Endkruemmung m1 : 46|8@1+ (1,0) [0|254] "Unit_None"  Gateway_PQ35
 SG_ PSD_Ges_alter_Geschw_Tag_Ende m2 : 46|3@1+ (1,0) [0|7] ""  Gateway_PQ35
 SG_ PSD_Ges_alter_Geschw_Std_Anf m2 : 49|5@1+ (1,0) [0|24] "Unit_Hours"  Gateway_PQ35
 SG_ PSD_Ort_Hoehe m3 : 53|11@1+ (5,-1000) [-1000|8000] "Unit_Meter"  Gateway_PQ35
 SG_ PSD_Sys_Anfangskruemmung_Vorz m0 : 54|1@1+ (1,0) [0|1] ""  Gateway_PQ35
 SG_ PSD_Abz_Endkruemmung_Vorz m1 : 54|1@1+ (1,0) [0|1] ""  Gateway_PQ35
 SG_ PSD_Ges_alter_Geschw_Std_Ende m2 : 54|5@1+ (1,0) [0|24] "Unit_Hours"  Gateway_PQ35
 SG_ PSD_Sys_Anfangssteigung m0 : 55|5@1+ (0.5,0) [0|14.5] "Unit_PerCent"  Gateway_PQ35
 SG_ PSD_Abz_Endsteigung m1 : 55|5@1+ (0.5,0) [0|14.5] "Unit_PerCent"  Gateway_PQ35
 SG_ PSD_Ges_Ueberholverbot m2 : 59|2@1+ (1,0) [0|3] ""  Gateway_PQ35
 SG_ PSD_Sys_Anfangssteigung_Vorz m0 : 60|1@1+ (1,0) [0|1] ""  Gateway_PQ35
 SG_ PSD_Abz_Endsteigung_Vorz m1 : 60|1@1+ (1,0) [0|1] ""  Gateway_PQ35
 SG_ PSD_Sys_Ortschaft m0 : 61|1@1+ (1,0) [0|1] ""  Gateway_PQ35
 SG_ PSD_Abz_Fahrspuren m1 : 61|2@1+ (1,0) [0|3] ""  Gateway_PQ35
 SG_ PSD_Ges_Wechselverkehrszeichen m2 : 61|3@1+ (1,0) [0|7] ""  Gateway_PQ35
 SG_ PSD_Sys_Digitalisierung m0 : 62|1@1+ (1,0) [0|1] ""  Gateway_PQ35
 SG_ PSD_Sys_Zielfuehrung m0 : 63|1@1+ (1,0) [0|1] ""  Gateway_PQ35
 SG_ PSD_Abz_wahrscheinlichster_Pfad m1 : 63|1@1+ (1,0) [0|1] ""  Gateway_PQ35

BO_TX_BU_ 657 : Gateway_PQ35,Gateway_PQ46;
BO_TX_BU_ 1075 : Booster_AMP,DSP_SKODA;
BO_TX_BU_ 1081 : Radio_2DIN,Radio_Modul,Radio_SKODA;
BO_TX_BU_ 1078 : RNS_300_NF,RNS_MFD2,RNS_midline;
BO_TX_BU_ 1082 : UHV_High,UHV_low,UHV_NAR,UHV_Premium,UHV_UMTS;
BO_TX_BU_ 1175 : Gateway_PQ35,Gateway_PQ46;
CM_ SG_ 657 ZK1_Funkschl_Nr "000 = nicht definiert bzw kein aktueller Funkempfang
xxx = Schluessel-Nr.
Nummer des Funkschluessels";
CM_ SG_ 657 ZK1_433_MHz "1 = 433 MHZ
0 = 315 MHz
433 - MHz-System";
CM_ SG_ 657 ZK1_Taste_HDF "1 = HDF-Taste der FFB betätigt
Taste HD-Fernentriegelung betaetigt";
CM_ SG_ 657 ZK1_Taste_Panik "Panik-Taste betaetigt";
CM_ SG_ 657 ZK1_Taste_Auf "1 = Funkschluessel Taste 'Auf' gedrueckt
0 = Taste nicht betaetigt";
CM_ SG_ 657 ZK1_Taste_Zu "Taste ZV_zu betaetigt";
CM_ SG_ 657 ZK1_FT_verriegeln "Fahrertuer verriegeln";
CM_ SG_ 657 ZK1_FT_entriegeln "Fahrertuer entriegeln";
CM_ SG_ 657 ZK1_BT_verriegeln "Beifahrertuer verriegeln";
CM_ SG_ 657 ZK1_BT_entriegeln "Beifahrertuer entriegeln";
CM_ SG_ 657 ZK1_HL_verriegeln "Tuer hinten links verriegeln";
CM_ SG_ 657 ZK1_HL_entriegeln "Tuer hinten links entriegeln";
CM_ SG_ 657 ZK1_HR_verriegeln "Tuer hinten rechts verriegeln";
CM_ SG_ 657 ZK1_HR_entriegeln "Tuer hinten rechts entriegeln";
CM_ SG_ 657 ZK1_Zent_safen "Zentral safen";
CM_ SG_ 657 ZK1_Zent_entsafen "Zentral entsafen";
CM_ SG_ 657 ZK1_HD_verriegeln "Heckdeckel verriegeln";
CM_ SG_ 657 ZK1_HD_entriegeln "1 = Heckschloss wird vom BCM oder KSG zum entriegeln bestromt (Rueckmeldung)";
CM_ SG_ 657 ZK1_HD_oeffnen "1 = Heckdeckel oeffnen";
CM_ SG_ 657 ZK1_HD_schliessen "Heckdeckel schliessen";
CM_ SG_ 657 ZK1_LED_Steuerung "Anst. der LED in den Tueren
1 = LED an
0 = LED aus
BAF gilt nicht fuer dieses Bit";
CM_ SG_ 657 ZK1_LED_Uebernahme "Uebernahme LED-Steuerung durch TSG_FT
1 = TSG uebernimmt LED Strg.";
CM_ SG_ 657 ZK1_Dongle_Nr "000 = nicht definiert bzw kein aktueller Funkempfang
xxx = Schluessel-Nr.
Nummer des Funkdongles Verdecksteuerung";
CM_ SG_ 657 ZK1_Dongle_Freq "00 = 315 MHz
01 = 433 MHz
Frequenz des Funkdongles Verdecksteuerung";
CM_ SG_ 657 ZK1_Verdeck_auf "1 = Verdeck oeffnen";
CM_ SG_ 657 ZK1_Verdeck_zu "1 = Verdeck schliessen";
CM_ SG_ 657 ZK1_LeaveHome_aktiv "1 = Leaving Home aktiv";
CM_ SG_ 657 ZK1_HL_Tuer_offen "1 = Tuer geoeffnet
0 = Tuer geschlossen
Signal nur für hintere FH-SG zur Erfuellung von USA-Einklemmschutzgesetz
Tuer HL offen, schneller Drehfallen-Kontakt";
CM_ SG_ 657 ZK1_HR_Tuer_offen "1 = Tuer geoeffnet
0 = Tuer geschlossen
Signal nur für hintere FH-SG zur Erfuellung von USA-Einklemmschutzgesetz
Tuer HR offen, schneller Drehfallen-Kontakt";
CM_ SG_ 657 ZK1_SL_Anf "Anforderung zum Öffnen / Schliessen der Schiebetür Links mit der FFB-Taste SL";
CM_ SG_ 657 ZK1_SR_Anf "Anforderung zum Öffnen / Schliessen der Schiebetür Rechts mit der FFB-Taste SR";
CM_ SG_ 1075 NWM_DSP_Receiver "SG Adresse";
CM_ SG_ 1075 NWM_DSP_CmdRing "Ring Message";
CM_ SG_ 1075 NWM_DSP_CmdAlive "Alive Message";
CM_ SG_ 1075 NWM_DSP_CmdLimpHome "Limp Home Message";
CM_ SG_ 1075 NWM_DSP_SleepInd "Bussleep Indication";
CM_ SG_ 1075 NWM_DSP_SleepAck "Bussleep Acknowledge";
CM_ SG_ 1075 NWM_DSP_Per_WakeUp "Weckursache Peripherie
0 = wenn Funktionswakeup
1 = CAN
2 = P-WakeUp, Ursache nicht bekannt";
CM_ SG_ 1075 NWM_DSP_Fkt_WakeUp "Weckursache Funktion
0 = wenn Peripheriewakeup";
CM_ SG_ 1075 NWM_DSP_Klemme_15 "Nachlaufursache, kein Sleep Ind gesetzt
1 = Klemme 15 ein";
CM_ SG_ 1075 NWM_DSP_Diagnose "Nachlaufursache, kein Sleep Ind gesetzt
1 = Diagnose bei Kl 15 aus";
CM_ SG_ 1075 NWM_DSP_MindestAktivZeit "Nachlaufursache, kein Sleep Ind gesetzt
1 = Mindestaktivzeit Taktiv_min
OSEK-NM: Mindestaktivzeit";
CM_ SG_ 1075 NWM_DSP_Ursache_4 "Nachlaufursache, kein Sleep Ind gesetzt
1 = Nachlaufursache 4";
CM_ SG_ 1075 NWM_DSP_Ursache_5 "Nachlaufursache, kein Sleep Ind gesetzt
1 = Nachlaufursache 5";
CM_ SG_ 1075 NWM_DSP_Ursache_6 "Nachlaufursache, kein Sleep Ind gesetzt
1 = Nachlaufursache 6";
CM_ SG_ 1075 NWM_DSP_Ursache_7 "Nachlaufursache, kein Sleep Ind gesetzt
1 = Nachlaufursache 7";
CM_ SG_ 1075 NWM_DSP_Ursache_8 "Nachlaufursache, kein Sleep Ind gesetzt
1 = Nachlaufursache 8";
CM_ SG_ 1075 NWM_DSP_Nachlauf_1 "1 = interner Nachlauf vor Wakeup 1";
CM_ SG_ 1075 NWM_DSP_Nachlauf_2 "1 = interner Nachlauf vor Wakeup 2";
CM_ SG_ 1075 NWM_DSP_Nachlauf_3 "1 = interner Nachlauf vor Wakeup 3";
CM_ SG_ 1075 NWM_DSP_Nachlauf_4 "1 = interner Nachlauf vor Wakeup 4";
CM_ SG_ 1075 NWM_DSP_Nachlauf_5 "1 = interner Nachlauf vor Wakeup 5";
CM_ SG_ 1075 NWM_DSP_Nachlauf_6 "1 = interner Nachlauf vor Wakeup 6";
CM_ SG_ 1075 NWM_DSP_Nachlauf_7 "1 = interner Nachlauf vor Wakeup 7";
CM_ SG_ 1075 NWM_DSP_Nachlauf_8 "1 = interner Nachlauf vor Wakeup 8";
CM_ SG_ 1075 NWM_DSP_TimeOut_Fehler "1 = Aktiver Timeout Fehlerspeichereintrag";
CM_ SG_ 1075 NWM_DSP_CAN_Diag_deaktiv "1 = Keine CAN Bus bezogene Eigendiagnose";
CM_ SG_ 1075 NWM_DSP_KompSchutz "1 = Funktionseinschränkung aufgrund Komponentenschutz aktiv";
CM_ SG_ 1075 NWM_DSP_Mute_Mode "1 = Funktionseinschränkung aufgrund Mute Mode aktiv, nur VW";
CM_ SG_ 1075 NWM_DSP_Transport_Mode "1 = Funktionseinschränkung aufgrund Transport Mode aktiv";
CM_ SG_ 1075 NWM_DSP_Abschaltst_aktiv "1 = Funktionsabschaltung wegen Abschaltschaltstufe";
CM_ SG_ 1075 NWM_DSP_Eindraht_Fehler "1 = Eindrahtbetrieb erkannt";
CM_ SG_ 1075 NWM_DSP_Anf_1 "für künftige Anforderungen";
CM_ SG_ 1075 NWM_DSP_Anf_9 "für künftige Anforderungen 2";
CM_ SG_ 1077 NWM_MDI_Receiver "SG Adresse";
CM_ SG_ 1077 NWM_MDI_CmdRing "Ring Message";
CM_ SG_ 1077 NWM_MDI_CmdAlive "Alive Message";
CM_ SG_ 1077 NWM_MDI_CmdLimpHome "Limp Home Message";
CM_ SG_ 1077 NWM_MDI_SleepInd "Bussleep Indication";
CM_ SG_ 1077 NWM_MDI_SleepAck "Bussleep Acknowledge";
CM_ SG_ 1077 NWM_MDI_Per_WakeUp "Weckursache Peripherie
0 = wenn Funktionswakeup
1 = CAN
2 = P-WakeUp, Ursache nicht bekannt";
CM_ SG_ 1077 NWM_MDI_Fkt_WakeUp "Weckursache Funktion
0 = wenn Peripheriewakeup";
CM_ SG_ 1077 NWM_MDI_Klemme_15 "Nachlaufursache, kein Sleep Ind gesetzt
1 = Klemme 15 ein";
CM_ SG_ 1077 NWM_MDI_Diagnose "Nachlaufursache, kein Sleep Ind gesetzt
1 = Diagnose bei Kl 15 aus";
CM_ SG_ 1077 NWM_MDI_MindestAktivZeit "Nachlaufursache, kein Sleep Ind gesetzt
1 = Mindestaktivzeit Taktiv_min
OSEK-NM: Mindestaktivzeit";
CM_ SG_ 1077 NWM_MDI_Ursache_4 "Nachlaufursache, kein Sleep Ind gesetzt
1 = Nachlaufursache 4";
CM_ SG_ 1077 NWM_MDI_Ursache_5 "Nachlaufursache, kein Sleep Ind gesetzt
1 = Nachlaufursache 5";
CM_ SG_ 1077 NWM_MDI_Ursache_6 "Nachlaufursache, kein Sleep Ind gesetzt
1 = Nachlaufursache 6";
CM_ SG_ 1077 NWM_MDI_Ursache_7 "Nachlaufursache, kein Sleep Ind gesetzt
1 = Nachlaufursache 7";
CM_ SG_ 1077 NWM_MDI_Ursache_8 "Nachlaufursache, kein Sleep Ind gesetzt
1 = Nachlaufursache 8";
CM_ SG_ 1077 NWM_MDI_Nachlauf_1 "1 = interner Nachlauf vor Wakeup 1";
CM_ SG_ 1077 NWM_MDI_Nachlauf_2 "1 = interner Nachlauf vor Wakeup 2";
CM_ SG_ 1077 NWM_MDI_Nachlauf_3 "1 = interner Nachlauf vor Wakeup 3";
CM_ SG_ 1077 NWM_MDI_Nachlauf_4 "1 = interner Nachlauf vor Wakeup 4";
CM_ SG_ 1077 NWM_MDI_Nachlauf_5 "1 = interner Nachlauf vor Wakeup 5";
CM_ SG_ 1077 NWM_MDI_Nachlauf_6 "1 = interner Nachlauf vor Wakeup 6";
CM_ SG_ 1077 NWM_MDI_Nachlauf_7 "1 = interner Nachlauf vor Wakeup 7";
CM_ SG_ 1077 NWM_MDI_Nachlauf_8 "1 = interner Nachlauf vor Wakeup 8";
CM_ SG_ 1077 NWM_MDI_TimeOut_Fehler "1 = Aktiver Timeout Fehlerspeichereintrag";
CM_ SG_ 1077 NWM_MDI_CAN_Diag_deaktiv "1 = Keine CAN Bus bezogene Eigendiagnose";
CM_ SG_ 1077 NWM_MDI_KompSchutz "1 = Funktionseinschränkung aufgrund Komponentenschutz aktiv";
CM_ SG_ 1077 NWM_MDI_Mute_Mode "1 = Funktionseinschränkung aufgrund Mute Mode aktiv, nur VW";
CM_ SG_ 1077 NWM_MDI_Transport_Mode "1 = Funktionseinschränkung aufgrund Transport Mode aktiv";
CM_ SG_ 1077 NWM_MDI_Abschaltst_aktiv "1 = Funktionsabschaltung wegen Abschaltschaltstufe";
CM_ SG_ 1077 NWM_MDI_Eindraht_Fehler "1 = Eindrahtbetrieb erkannt";
CM_ SG_ 1077 NWM_MDI_Anf_1 "für künftige Anforderungen";
CM_ SG_ 1077 NWM_MDI_Anf_9 "für künftige Anforderungen 2";
CM_ SG_ 1081 NWM_Radio_Receiver "SG Adresse";
CM_ SG_ 1081 NWM_Radio_CmdRing "Ring Message";
CM_ SG_ 1081 NWM_Radio_CmdAlive "Alive Message";
CM_ SG_ 1081 NWM_Radio_CmdLimpHome "Limp Home Message";
CM_ SG_ 1081 NWM_Radio_SleepInd "Bussleep Indication";
CM_ SG_ 1081 NWM_Radio_SleepAck "Bussleep Acknowledge";
CM_ SG_ 1081 NWM_Radio_Per_WakeUp "Weckursache Peripherie
0 = wenn Funktionswakeup
1 = CAN
2 = P-WakeUp, Ursache nicht bekannt
3 = Radio wird eingeschaltet
4 = Radio wird ausgeschaltet
5 = Klemme 15 Hardware, falls vorhanden
30 = Klemme 30 Reset";
CM_ SG_ 1081 NWM_Radio_Fkt_WakeUp "Weckursache Funktion
0 = wenn Peripheriewakeup
1 = Dimmungsnachlauf (bei Blaupunkt auch für Telefon ohne BAP)
2 = 'Communication Request' by any application (Verwendung von präzisen Weckursachen sind diesem Wert vorzuziehen)
3 = Wecken durch S-Kontakt";
CM_ SG_ 1081 NWM_Radio_Klemme_15 "Nachlaufursache, kein Sleep Ind gesetzt
1 = Klemme 15 ein";
CM_ SG_ 1081 NWM_Radio_Diagnose "Nachlaufursache, kein Sleep Ind gesetzt
1 = Diagnose bei Kl 15 aus";
CM_ SG_ 1081 NWM_Radio_MindestAktivZeit "Nachlaufursache, kein Sleep Ind gesetzt
1 = Mindestaktivzeit Taktiv_min
OSEK-NM: Mindestaktivzeit";
CM_ SG_ 1081 NWM_Radio_Ursache_4 "Nachlaufursache, kein Sleep Ind gesetzt
1 = Radio On und BAP-Kommunikation aktiv (z.B. mit MDI)";
CM_ SG_ 1081 NWM_Radio_Ursache_5 "Nachlaufursache, kein Sleep Ind gesetzt
1 = Mindestens ein 'Communication Request' der Applikation";
CM_ SG_ 1081 NWM_Radio_Ursache_6 "Nachlaufursache, kein Sleep Ind gesetzt
1 = Theft Protection (10 Sek für Radio-Komfort-Codierung)";
CM_ SG_ 1081 NWM_Radio_Ursache_7 "Nachlaufursache, kein Sleep Ind gesetzt
1 = Nachlaufursache 7";
CM_ SG_ 1081 NWM_Radio_Ursache_8 "Nachlaufursache, kein Sleep Ind gesetzt
1 = Nachlaufursache 8";
CM_ SG_ 1081 NWM_Radio_Nachlauf_1 "1 = deep sleep
interner Nachlauf vor Wakeup 1";
CM_ SG_ 1081 NWM_Radio_Nachlauf_2 "Nachlaufursache, kein Sleep Ind gesetzt
1 = Dimmungsnachlauf (bei Blaupunkt auch für Telefon ohne BAP)
interner Nachlauf vor Wakeup 2";
CM_ SG_ 1081 NWM_Radio_Nachlauf_3 "1 = Radio ist eingeschaltet (Stundennachlauf)
interner Nachlauf vor Wakeup 3";
CM_ SG_ 1081 NWM_Radio_Nachlauf_4 "1 = Tuner ist aktiv
interner Nachlauf vor Wakeup 4";
CM_ SG_ 1081 NWM_Radio_Nachlauf_5 "1 = interner Nachlauf vor Wakeup 5";
CM_ SG_ 1081 NWM_Radio_Nachlauf_6 "1 = interner Nachlauf vor Wakeup 6";
CM_ SG_ 1081 NWM_Radio_Nachlauf_7 "1 = interner Nachlauf vor Wakeup 7";
CM_ SG_ 1081 NWM_Radio_Nachlauf_8 "1 = Neustart nach Flash Update
interner Nachlauf vor Wakeup 8";
CM_ SG_ 1081 NWM_Radio_TimeOut_Fehler "1 = Aktiver Timeout Fehlerspeichereintrag";
CM_ SG_ 1081 NWM_Radio_CAN_Diag_deaktiv "1 = Keine CAN Bus bezogene Eigendiagnose";
CM_ SG_ 1081 NWM_Radio_KompSchutz "1 = Funktionseinschränkung aufgrund Komponentenschutz aktiv";
CM_ SG_ 1081 NWM_Radio_Mute_Mode "1 = Funktionseinschränkung aufgrund Mute Mode aktiv, nur VW";
CM_ SG_ 1081 NWM_Radio_Transport_Mode "1 = Funktionseinschränkung aufgrund Transport Mode aktiv";
CM_ SG_ 1081 NWM_Radio_Abschaltst_aktiv "1 = Funktionsabschaltung wegen Abschaltschaltstufe";
CM_ SG_ 1081 NWM_Radio_Eindraht_Fehler "1 = Eindrahtbetrieb erkannt";
CM_ SG_ 1081 NWM_Radio_Anf_1 "für künftige Anforderungen";
CM_ SG_ 1081 NWM_Radio_Anf_9 "für künftige Anforderungen 2";
CM_ SG_ 1065 NWM_RV_Receiver "SG Adresse";
CM_ SG_ 1065 NWM_RV_CmdRing "Ring Message";
CM_ SG_ 1065 NWM_RV_CmdAlive "Alive Message";
CM_ SG_ 1065 NWM_RV_CmdLimpHome "Limp Home Message";
CM_ SG_ 1065 NWM_RV_SleepInd "Bussleep Indication";
CM_ SG_ 1065 NWM_RV_SleepAck "Bussleep Acknowledge";
CM_ SG_ 1065 NWM_RV_Per_WakeUp "Weckursache Peripherie
0 = wenn Funktionswakeup
1 = CAN
2 = P-WakeUp, Ursache nicht bekannt
4 = Klemme 30 Reset";
CM_ SG_ 1065 NWM_RV_Fkt_WakeUp "Weckursache Funktion
0 = wenn Peripheriewakeup";
CM_ SG_ 1065 NWM_RV_Klemme_15 "Nachlaufursache, kein Sleep Ind gesetzt
1 = Klemme 15 ein";
CM_ SG_ 1065 NWM_RV_Diagnose "Nachlaufursache, kein Sleep Ind gesetzt
1 = Diagnose bei Kl 15 aus";
CM_ SG_ 1065 NWM_RV_MindestAktivZeit "Nachlaufursache, kein Sleep Ind gesetzt
1 = Mindestaktivzeit Taktiv_min
OSEK-NM: Mindestaktivzeit";
CM_ SG_ 1065 NWM_RV_Ursache_4 "Nachlaufursache, kein Sleep Ind gesetzt
1 = Nachlaufursache 4";
CM_ SG_ 1065 NWM_RV_Ursache_5 "Nachlaufursache, kein Sleep Ind gesetzt
1 = Nachlaufursache 5";
CM_ SG_ 1065 NWM_RV_Ursache_6 "Nachlaufursache, kein Sleep Ind gesetzt
1 = Nachlaufursache 6";
CM_ SG_ 1065 NWM_RV_Ursache_7 "Nachlaufursache, kein Sleep Ind gesetzt
1 = Nachlaufursache 7";
CM_ SG_ 1065 NWM_RV_Ursache_8 "Nachlaufursache, kein Sleep Ind gesetzt
1 = Nachlaufursache 8";
CM_ SG_ 1065 NWM_RV_Nachlauf_1 "1 = interner Nachlauf vor Wakeup 1";
CM_ SG_ 1065 NWM_RV_Nachlauf_2 "1 = interner Nachlauf vor Wakeup 2";
CM_ SG_ 1065 NWM_RV_Nachlauf_3 "1 = interner Nachlauf vor Wakeup 3";
CM_ SG_ 1065 NWM_RV_Nachlauf_4 "1 = interner Nachlauf vor Wakeup 4";
CM_ SG_ 1065 NWM_RV_Nachlauf_5 "1 = interner Nachlauf vor Wakeup 5";
CM_ SG_ 1065 NWM_RV_Nachlauf_6 "1 = interner Nachlauf vor Wakeup 6";
CM_ SG_ 1065 NWM_RV_Nachlauf_7 "1 = interner Nachlauf vor Wakeup 7";
CM_ SG_ 1065 NWM_RV_Nachlauf_8 "1 = interner Nachlauf vor Wakeup 8";
CM_ SG_ 1065 NWM_RV_TimeOut_Fehler "1 = Aktiver Timeout Fehlerspeichereintrag";
CM_ SG_ 1065 NWM_RV_CAN_Diag_deaktiv "1 = Keine CAN Bus bezogene Eigendiagnose";
CM_ SG_ 1065 NWM_RV_KompSchutz "1 = Funktionseinschränkung aufgrund Komponentenschutz aktiv";
CM_ SG_ 1065 NWM_RV_Mute_Mode "1 = Funktionseinschränkung aufgrund Mute Mode aktiv, nur VW";
CM_ SG_ 1065 NWM_RV_Transport_Mode "1 = Funktionseinschränkung aufgrund Transport Mode aktiv";
CM_ SG_ 1065 NWM_RV_Abschaltst_aktiv "1 = Funktionsabschaltung wegen Abschaltschaltstufe";
CM_ SG_ 1065 NWM_RV_Eindraht_Fehler "1 = Eindrahtbetrieb erkannt";
CM_ SG_ 1065 NWM_RV_Anf_1 "für künftige Anforderungen";
CM_ SG_ 1065 NWM_RV_Anf_9 "für künftige Anforderungen 2";
CM_ SG_ 1078 NWM_RNS_Receiver "SG Adresse";
CM_ SG_ 1078 NWM_RNS_CmdRing "Ring Message";
CM_ SG_ 1078 NWM_RNS_CmdAlive "Alive Message";
CM_ SG_ 1078 NWM_RNS_CmdLimpHome "Limp Home Message";
CM_ SG_ 1078 NWM_RNS_SleepInd "Bussleep Indication";
CM_ SG_ 1078 NWM_RNS_SleepAck "Bussleep Acknowledge";
CM_ SG_ 1078 NWM_RNS_Per_WakeUp "Weckursache Peripherie
0 = wenn Funktionswakeup
1 = CAN
2 = P-WakeUp, Ursache nicht bekannt
3 = Klemme 15 Hardware, falls vorhanden
4 = Klemme 30 Reset
5 = ON Tipper
6 = Telefon Mute
7 = RTC (Real Time Clock)
8 = CD-Eject
9 = CD-Insert";
CM_ SG_ 1078 NWM_RNS_Fkt_WakeUp "Weckursache Funktion
0 = wenn Peripheriewakeup
1 = Dimmungsnachlauf
2 = 'Communication Request' by any application (Verwendung von präzisen Weckursachen sind diesem Wert vorzuziehen)
3 = Telefon Mute";
CM_ SG_ 1078 NWM_RNS_Klemme_15 "Nachlaufursache, kein Sleep Ind gesetzt
1 = Klemme 15 ein";
CM_ SG_ 1078 NWM_RNS_Diagnose "Nachlaufursache, kein Sleep Ind gesetzt
1 = Diagnose bei Kl 15 aus";
CM_ SG_ 1078 NWM_RNS_MindestAktivZeit "Nachlaufursache, kein Sleep Ind gesetzt
1 = Mindestaktivzeit Taktiv_min (WAKE_TEMP)
OSEK-NM: Mindestaktivzeit";
CM_ SG_ 1078 NWM_RNS_Ursache_4 "Nachlaufursache, kein Sleep Ind gesetzt
1 = Radio On und BAP-Kommunikation aktiv";
CM_ SG_ 1078 NWM_RNS_Ursache_5 "Nachlaufursache, kein Sleep Ind gesetzt
1 = Die DDP-Komponente Navigation/Kompass hält den Bus wach";
CM_ SG_ 1078 NWM_RNS_Ursache_6 "Nachlaufursache, kein Sleep Ind gesetzt
1 = Die DDP-Komponente Audio hält den Bus wach";
CM_ SG_ 1078 NWM_RNS_Ursache_7 "Nachlaufursache, kein Sleep Ind gesetzt
1 = Nachlaufursache 7";
CM_ SG_ 1078 NWM_RNS_Ursache_8 "Nachlaufursache, kein Sleep Ind gesetzt
1 = Nachlaufursache 8";
CM_ SG_ 1078 NWM_RNS_Nachlauf_1 "1 = interner Nachlauf vor Wakeup 1";
CM_ SG_ 1078 NWM_RNS_Nachlauf_2 "1 = Dimmung (Kl58d)
interner Nachlauf vor Wakeup 2";
CM_ SG_ 1078 NWM_RNS_Nachlauf_3 "1 = Telefon Mute
interner Nachlauf vor Wakeup 3";
CM_ SG_ 1078 NWM_RNS_Nachlauf_4 "1 = interner Nachlauf vor Wakeup 4";
CM_ SG_ 1078 NWM_RNS_Nachlauf_5 "1 = interner Nachlauf vor Wakeup 5";
CM_ SG_ 1078 NWM_RNS_Nachlauf_6 "1 = interner Nachlauf vor Wakeup 6";
CM_ SG_ 1078 NWM_RNS_Nachlauf_7 "1 = interner Nachlauf vor Wakeup 7";
CM_ SG_ 1078 NWM_RNS_Nachlauf_8 "1 = interner Nachlauf vor Wakeup 8";
CM_ SG_ 1078 NWM_RNS_TimeOut_Fehler "1 = Aktiver Timeout Fehlerspeichereintrag";
CM_ SG_ 1078 NWM_RNS_CAN_Diag_deaktiv "1 = Keine CAN Bus bezogene Eigendiagnose";
CM_ SG_ 1078 NWM_RNS_KompSchutz "1 = Funktionseinschränkung aufgrund Komponentenschutz aktiv";
CM_ SG_ 1078 NWM_RNS_Mute_Mode "1 = Funktionseinschränkung aufgrund Mute Mode aktiv, nur VW";
CM_ SG_ 1078 NWM_RNS_Transport_Mode "1 = Funktionseinschränkung aufgrund Transport Mode aktiv";
CM_ SG_ 1078 NWM_RNS_Abschaltst_aktiv "1 = Funktionsabschaltung wegen Abschaltschaltstufe";
CM_ SG_ 1078 NWM_RNS_Eindraht_Fehler "1 = Eindrahtbetrieb erkannt";
CM_ SG_ 1078 NWM_RNS_Anf_1 "für künftige Anforderungen";
CM_ SG_ 1078 NWM_RNS_Anf_9 "für künftige Anforderungen 2";
CM_ SG_ 1082 NWM_TEL_Receiver "SG Adresse";
CM_ SG_ 1082 NWM_TEL_CmdRing "Ring Message";
CM_ SG_ 1082 NWM_TEL_CmdAlive "Alive Message";
CM_ SG_ 1082 NWM_TEL_CmdLimpHome "Limp Home Message";
CM_ SG_ 1082 NWM_TEL_SleepInd "BusSleep Indication";
CM_ SG_ 1082 NWM_TEL_SleepAck "BusSleep Acknowledge";
CM_ SG_ 1082 NWM_TEL_Per_WakeUp "Weckursache Peripherie
0 = wenn Funktionswakeup
1 = CAN
2 = P-WakeUp, Ursache nicht bekannt";
CM_ SG_ 1082 NWM_TEL_Fkt_WakeUp "Weckursache Funktion
0 = wenn Peripheriewakeup";
CM_ SG_ 1082 NWM_TEL_Klemme_15 "Nachlaufursache, kein Sleep Ind gesetzt
1 = Klemme 15 ein";
CM_ SG_ 1082 NWM_TEL_Diagnose "Nachlaufursache, kein Sleep Ind gesetzt
1 = Diagnose bei Kl 15 aus";
CM_ SG_ 1082 NWM_TEL_MindestAktivZeit "Nachlaufursache, kein Sleep Ind gesetzt
1 = Mindestaktivzeit Taktiv_min
OSEK-NM: Mindestaktivzeit";
CM_ SG_ 1082 NWM_TEL_Ursache_4 "Nachlaufursache, kein Sleep Ind gesetzt
1 = Aktives Telefonat";
CM_ SG_ 1082 NWM_TEL_Ursache_5 "Nachlaufursache, kein Sleep Ind gesetzt
1 = Aktives streaming von Media-Daten";
CM_ SG_ 1082 NWM_TEL_Ursache_6 "Nachlaufursache, kein Sleep Ind gesetzt
1 = Nachlaufursache 6";
CM_ SG_ 1082 NWM_TEL_Ursache_7 "Nachlaufursache, kein Sleep Ind gesetzt
1 = Nachlaufursache 7";
CM_ SG_ 1082 NWM_TEL_Ursache_8 "Nachlaufursache, kein Sleep Ind gesetzt
1 = Nachlaufursache 8";
CM_ SG_ 1082 NWM_TEL_Nachlauf_1 "1 = interner Nachlauf vor Wakeup 1";
CM_ SG_ 1082 NWM_TEL_Nachlauf_2 "1 = interner Nachlauf vor Wakeup 2";
CM_ SG_ 1082 NWM_TEL_Nachlauf_3 "1 = interner Nachlauf vor Wakeup 3";
CM_ SG_ 1082 NWM_TEL_Nachlauf_4 "1 = interner Nachlauf vor Wakeup 4";
CM_ SG_ 1082 NWM_TEL_Nachlauf_5 "1 = interner Nachlauf vor Wakeup 5";
CM_ SG_ 1082 NWM_TEL_Nachlauf_6 "1 = interner Nachlauf vor Wakeup 6";
CM_ SG_ 1082 NWM_TEL_Nachlauf_7 "1 = interner Nachlauf vor Wakeup 7";
CM_ SG_ 1082 NWM_TEL_Nachlauf_8 "1 = interner Nachlauf vor Wakeup 8";
CM_ SG_ 1082 NWM_TEL_TimeOut_Fehler "1 = Aktiver Timeout Fehlerspeichereintrag";
CM_ SG_ 1082 NWM_TEL_CAN_Diag_deaktiv "1 = Keine CAN Bus bezogene Eigendiagnose";
CM_ SG_ 1082 NWM_TEL_KompSchutz "1 = Funktionseinschränkung aufgrund Komponentenschutz aktiv";
CM_ SG_ 1082 NWM_TEL_Mute_Mode "1 = Funktionseinschränkung aufgrund Mute Mode aktiv, nur VW";
CM_ SG_ 1082 NWM_TEL_Transport_Mode "1 = Funktionseinschränkung aufgrund Transport Mode aktiv";
CM_ SG_ 1082 NWM_TEL_Abschaltst_aktiv "1 = Funktionsabschaltung wegen Abschaltschaltstufe";
CM_ SG_ 1082 NWM_TEL_Eindraht_Fehler "1 = Eindrahtbetrieb erkannt";
CM_ SG_ 1082 NWM_TEL_Anf_1 "für künftige Anforderungen";
CM_ SG_ 1082 NWM_TEL_Anf_9 "für künftige Anforderungen 2";
CM_ SG_ 1079 NWM_TV_Receiver "SG Adresse";
CM_ SG_ 1079 NWM_TV_CmdRing "Ring Message";
CM_ SG_ 1079 NWM_TV_CmdAlive "Alive Message";
CM_ SG_ 1079 NWM_TV_CmdLimpHome "Limp Home Message";
CM_ SG_ 1079 NWM_TV_SleepInd "Bussleep Indication";
CM_ SG_ 1079 NWM_TV_SleepAck "Bussleep Acknowledge";
CM_ SG_ 1079 NWM_TV_Per_WakeUp "Weckursache Peripherie
0 = wenn Funktionswakeup
1 = CAN
2 = P-WakeUp, Ursache nicht bekannt";
CM_ SG_ 1079 NWM_TV_Fkt_WakeUp "Weckursache Funktion
0 = wenn Peripheriewakeup";
CM_ SG_ 1079 NWM_TV_Klemme_15 "Nachlaufursache, kein Sleep Ind gesetzt
1 = Klemme 15 ein";
CM_ SG_ 1079 NWM_TV_Diagnose "Nachlaufursache, kein Sleep Ind gesetzt
1 = Diagnose bei Kl 15 aus";
CM_ SG_ 1079 NWM_TV_MindestAktivZeit "Nachlaufursache, kein Sleep Ind gesetzt
1 = Mindestaktivzeit Taktiv_min
OSEK-NM: Mindestaktivzeit";
CM_ SG_ 1079 NWM_TV_Ursache_4 "Nachlaufursache, kein Sleep Ind gesetzt
1 = Nachlaufursache 4";
CM_ SG_ 1079 NWM_TV_Ursache_5 "Nachlaufursache, kein Sleep Ind gesetzt
1 = Nachlaufursache 5";
CM_ SG_ 1079 NWM_TV_Ursache_6 "Nachlaufursache, kein Sleep Ind gesetzt
1 = Nachlaufursache 6";
CM_ SG_ 1079 NWM_TV_Ursache_7 "Nachlaufursache, kein Sleep Ind gesetzt
1 = Nachlaufursache 7";
CM_ SG_ 1079 NWM_TV_Ursache_8 "Nachlaufursache, kein Sleep Ind gesetzt
1 = Nachlaufursache 8";
CM_ SG_ 1079 NWM_TV_Nachlauf_1 "1 = interner Nachlauf vor Wakeup 1";
CM_ SG_ 1079 NWM_TV_Nachlauf_2 "1 = interner Nachlauf vor Wakeup 2";
CM_ SG_ 1079 NWM_TV_Nachlauf_3 "1 = interner Nachlauf vor Wakeup 3";
CM_ SG_ 1079 NWM_TV_Nachlauf_4 "1 = interner Nachlauf vor Wakeup 4";
CM_ SG_ 1079 NWM_TV_Nachlauf_5 "1 = interner Nachlauf vor Wakeup 5";
CM_ SG_ 1079 NWM_TV_Nachlauf_6 "1 = interner Nachlauf vor Wakeup 6";
CM_ SG_ 1079 NWM_TV_Nachlauf_7 "1 = interner Nachlauf vor Wakeup 7";
CM_ SG_ 1079 NWM_TV_Nachlauf_8 "1 = interner Nachlauf vor Wakeup 8";
CM_ SG_ 1079 NWM_TV_TimeOut_Fehler "1 = Aktiver Timeout Fehlerspeichereintrag";
CM_ SG_ 1079 NWM_TV_CAN_Diag_deaktiv "1 = Keine CAN Bus bezogene Eigendiagnose";
CM_ SG_ 1079 NWM_TV_KompSchutz "1 = Funktionseinschränkung aufgrund Komponentenschutz aktiv";
CM_ SG_ 1079 NWM_TV_Mute_Mode "1 = Funktionseinschränkung aufgrund Mute Mode aktiv, nur VW";
CM_ SG_ 1079 NWM_TV_Transport_Mode "1 = Funktionseinschränkung aufgrund Transport Mode aktiv";
CM_ SG_ 1079 NWM_TV_Abschaltst_aktiv "1 = Funktionsabschaltung wegen Abschaltschaltstufe";
CM_ SG_ 1079 NWM_TV_Eindraht_Fehler "1 = Eindrahtbetrieb erkannt";
CM_ SG_ 1079 NWM_TV_Anf_1 "für künftige Anforderungen";
CM_ SG_ 1079 NWM_TV_Anf_9 "für künftige Anforderungen 2";
CM_ SG_ 1175 PH_Abschaltursache "Abschaltursache bleibt bis zur nächsten Aktivierung bzw. bis KL15 aus gesetzt
0 = keine, bzw. System aktiv
1 = Abschaltung durch Herausnahme R-Gang
2 = Abschaltung ueber Geschwindigkeit
3 = Abschaltung ueber PDC-Taster
4 = Abschaltung wegen PLA
5 = ";
CM_ SG_ 1175 PH_Opt_Anzeige_V_ein "OPS vorne ist im Display aktiv bzw. Anzeigemodule vorne sind eingeschaltet
Optische Anzeige vorn aktiv";
CM_ SG_ 1175 PH_Opt_Anzeige_H_ein "OPS hinten ist im Display aktiv bzw. Anzeigemodule hinten sind eingeschaltet
Optische Anzeige hinten aktiv";
CM_ SG_ 1175 PH_Opt_Anz_V_Hindernis "mindestens 1 Segment wird für den vorderen Detekionsbereich dargestellt, also ein Hindernis ist im Detektionsbereich
Optische Anzeige vorn Hindernis";
CM_ SG_ 1175 PH_Opt_Anz_H_Hindernis "mindestens 1 Segment wird für den hinteren Detekionsbereich dargestellt, also ein Hindernis ist im Detektionsbereich
Optische Anzeige hinten Hindernis";
CM_ SG_ 1175 PH_Tongeber_V_aktiv "Rohsignal für 'Tongeber vorne wird angesteuert', verlängerbar mit Nachlauftimer
Tongeber vorn aktiv";
CM_ SG_ 1175 PH_Tongeber_H_aktiv "Rohsignal für 'Tongeber hinten wird angesteuert', verlängerbar mit Nachlauftimer
Tongeber hinten aktiv";
CM_ SG_ 1175 PH_Tongeber_mute "1 = Tongeber stummgeschaltet;
Tongeber Mute";
CM_ SG_ 1175 PH_Anf_Audioabsenkung "1 = Anforderung an das Audiosystem für Absenkung der Lautstärke";
CM_ SG_ 1175 PH_Frequenz_hinten "Uebertragung der aktuell im APS Steuergeraet gespeicherten Werte fuer Tongeber Frequenz hinten";
CM_ SG_ 1175 PH_Lautstaerke_hinten "Uebertragung der aktuell im APS Steuergeraet gespeicherten Werte fuer Tongeber Lautstaerke hinten";
CM_ SG_ 1175 PH_Frequenz_vorn "Uebertragung der aktuell im APS Steuergeraet gespeicherten Werte fuer Tongeber Frequenz vorne";
CM_ SG_ 1175 PH_Lautstaerke_vorn "Uebertragung der aktuell im APS Steuergeraet gespeicherten Werte fuer Tongeber Lautstaerke vorn.";
CM_ SG_ 1175 PH_Trigger_Bildaufschaltung "nur Audi für OPS in der RNS-E";
CM_ SG_ 1175 PH_StartStopp_Info "Stopp-Freigabe/Start-Anforderung für den Start-Stopp-Koordinator";
CM_ SG_ 1175 PH_defekt "ein Fehler ist aufgetreten, der die Parkhilfe in den Fehlerzustand versetzt, Signal bleibt bis zur nächsten 'Gut-Aktivierung' gesetzt";
CM_ SG_ 1175 PH_gestoert "eine Störung ist aufgetreten, der die Parkhilfe in einen 'gestört-Zustand' versetzt, z.B. massiver Fremdultraschall, Vereisung, Schnee";
CM_ SG_ 1175 PH_Systemzustand "Aktivierungsursache wird für die Dauer der Aktivierung gemeldet
Im Fehlerfall bei aktivem System wechselt das Signal auf '7'
(siehe auch 'Abschaltursache')";
CM_ SG_ 1175 PH_Display_Kundenwunsch "Anzeige der aktuell verwendeten Parameter bzgl. Kundenwunsch Displayanziege bei Aktivierung (nicht zwingend die abgespeicherten !)";
CM_ SG_ 1175 PH_KD_Fehler "mindestens ein Fehler ist im Kundendienstfehlerspeicher eingetragen";
CM_ SG_ 929 PSD_Pos_Segment_ID "Identifier des Streckensegments, auf dem sich das Fahrzeug aktuell befindet";
CM_ SG_ 929 PSD_Pos_Segmentlaenge "Verbleibende Länge des Streckensegments, auf dem sich das Fahrzeug aktuell befindet";
CM_ SG_ 929 PSD_Pos_Inhibitzeit "Zeitspanne zwischen Generierung der PSD Daten im Navigationssystem und Versand der Daten auf den Most";
CM_ SG_ 929 PSD_Segment_ID "Identifier des prädiktiven Streckensegments
";
CM_ SG_ 929 PSD_Vorgaenger_Segment_ID "An dem Streckensegment mit diesem Identifier schließt sich das neue Segment mit der ID 'PSD_01_Segment_ID' an.";
CM_ SG_ 929 PSD_Strassenklasse "Die Klassifizierung der Straße";
CM_ SG_ 929 PSD_Segmentlaenge "Gesamtlänge des prädiktiven Streckensegments";
CM_ SG_ 929 PSD_Endkruemmung "'Endkrümmung der Klotoide des übermittelten Streckensegments. Die Anfangskrümmung des folgenden Streckensegments entspricht der Endkrümmung dieses Segments. Krümmung = 1/(1+0.155 * x²) [1/m]";
CM_ SG_ 929 PSD_Endsteigung "Endsteigung des Streckensegments.";
CM_ SG_ 929 PSD_ADAS_Qualitaet "ADAS Qualtität des Streckensegments.";
CM_ SG_ 929 PSD_Fahrspuren "Fahrspuren in Fahrtrichtung";
CM_ SG_ 929 PSD_wahrscheinlichster_Pfad "Identifiziert den vom Navigationssystem berechneten wahrscheinlichsten Pfad des Fahrzeuges. ";
CM_ SG_ 930 PSD_Multiplex "Identifieziert den Multiplex der Botschaft.";
CM_ SG_ 930 PSD_Sys_Segment_ID "Identifier des prädiktiven Streckensegments ab dem die Systeminformationen gültig sind.";
CM_ SG_ 930 PSD_Abz_Segment_ID "Identifier des prädiktiven abzweigenden Streckensegments.";
CM_ SG_ 930 PSD_Ges_Segment_ID "Identifier des prädiktiven Streckensegments ab dem die Geschwindigkeitsbegrenzungen und mögliche Einschränkungen gelten.";
CM_ SG_ 930 PSD_Ort_Laenge_VZ "Vorzeichen Laengengrad";
CM_ SG_ 930 PSD_Ort_Laenge "Laengengrad in WGS84 aus Koppelnavigation";
CM_ SG_ 930 PSD_Sys_Laendercode "Ländercode";
CM_ SG_ 930 PSD_Abz_Segmentlaenge "Länge des aktuell übermittelten Streckensegments der Abzweigung";
CM_ SG_ 930 PSD_Ges_Geschwindigkeit_Typ "Typ der Geschwindigkeitsbegrenzung";
CM_ SG_ 930 PSD_Ges_Geschwindigkeit_Gespann "Gilt diese Einschränkung der Geschwindigkeit für alle Fahrzeuge oder ausschließlich für PKW mit Gespann oder für LKW, Buss, etc.";
CM_ SG_ 930 PSD_Abz_Vorgaenger_Segment_ID "Identifier des prädiktiven Streckensegments an dessen Ende die Abzweigung angeheftet ist.";
CM_ SG_ 930 PSD_Sys_Geschwindigkeit_Einheit "Unterscheidung zwischen km/h und miles/h";
CM_ SG_ 930 PSD_Ges_Geschwindigkeit_Witter "Witterungsabhängigkeit der Geschwindigkeitsbegrenzung";
CM_ SG_ 930 PSD_Sys_Verkehrsrichtung "Unterscheidung zwischen Linksverkehr und Rechtsverkehr";
CM_ SG_ 930 PSD_Sys_Release_Monat "Release Datum der Daten DVD: Monat 01¿12";
CM_ SG_ 930 PSD_Ges_Geschwindigkeit_Tag_Anf "Wochentag, an dem die tägliche Geschwindigkeitsbegrenzung beginnt";
CM_ SG_ 930 PSD_Ges_Geschwindigkeit_Tag_Ende "Wochentag, an dem die tägliche Geschwindigkeitsbegrenzung endet";
CM_ SG_ 930 PSD_Sys_Release_Jahr "Release Datum der Daten DVD Jahr 2000 - 2031";
CM_ SG_ 930 PSD_Ges_Geschwindigkeit_Std_Anf "Stunde, zu der die stündliche Geschwindigkeitsbegrenzung beginnt
0h.. 24h";
CM_ SG_ 930 PSD_Abz_Geschwindigkeit_Typ "Typ der Geschwindigkeitsbegrenzung";
CM_ SG_ 930 PSD_Sys_Tunnel "Tunnel";
CM_ SG_ 930 PSD_Abz_Strassenklasse "Die Klassifizierung des abzweigenden Streckensegments.";
CM_ SG_ 930 PSD_Sys_Bruecke "Bruecke";
CM_ SG_ 930 PSD_Sys_Fahrsp_Gegenr "Fahrspuren in Gegenrichtung";
CM_ SG_ 930 PSD_Abz_ADAS_Qualitaet "ADAS Qualtität des abzweigenden Streckensegments.";
CM_ SG_ 930 PSD_Ges_Geschwindigkeit_Std_Ende "Stunde, an der die stündliche Geschwindigkeitsbegrenzung endet
0h.. 24h";
CM_ SG_ 930 PSD_Ort_Breite "Breitengrad in WGS84 aus Koppelnavigation";
CM_ SG_ 930 PSD_Abz_Abzweigerichtung "Richtung, in die die Abzweigung von der Hauptroute abzweigt.";
CM_ SG_ 930 PSD_Sys_TMC_Baustelle "TMC Signal fuer Baustellenbereich";
CM_ SG_ 930 PSD_Abz_Abzweigewinkel "Winkel, unter dem die Abzweigung von der Hauptroute abzweigt.";
CM_ SG_ 930 PSD_Sys_TMC_Stau "TMC Signal fuer Stauinformation";
CM_ SG_ 930 PSD_Abz_Anfangskruemmung "Anfangskrümmung des abzweigenden Streckensegments.
Krümmung = 1/(1+0,155*x²)  [1/m]";
CM_ SG_ 930 PSD_Ges_alter_Geschw_Gespann "Gilt diese alternative Einschränkung der Geschwindigkeit für alle Fahrzeuge oder ausschließlich für PKW mit Gespann oder LKW, Busse, etc. 
0x0 = alle Fahrzeuge
0x1 = PKW mit Gespann
0x2 = LKW, Busse, etc.";
CM_ SG_ 930 PSD_Ges_alter_Geschw_Witter "Witterungsabhängigkeit der alternativen Geschwindigkeitsbegrenzung.";
CM_ SG_ 930 PSD_Ges_alter_Geschw_Tag_Anf "Wochentag, an dem die tägliche alternative Geschwindigkeitsbegrenzung beginnt";
CM_ SG_ 930 PSD_Sys_Anfangskruemmung "Anfangskrümmung des abzweigenden Streckensegments.
Krümmung = 1/(1+0,155*x²)  [1/m]";
CM_ SG_ 930 PSD_Abz_Endkruemmung "Endkrümmung des abzweigenden Streckensegments.
Krümmung = 1/(1+0,155*x²)  [1/m]";
CM_ SG_ 930 PSD_Ges_alter_Geschw_Tag_Ende "Wochentag, an dem die tägliche alternative Geschwindigkeitsbegrenzung endet.";
CM_ SG_ 930 PSD_Ges_alter_Geschw_Std_Anf "Stunde, zu der die stündliche alternative Geschwindigkeitsbegrenzung beginnt
0h.. 24h.";
CM_ SG_ 930 PSD_Ort_Hoehe "Hoehe ueber NN an der";
CM_ SG_ 930 PSD_Ges_alter_Geschw_Std_Ende "Stunde an der die stündliche alternative Geschwindigkeitsbegrenzung endet
0h.. 24h";
CM_ SG_ 930 PSD_Sys_Anfangssteigung "Anfangssteigung des Streckensegments. ";
CM_ SG_ 930 PSD_Abz_Endsteigung "Endsteigung des Streckensegments. ";
CM_ SG_ 930 PSD_Sys_Ortschaft "Die Grenze wird nicht durch das Ortsschild, sondern durch den Beginn der Bebauung markiert.";
CM_ SG_ 930 PSD_Abz_Fahrspuren "Fahrspuren der abzweigenden Strecke in Fahrtrichtung.";
CM_ SG_ 930 PSD_Ges_Wechselverkehrszeichen "Am Beginn des Segments ist ein Wechselverkehrszeichen angebracht.";
CM_ SG_ 930 PSD_Sys_Digitalisierung "Qualität des Kartenmaterials.
In digitalisierten Karten sind sämtliche Straßen erfasst. 
In teildigitalisierten Karten können einzelne Straßen nicht erfasst sein. Dies kann zu Fehlinterpretationen beim MapMatching innerhalb des Navigationssystems führen";
CM_ SG_ 930 PSD_Sys_Zielfuehrung "Zielfuehrung im Navigationssystem. Damit lässt sich der wahrscheinlichste Pfad des Fahrzeuges zuverlässig angeben.";
CM_ SG_ 930 PSD_Abz_wahrscheinlichster_Pfad "Identifiziert den vom Navigationssystem berechneten wahrscheinlichsten Pfad des Fahrzeuges für die abzweigende Strecke.";
BA_DEF_ BO_  "GenMsgAutoGenDsp" ENUM  "No","Yes";
BA_DEF_ BO_  "GenMsgAutoGenSnd" ENUM  "No","Yes";
BA_DEF_ BO_  "GenMsgCycleTime" INT 0 65535;
BA_DEF_ BO_  "GenMsgCycleTimeFast" INT 0 65535;
BA_DEF_ BO_  "GenMsgDelayTime" INT 0 100000;
BA_DEF_ BO_  "GenMsgILSupport" ENUM  "No","Yes";
BA_DEF_ BO_  "GenMsgNrOfRepetition" INT 0 100;
BA_DEF_ BO_  "GenMsgSendType" ENUM  "Cyclic","not_used","not_used","not_used","not_used","not_used","not_used","IfActive","NoMsgSendType";
BA_DEF_ BO_  "GenMsgStartDelayTime" INT 0 100000;
BA_DEF_ BO_  "NmMessage" ENUM  "No","Yes";
BA_DEF_ BO_  "NmhMessage" ENUM  "No","Yes";
BA_DEF_ BO_  "VAGTP20_API" HEX 0 255;
BA_DEF_ BO_  "VAGTP20_DynConnection" ENUM  "No","Yes";
BA_DEF_ BO_  "VAGTP20_DynSetup" ENUM  "No","Yes";
BA_DEF_ BO_  "VAGTP20_StatConnection" ENUM  "No","Yes";
BA_DEF_ BO_  "DiagRequest" ENUM  "No","Yes";
BA_DEF_ BO_  "DiagResponse" ENUM  "No","Yes";
BA_DEF_ BO_  "DiagState" ENUM  "No","Yes";
BA_DEF_ SG_  "GenSigAutoGenDsp" ENUM  "No","Yes";
BA_DEF_ SG_  "GenSigAutoGenSnd" ENUM  "No","Yes";
BA_DEF_ SG_  "GenSigEnvVarType" ENUM  "int","float","undef";
BA_DEF_ SG_  "GenSigInactiveValue" INT -2147483648 2147483647;
BA_DEF_ SG_  "GenSigSendType" ENUM  "Cyclic","OnWrite","OnWriteWithRepetition","OnChange","OnChangeWithRepetition","IfActive","IfActiveWithRepetition","NoSigSendType","OnChangeAndIfActive","OnChangeAndIfActiveWithRepetition";
BA_DEF_ SG_  "GenSigStartValue" INT -2147483648 2147483647;
BA_DEF_ SG_  "NWM-WakeupAllowed" ENUM  "No","Yes";
BA_DEF_ SG_  "GenSigFuncType" ENUM  "NoFunction","MsgCounter","CRC-8","XOR","XOR-2","DatedBit","SW-Kl15","CHK","Constant","Protocol";
BA_DEF_ SG_  "GenSigSwitchedByIgnition" ENUM  "No","Yes";
BA_DEF_ SG_  "Fehlerwert" HEX 0 2147483647;
BA_DEF_DEF_  "GenMsgAutoGenDsp" "Yes";
BA_DEF_DEF_  "GenMsgAutoGenSnd" "Yes";
BA_DEF_DEF_  "GenMsgCycleTime" 0;
BA_DEF_DEF_  "GenMsgCycleTimeFast" 0;
BA_DEF_DEF_  "GenMsgDelayTime" 0;
BA_DEF_DEF_  "GenMsgILSupport" "No";
BA_DEF_DEF_  "GenMsgNrOfRepetition" 0;
BA_DEF_DEF_  "GenMsgSendType" "NoMsgSendType";
BA_DEF_DEF_  "GenMsgStartDelayTime" 0;
BA_DEF_DEF_  "NmMessage" "No";
BA_DEF_DEF_  "NmhMessage" "No";
BA_DEF_DEF_  "VAGTP20_API" 0;
BA_DEF_DEF_  "VAGTP20_DynConnection" "No";
BA_DEF_DEF_  "VAGTP20_DynSetup" "No";
BA_DEF_DEF_  "VAGTP20_StatConnection" "No";
BA_DEF_DEF_  "DiagRequest" "No";
BA_DEF_DEF_  "DiagResponse" "No";
BA_DEF_DEF_  "DiagState" "No";
BA_DEF_DEF_  "GenSigAutoGenDsp" "No";
BA_DEF_DEF_  "GenSigAutoGenSnd" "No";
BA_DEF_DEF_  "GenSigEnvVarType" "undef";
BA_DEF_DEF_  "GenSigInactiveValue" 0;
BA_DEF_DEF_  "GenSigSendType" "NoSigSendType";
BA_DEF_DEF_  "GenSigStartValue" 0;
BA_DEF_DEF_  "NWM-WakeupAllowed" "No";
BA_DEF_DEF_  "GenSigFuncType" "NoFunction";
BA_DEF_DEF_  "GenSigSwitchedByIgnition" "No";
BA_DEF_DEF_  "Fehlerwert" 0;
BA_ "GenMsgCycleTime" BO_ 657 40;
BA_ "GenMsgCycleTimeFast" BO_ 657 40;
BA_ "GenMsgDelayTime" BO_ 657 4;
BA_ "GenMsgNrOfRepetition" BO_ 657 5;
BA_ "GenMsgSendType" BO_ 657 7;
BA_ "GenMsgAutoGenDsp" BO_ 1075 0;
BA_ "GenMsgAutoGenSnd" BO_ 1075 0;
BA_ "NmMessage" BO_ 1075 1;
BA_ "GenMsgAutoGenDsp" BO_ 1077 0;
BA_ "GenMsgAutoGenSnd" BO_ 1077 0;
BA_ "NmMessage" BO_ 1077 1;
BA_ "GenMsgAutoGenDsp" BO_ 1081 0;
BA_ "GenMsgAutoGenSnd" BO_ 1081 0;
BA_ "NmMessage" BO_ 1081 1;
BA_ "GenMsgAutoGenDsp" BO_ 1065 0;
BA_ "GenMsgAutoGenSnd" BO_ 1065 0;
BA_ "NmMessage" BO_ 1065 1;
BA_ "GenMsgAutoGenDsp" BO_ 1078 0;
BA_ "GenMsgAutoGenSnd" BO_ 1078 0;
BA_ "NmMessage" BO_ 1078 1;
BA_ "GenMsgAutoGenDsp" BO_ 1082 0;
BA_ "GenMsgAutoGenSnd" BO_ 1082 0;
BA_ "NmMessage" BO_ 1082 1;
BA_ "GenMsgAutoGenDsp" BO_ 1079 0;
BA_ "GenMsgAutoGenSnd" BO_ 1079 0;
BA_ "NmMessage" BO_ 1079 1;
BA_ "GenMsgCycleTime" BO_ 1175 100;
BA_ "GenMsgDelayTime" BO_ 1175 50;
BA_ "GenMsgILSupport" BO_ 1175 1;
BA_ "GenMsgSendType" BO_ 1175 0;
BA_ "GenMsgCycleTime" BO_ 929 150;
BA_ "GenMsgILSupport" BO_ 929 1;
BA_ "GenMsgSendType" BO_ 929 0;
BA_ "GenMsgCycleTime" BO_ 930 150;
BA_ "GenMsgILSupport" BO_ 930 1;
BA_ "GenMsgSendType" BO_ 930 0;
BA_ "GenSigAutoGenDsp" SG_ 657 ZK1_Funkschl_Nr 1;
BA_ "GenSigAutoGenSnd" SG_ 657 ZK1_Funkschl_Nr 1;
BA_ "GenSigSendType" SG_ 657 ZK1_Funkschl_Nr 6;
BA_ "GenSigAutoGenDsp" SG_ 657 ZK1_433_MHz 1;
BA_ "GenSigAutoGenSnd" SG_ 657 ZK1_433_MHz 1;
BA_ "GenSigAutoGenDsp" SG_ 657 ZK1_Taste_HDF 1;
BA_ "GenSigAutoGenSnd" SG_ 657 ZK1_Taste_HDF 1;
BA_ "GenSigSendType" SG_ 657 ZK1_Taste_HDF 6;
BA_ "GenSigAutoGenDsp" SG_ 657 ZK1_Taste_Panik 1;
BA_ "GenSigAutoGenSnd" SG_ 657 ZK1_Taste_Panik 1;
BA_ "GenSigSendType" SG_ 657 ZK1_Taste_Panik 6;
BA_ "GenSigAutoGenDsp" SG_ 657 ZK1_Taste_Auf 1;
BA_ "GenSigAutoGenSnd" SG_ 657 ZK1_Taste_Auf 1;
BA_ "GenSigSendType" SG_ 657 ZK1_Taste_Auf 6;
BA_ "GenSigAutoGenDsp" SG_ 657 ZK1_Taste_Zu 1;
BA_ "GenSigAutoGenSnd" SG_ 657 ZK1_Taste_Zu 1;
BA_ "GenSigSendType" SG_ 657 ZK1_Taste_Zu 6;
BA_ "GenSigAutoGenDsp" SG_ 657 ZK1_FT_verriegeln 1;
BA_ "GenSigAutoGenSnd" SG_ 657 ZK1_FT_verriegeln 1;
BA_ "GenSigSendType" SG_ 657 ZK1_FT_verriegeln 6;
BA_ "GenSigAutoGenDsp" SG_ 657 ZK1_FT_entriegeln 1;
BA_ "GenSigAutoGenSnd" SG_ 657 ZK1_FT_entriegeln 1;
BA_ "GenSigSendType" SG_ 657 ZK1_FT_entriegeln 6;
BA_ "GenSigAutoGenDsp" SG_ 657 ZK1_BT_verriegeln 1;
BA_ "GenSigAutoGenSnd" SG_ 657 ZK1_BT_verriegeln 1;
BA_ "GenSigSendType" SG_ 657 ZK1_BT_verriegeln 6;
BA_ "GenSigAutoGenDsp" SG_ 657 ZK1_BT_entriegeln 1;
BA_ "GenSigAutoGenSnd" SG_ 657 ZK1_BT_entriegeln 1;
BA_ "GenSigSendType" SG_ 657 ZK1_BT_entriegeln 6;
BA_ "GenSigAutoGenDsp" SG_ 657 ZK1_HL_verriegeln 1;
BA_ "GenSigAutoGenSnd" SG_ 657 ZK1_HL_verriegeln 1;
BA_ "GenSigSendType" SG_ 657 ZK1_HL_verriegeln 6;
BA_ "GenSigAutoGenDsp" SG_ 657 ZK1_HL_entriegeln 1;
BA_ "GenSigAutoGenSnd" SG_ 657 ZK1_HL_entriegeln 1;
BA_ "GenSigSendType" SG_ 657 ZK1_HL_entriegeln 6;
BA_ "GenSigAutoGenDsp" SG_ 657 ZK1_HR_verriegeln 1;
BA_ "GenSigAutoGenSnd" SG_ 657 ZK1_HR_verriegeln 1;
BA_ "GenSigSendType" SG_ 657 ZK1_HR_verriegeln 6;
BA_ "GenSigAutoGenDsp" SG_ 657 ZK1_HR_entriegeln 1;
BA_ "GenSigAutoGenSnd" SG_ 657 ZK1_HR_entriegeln 1;
BA_ "GenSigSendType" SG_ 657 ZK1_HR_entriegeln 6;
BA_ "GenSigAutoGenDsp" SG_ 657 ZK1_Zent_safen 1;
BA_ "GenSigAutoGenSnd" SG_ 657 ZK1_Zent_safen 1;
BA_ "GenSigSendType" SG_ 657 ZK1_Zent_safen 6;
BA_ "GenSigAutoGenDsp" SG_ 657 ZK1_Zent_entsafen 1;
BA_ "GenSigAutoGenSnd" SG_ 657 ZK1_Zent_entsafen 1;
BA_ "GenSigSendType" SG_ 657 ZK1_Zent_entsafen 6;
BA_ "GenSigAutoGenDsp" SG_ 657 ZK1_HD_verriegeln 1;
BA_ "GenSigAutoGenSnd" SG_ 657 ZK1_HD_verriegeln 1;
BA_ "GenSigSendType" SG_ 657 ZK1_HD_verriegeln 6;
BA_ "GenSigAutoGenDsp" SG_ 657 ZK1_HD_entriegeln 1;
BA_ "GenSigAutoGenSnd" SG_ 657 ZK1_HD_entriegeln 1;
BA_ "GenSigSendType" SG_ 657 ZK1_HD_entriegeln 6;
BA_ "GenSigAutoGenDsp" SG_ 657 ZK1_HD_oeffnen 1;
BA_ "GenSigAutoGenSnd" SG_ 657 ZK1_HD_oeffnen 1;
BA_ "GenSigSendType" SG_ 657 ZK1_HD_oeffnen 6;
BA_ "GenSigAutoGenDsp" SG_ 657 ZK1_HD_schliessen 1;
BA_ "GenSigAutoGenSnd" SG_ 657 ZK1_HD_schliessen 1;
BA_ "GenSigSendType" SG_ 657 ZK1_HD_schliessen 6;
BA_ "GenSigAutoGenDsp" SG_ 657 ZK1_LED_Steuerung 1;
BA_ "GenSigAutoGenSnd" SG_ 657 ZK1_LED_Steuerung 1;
BA_ "GenSigSendType" SG_ 657 ZK1_LED_Steuerung 6;
BA_ "GenSigAutoGenDsp" SG_ 657 ZK1_LED_Uebernahme 1;
BA_ "GenSigAutoGenSnd" SG_ 657 ZK1_LED_Uebernahme 1;
BA_ "GenSigSendType" SG_ 657 ZK1_LED_Uebernahme 6;
BA_ "GenSigAutoGenDsp" SG_ 657 ZK1_Dongle_Nr 1;
BA_ "GenSigAutoGenSnd" SG_ 657 ZK1_Dongle_Nr 1;
BA_ "GenSigSendType" SG_ 657 ZK1_Dongle_Nr 6;
BA_ "GenSigAutoGenDsp" SG_ 657 ZK1_Dongle_Freq 1;
BA_ "GenSigAutoGenSnd" SG_ 657 ZK1_Dongle_Freq 1;
BA_ "GenSigSendType" SG_ 657 ZK1_Dongle_Freq 6;
BA_ "GenSigAutoGenDsp" SG_ 657 ZK1_Verdeck_auf 1;
BA_ "GenSigAutoGenSnd" SG_ 657 ZK1_Verdeck_auf 1;
BA_ "GenSigSendType" SG_ 657 ZK1_Verdeck_auf 6;
BA_ "GenSigAutoGenDsp" SG_ 657 ZK1_Verdeck_zu 1;
BA_ "GenSigAutoGenSnd" SG_ 657 ZK1_Verdeck_zu 1;
BA_ "GenSigSendType" SG_ 657 ZK1_Verdeck_zu 6;
BA_ "GenSigAutoGenDsp" SG_ 657 ZK1_LeaveHome_aktiv 1;
BA_ "GenSigAutoGenSnd" SG_ 657 ZK1_LeaveHome_aktiv 1;
BA_ "GenSigSendType" SG_ 657 ZK1_LeaveHome_aktiv 6;
BA_ "GenSigAutoGenDsp" SG_ 657 ZK1_HL_Tuer_offen 1;
BA_ "GenSigAutoGenSnd" SG_ 657 ZK1_HL_Tuer_offen 1;
BA_ "GenSigSendType" SG_ 657 ZK1_HL_Tuer_offen 6;
BA_ "GenSigAutoGenDsp" SG_ 657 ZK1_HR_Tuer_offen 1;
BA_ "GenSigAutoGenSnd" SG_ 657 ZK1_HR_Tuer_offen 1;
BA_ "GenSigSendType" SG_ 657 ZK1_HR_Tuer_offen 6;
BA_ "GenSigAutoGenDsp" SG_ 657 ZK1_SL_Anf 1;
BA_ "GenSigAutoGenSnd" SG_ 657 ZK1_SL_Anf 1;
BA_ "GenSigSendType" SG_ 657 ZK1_SL_Anf 6;
BA_ "GenSigAutoGenDsp" SG_ 657 ZK1_SR_Anf 1;
BA_ "GenSigAutoGenSnd" SG_ 657 ZK1_SR_Anf 1;
BA_ "GenSigSendType" SG_ 657 ZK1_SR_Anf 6;
BA_ "GenSigAutoGenDsp" SG_ 1075 NWM_DSP_Receiver 1;
BA_ "GenSigAutoGenSnd" SG_ 1075 NWM_DSP_Receiver 1;
BA_ "GenSigAutoGenDsp" SG_ 1075 NWM_DSP_CmdRing 1;
BA_ "GenSigAutoGenSnd" SG_ 1075 NWM_DSP_CmdRing 1;
BA_ "GenSigAutoGenDsp" SG_ 1075 NWM_DSP_CmdAlive 1;
BA_ "GenSigAutoGenSnd" SG_ 1075 NWM_DSP_CmdAlive 1;
BA_ "GenSigAutoGenDsp" SG_ 1075 NWM_DSP_CmdLimpHome 1;
BA_ "GenSigAutoGenSnd" SG_ 1075 NWM_DSP_CmdLimpHome 1;
BA_ "GenSigAutoGenDsp" SG_ 1075 NWM_DSP_SleepInd 1;
BA_ "GenSigAutoGenSnd" SG_ 1075 NWM_DSP_SleepInd 1;
BA_ "GenSigAutoGenDsp" SG_ 1075 NWM_DSP_SleepAck 1;
BA_ "GenSigAutoGenSnd" SG_ 1075 NWM_DSP_SleepAck 1;
BA_ "GenSigAutoGenDsp" SG_ 1075 NWM_DSP_Per_WakeUp 1;
BA_ "GenSigAutoGenSnd" SG_ 1075 NWM_DSP_Per_WakeUp 1;
BA_ "GenSigAutoGenDsp" SG_ 1075 NWM_DSP_Fkt_WakeUp 1;
BA_ "GenSigAutoGenSnd" SG_ 1075 NWM_DSP_Fkt_WakeUp 1;
BA_ "GenSigAutoGenDsp" SG_ 1075 NWM_DSP_Klemme_15 1;
BA_ "GenSigAutoGenSnd" SG_ 1075 NWM_DSP_Klemme_15 1;
BA_ "GenSigAutoGenDsp" SG_ 1075 NWM_DSP_Diagnose 1;
BA_ "GenSigAutoGenSnd" SG_ 1075 NWM_DSP_Diagnose 1;
BA_ "GenSigAutoGenDsp" SG_ 1075 NWM_DSP_MindestAktivZeit 1;
BA_ "GenSigAutoGenSnd" SG_ 1075 NWM_DSP_MindestAktivZeit 1;
BA_ "GenSigAutoGenDsp" SG_ 1075 NWM_DSP_Ursache_4 1;
BA_ "GenSigAutoGenSnd" SG_ 1075 NWM_DSP_Ursache_4 1;
BA_ "GenSigAutoGenDsp" SG_ 1075 NWM_DSP_Ursache_5 1;
BA_ "GenSigAutoGenSnd" SG_ 1075 NWM_DSP_Ursache_5 1;
BA_ "GenSigAutoGenDsp" SG_ 1075 NWM_DSP_Ursache_6 1;
BA_ "GenSigAutoGenSnd" SG_ 1075 NWM_DSP_Ursache_6 1;
BA_ "GenSigAutoGenDsp" SG_ 1075 NWM_DSP_Ursache_7 1;
BA_ "GenSigAutoGenSnd" SG_ 1075 NWM_DSP_Ursache_7 1;
BA_ "GenSigAutoGenDsp" SG_ 1075 NWM_DSP_Ursache_8 1;
BA_ "GenSigAutoGenSnd" SG_ 1075 NWM_DSP_Ursache_8 1;
BA_ "GenSigAutoGenDsp" SG_ 1075 NWM_DSP_Nachlauf_1 1;
BA_ "GenSigAutoGenSnd" SG_ 1075 NWM_DSP_Nachlauf_1 1;
BA_ "GenSigAutoGenDsp" SG_ 1075 NWM_DSP_Nachlauf_2 1;
BA_ "GenSigAutoGenSnd" SG_ 1075 NWM_DSP_Nachlauf_2 1;
BA_ "GenSigAutoGenDsp" SG_ 1075 NWM_DSP_Nachlauf_3 1;
BA_ "GenSigAutoGenSnd" SG_ 1075 NWM_DSP_Nachlauf_3 1;
BA_ "GenSigAutoGenDsp" SG_ 1075 NWM_DSP_Nachlauf_4 1;
BA_ "GenSigAutoGenSnd" SG_ 1075 NWM_DSP_Nachlauf_4 1;
BA_ "GenSigAutoGenDsp" SG_ 1075 NWM_DSP_Nachlauf_5 1;
BA_ "GenSigAutoGenSnd" SG_ 1075 NWM_DSP_Nachlauf_5 1;
BA_ "GenSigAutoGenDsp" SG_ 1075 NWM_DSP_Nachlauf_6 1;
BA_ "GenSigAutoGenSnd" SG_ 1075 NWM_DSP_Nachlauf_6 1;
BA_ "GenSigAutoGenDsp" SG_ 1075 NWM_DSP_Nachlauf_7 1;
BA_ "GenSigAutoGenSnd" SG_ 1075 NWM_DSP_Nachlauf_7 1;
BA_ "GenSigAutoGenDsp" SG_ 1075 NWM_DSP_Nachlauf_8 1;
BA_ "GenSigAutoGenSnd" SG_ 1075 NWM_DSP_Nachlauf_8 1;
BA_ "GenSigAutoGenDsp" SG_ 1075 NWM_DSP_TimeOut_Fehler 1;
BA_ "GenSigAutoGenSnd" SG_ 1075 NWM_DSP_TimeOut_Fehler 1;
BA_ "GenSigAutoGenDsp" SG_ 1075 NWM_DSP_CAN_Diag_deaktiv 1;
BA_ "GenSigAutoGenSnd" SG_ 1075 NWM_DSP_CAN_Diag_deaktiv 1;
BA_ "GenSigAutoGenDsp" SG_ 1075 NWM_DSP_KompSchutz 1;
BA_ "GenSigAutoGenSnd" SG_ 1075 NWM_DSP_KompSchutz 1;
BA_ "GenSigAutoGenDsp" SG_ 1075 NWM_DSP_Mute_Mode 1;
BA_ "GenSigAutoGenSnd" SG_ 1075 NWM_DSP_Mute_Mode 1;
BA_ "GenSigAutoGenDsp" SG_ 1075 NWM_DSP_Transport_Mode 1;
BA_ "GenSigAutoGenSnd" SG_ 1075 NWM_DSP_Transport_Mode 1;
BA_ "GenSigAutoGenDsp" SG_ 1075 NWM_DSP_Abschaltst_aktiv 1;
BA_ "GenSigAutoGenSnd" SG_ 1075 NWM_DSP_Abschaltst_aktiv 1;
BA_ "GenSigAutoGenDsp" SG_ 1075 NWM_DSP_Eindraht_Fehler 1;
BA_ "GenSigAutoGenSnd" SG_ 1075 NWM_DSP_Eindraht_Fehler 1;
BA_ "GenSigAutoGenDsp" SG_ 1075 NWM_DSP_Anf_1 1;
BA_ "GenSigAutoGenSnd" SG_ 1075 NWM_DSP_Anf_1 1;
BA_ "GenSigAutoGenDsp" SG_ 1075 NWM_DSP_Anf_2 1;
BA_ "GenSigAutoGenSnd" SG_ 1075 NWM_DSP_Anf_2 1;
BA_ "GenSigAutoGenDsp" SG_ 1075 NWM_DSP_Anf_3 1;
BA_ "GenSigAutoGenSnd" SG_ 1075 NWM_DSP_Anf_3 1;
BA_ "GenSigAutoGenDsp" SG_ 1075 NWM_DSP_Anf_4 1;
BA_ "GenSigAutoGenSnd" SG_ 1075 NWM_DSP_Anf_4 1;
BA_ "GenSigAutoGenDsp" SG_ 1075 NWM_DSP_Anf_5 1;
BA_ "GenSigAutoGenSnd" SG_ 1075 NWM_DSP_Anf_5 1;
BA_ "GenSigAutoGenDsp" SG_ 1075 NWM_DSP_Anf_6 1;
BA_ "GenSigAutoGenSnd" SG_ 1075 NWM_DSP_Anf_6 1;
BA_ "GenSigAutoGenDsp" SG_ 1075 NWM_DSP_Anf_7 1;
BA_ "GenSigAutoGenSnd" SG_ 1075 NWM_DSP_Anf_7 1;
BA_ "GenSigAutoGenDsp" SG_ 1075 NWM_DSP_Anf_8 1;
BA_ "GenSigAutoGenSnd" SG_ 1075 NWM_DSP_Anf_8 1;
BA_ "GenSigAutoGenDsp" SG_ 1075 NWM_DSP_Anf_9 1;
BA_ "GenSigAutoGenSnd" SG_ 1075 NWM_DSP_Anf_9 1;
BA_ "GenSigAutoGenDsp" SG_ 1075 NWM_DSP_Anf_10 1;
BA_ "GenSigAutoGenSnd" SG_ 1075 NWM_DSP_Anf_10 1;
BA_ "GenSigAutoGenDsp" SG_ 1075 NWM_DSP_Anf_11 1;
BA_ "GenSigAutoGenSnd" SG_ 1075 NWM_DSP_Anf_11 1;
BA_ "GenSigAutoGenDsp" SG_ 1075 NWM_DSP_Anf_12 1;
BA_ "GenSigAutoGenSnd" SG_ 1075 NWM_DSP_Anf_12 1;
BA_ "GenSigAutoGenDsp" SG_ 1075 NWM_DSP_Anf_13 1;
BA_ "GenSigAutoGenSnd" SG_ 1075 NWM_DSP_Anf_13 1;
BA_ "GenSigAutoGenDsp" SG_ 1075 NWM_DSP_Anf_14 1;
BA_ "GenSigAutoGenSnd" SG_ 1075 NWM_DSP_Anf_14 1;
BA_ "GenSigAutoGenDsp" SG_ 1075 NWM_DSP_Anf_15 1;
BA_ "GenSigAutoGenSnd" SG_ 1075 NWM_DSP_Anf_15 1;
BA_ "GenSigAutoGenDsp" SG_ 1075 NWM_DSP_Anf_16 1;
BA_ "GenSigAutoGenSnd" SG_ 1075 NWM_DSP_Anf_16 1;
BA_ "GenSigAutoGenDsp" SG_ 1077 NWM_MDI_Receiver 1;
BA_ "GenSigAutoGenSnd" SG_ 1077 NWM_MDI_Receiver 1;
BA_ "GenSigAutoGenDsp" SG_ 1077 NWM_MDI_CmdRing 1;
BA_ "GenSigAutoGenSnd" SG_ 1077 NWM_MDI_CmdRing 1;
BA_ "GenSigAutoGenDsp" SG_ 1077 NWM_MDI_CmdAlive 1;
BA_ "GenSigAutoGenSnd" SG_ 1077 NWM_MDI_CmdAlive 1;
BA_ "GenSigAutoGenDsp" SG_ 1077 NWM_MDI_CmdLimpHome 1;
BA_ "GenSigAutoGenSnd" SG_ 1077 NWM_MDI_CmdLimpHome 1;
BA_ "GenSigAutoGenDsp" SG_ 1077 NWM_MDI_SleepInd 1;
BA_ "GenSigAutoGenSnd" SG_ 1077 NWM_MDI_SleepInd 1;
BA_ "GenSigAutoGenDsp" SG_ 1077 NWM_MDI_SleepAck 1;
BA_ "GenSigAutoGenSnd" SG_ 1077 NWM_MDI_SleepAck 1;
BA_ "GenSigAutoGenDsp" SG_ 1077 NWM_MDI_Per_WakeUp 1;
BA_ "GenSigAutoGenSnd" SG_ 1077 NWM_MDI_Per_WakeUp 1;
BA_ "GenSigAutoGenDsp" SG_ 1077 NWM_MDI_Fkt_WakeUp 1;
BA_ "GenSigAutoGenSnd" SG_ 1077 NWM_MDI_Fkt_WakeUp 1;
BA_ "GenSigAutoGenDsp" SG_ 1077 NWM_MDI_Klemme_15 1;
BA_ "GenSigAutoGenSnd" SG_ 1077 NWM_MDI_Klemme_15 1;
BA_ "GenSigAutoGenDsp" SG_ 1077 NWM_MDI_Diagnose 1;
BA_ "GenSigAutoGenSnd" SG_ 1077 NWM_MDI_Diagnose 1;
BA_ "GenSigAutoGenDsp" SG_ 1077 NWM_MDI_MindestAktivZeit 1;
BA_ "GenSigAutoGenSnd" SG_ 1077 NWM_MDI_MindestAktivZeit 1;
BA_ "GenSigAutoGenDsp" SG_ 1077 NWM_MDI_Ursache_4 1;
BA_ "GenSigAutoGenSnd" SG_ 1077 NWM_MDI_Ursache_4 1;
BA_ "GenSigAutoGenDsp" SG_ 1077 NWM_MDI_Ursache_5 1;
BA_ "GenSigAutoGenSnd" SG_ 1077 NWM_MDI_Ursache_5 1;
BA_ "GenSigAutoGenDsp" SG_ 1077 NWM_MDI_Ursache_6 1;
BA_ "GenSigAutoGenSnd" SG_ 1077 NWM_MDI_Ursache_6 1;
BA_ "GenSigAutoGenDsp" SG_ 1077 NWM_MDI_Ursache_7 1;
BA_ "GenSigAutoGenSnd" SG_ 1077 NWM_MDI_Ursache_7 1;
BA_ "GenSigAutoGenDsp" SG_ 1077 NWM_MDI_Ursache_8 1;
BA_ "GenSigAutoGenSnd" SG_ 1077 NWM_MDI_Ursache_8 1;
BA_ "GenSigAutoGenDsp" SG_ 1077 NWM_MDI_Nachlauf_1 1;
BA_ "GenSigAutoGenSnd" SG_ 1077 NWM_MDI_Nachlauf_1 1;
BA_ "GenSigAutoGenDsp" SG_ 1077 NWM_MDI_Nachlauf_2 1;
BA_ "GenSigAutoGenSnd" SG_ 1077 NWM_MDI_Nachlauf_2 1;
BA_ "GenSigAutoGenDsp" SG_ 1077 NWM_MDI_Nachlauf_3 1;
BA_ "GenSigAutoGenSnd" SG_ 1077 NWM_MDI_Nachlauf_3 1;
BA_ "GenSigAutoGenDsp" SG_ 1077 NWM_MDI_Nachlauf_4 1;
BA_ "GenSigAutoGenSnd" SG_ 1077 NWM_MDI_Nachlauf_4 1;
BA_ "GenSigAutoGenDsp" SG_ 1077 NWM_MDI_Nachlauf_5 1;
BA_ "GenSigAutoGenSnd" SG_ 1077 NWM_MDI_Nachlauf_5 1;
BA_ "GenSigAutoGenDsp" SG_ 1077 NWM_MDI_Nachlauf_6 1;
BA_ "GenSigAutoGenSnd" SG_ 1077 NWM_MDI_Nachlauf_6 1;
BA_ "GenSigAutoGenDsp" SG_ 1077 NWM_MDI_Nachlauf_7 1;
BA_ "GenSigAutoGenSnd" SG_ 1077 NWM_MDI_Nachlauf_7 1;
BA_ "GenSigAutoGenDsp" SG_ 1077 NWM_MDI_Nachlauf_8 1;
BA_ "GenSigAutoGenSnd" SG_ 1077 NWM_MDI_Nachlauf_8 1;
BA_ "GenSigAutoGenDsp" SG_ 1077 NWM_MDI_TimeOut_Fehler 1;
BA_ "GenSigAutoGenSnd" SG_ 1077 NWM_MDI_TimeOut_Fehler 1;
BA_ "GenSigAutoGenDsp" SG_ 1077 NWM_MDI_CAN_Diag_deaktiv 1;
BA_ "GenSigAutoGenSnd" SG_ 1077 NWM_MDI_CAN_Diag_deaktiv 1;
BA_ "GenSigAutoGenDsp" SG_ 1077 NWM_MDI_KompSchutz 1;
BA_ "GenSigAutoGenSnd" SG_ 1077 NWM_MDI_KompSchutz 1;
BA_ "GenSigAutoGenDsp" SG_ 1077 NWM_MDI_Mute_Mode 1;
BA_ "GenSigAutoGenSnd" SG_ 1077 NWM_MDI_Mute_Mode 1;
BA_ "GenSigAutoGenDsp" SG_ 1077 NWM_MDI_Transport_Mode 1;
BA_ "GenSigAutoGenSnd" SG_ 1077 NWM_MDI_Transport_Mode 1;
BA_ "GenSigAutoGenDsp" SG_ 1077 NWM_MDI_Abschaltst_aktiv 1;
BA_ "GenSigAutoGenSnd" SG_ 1077 NWM_MDI_Abschaltst_aktiv 1;
BA_ "GenSigAutoGenDsp" SG_ 1077 NWM_MDI_Eindraht_Fehler 1;
BA_ "GenSigAutoGenSnd" SG_ 1077 NWM_MDI_Eindraht_Fehler 1;
BA_ "GenSigAutoGenDsp" SG_ 1077 NWM_MDI_Anf_1 1;
BA_ "GenSigAutoGenSnd" SG_ 1077 NWM_MDI_Anf_1 1;
BA_ "GenSigAutoGenDsp" SG_ 1077 NWM_MDI_Anf_2 1;
BA_ "GenSigAutoGenSnd" SG_ 1077 NWM_MDI_Anf_2 1;
BA_ "GenSigAutoGenDsp" SG_ 1077 NWM_MDI_Anf_3 1;
BA_ "GenSigAutoGenSnd" SG_ 1077 NWM_MDI_Anf_3 1;
BA_ "GenSigAutoGenDsp" SG_ 1077 NWM_MDI_Anf_4 1;
BA_ "GenSigAutoGenSnd" SG_ 1077 NWM_MDI_Anf_4 1;
BA_ "GenSigAutoGenDsp" SG_ 1077 NWM_MDI_Anf_5 1;
BA_ "GenSigAutoGenSnd" SG_ 1077 NWM_MDI_Anf_5 1;
BA_ "GenSigAutoGenDsp" SG_ 1077 NWM_MDI_Anf_6 1;
BA_ "GenSigAutoGenSnd" SG_ 1077 NWM_MDI_Anf_6 1;
BA_ "GenSigAutoGenDsp" SG_ 1077 NWM_MDI_Anf_7 1;
BA_ "GenSigAutoGenSnd" SG_ 1077 NWM_MDI_Anf_7 1;
BA_ "GenSigAutoGenDsp" SG_ 1077 NWM_MDI_Anf_8 1;
BA_ "GenSigAutoGenSnd" SG_ 1077 NWM_MDI_Anf_8 1;
BA_ "GenSigAutoGenDsp" SG_ 1077 NWM_MDI_Anf_9 1;
BA_ "GenSigAutoGenSnd" SG_ 1077 NWM_MDI_Anf_9 1;
BA_ "GenSigAutoGenDsp" SG_ 1077 NWM_MDI_Anf_10 1;
BA_ "GenSigAutoGenSnd" SG_ 1077 NWM_MDI_Anf_10 1;
BA_ "GenSigAutoGenDsp" SG_ 1077 NWM_MDI_Anf_11 1;
BA_ "GenSigAutoGenSnd" SG_ 1077 NWM_MDI_Anf_11 1;
BA_ "GenSigAutoGenDsp" SG_ 1077 NWM_MDI_Anf_12 1;
BA_ "GenSigAutoGenSnd" SG_ 1077 NWM_MDI_Anf_12 1;
BA_ "GenSigAutoGenDsp" SG_ 1077 NWM_MDI_Anf_13 1;
BA_ "GenSigAutoGenSnd" SG_ 1077 NWM_MDI_Anf_13 1;
BA_ "GenSigAutoGenDsp" SG_ 1077 NWM_MDI_Anf_14 1;
BA_ "GenSigAutoGenSnd" SG_ 1077 NWM_MDI_Anf_14 1;
BA_ "GenSigAutoGenDsp" SG_ 1077 NWM_MDI_Anf_15 1;
BA_ "GenSigAutoGenSnd" SG_ 1077 NWM_MDI_Anf_15 1;
BA_ "GenSigAutoGenDsp" SG_ 1077 NWM_MDI_Anf_16 1;
BA_ "GenSigAutoGenSnd" SG_ 1077 NWM_MDI_Anf_16 1;
BA_ "GenSigAutoGenDsp" SG_ 1081 NWM_Radio_Receiver 1;
BA_ "GenSigAutoGenSnd" SG_ 1081 NWM_Radio_Receiver 1;
BA_ "GenSigAutoGenDsp" SG_ 1081 NWM_Radio_CmdRing 1;
BA_ "GenSigAutoGenSnd" SG_ 1081 NWM_Radio_CmdRing 1;
BA_ "GenSigAutoGenDsp" SG_ 1081 NWM_Radio_CmdAlive 1;
BA_ "GenSigAutoGenSnd" SG_ 1081 NWM_Radio_CmdAlive 1;
BA_ "GenSigAutoGenDsp" SG_ 1081 NWM_Radio_CmdLimpHome 1;
BA_ "GenSigAutoGenSnd" SG_ 1081 NWM_Radio_CmdLimpHome 1;
BA_ "GenSigAutoGenDsp" SG_ 1081 NWM_Radio_SleepInd 1;
BA_ "GenSigAutoGenSnd" SG_ 1081 NWM_Radio_SleepInd 1;
BA_ "GenSigAutoGenDsp" SG_ 1081 NWM_Radio_SleepAck 1;
BA_ "GenSigAutoGenSnd" SG_ 1081 NWM_Radio_SleepAck 1;
BA_ "GenSigAutoGenDsp" SG_ 1081 NWM_Radio_Per_WakeUp 1;
BA_ "GenSigAutoGenSnd" SG_ 1081 NWM_Radio_Per_WakeUp 1;
BA_ "GenSigAutoGenDsp" SG_ 1081 NWM_Radio_Fkt_WakeUp 1;
BA_ "GenSigAutoGenSnd" SG_ 1081 NWM_Radio_Fkt_WakeUp 1;
BA_ "GenSigAutoGenDsp" SG_ 1081 NWM_Radio_Klemme_15 1;
BA_ "GenSigAutoGenSnd" SG_ 1081 NWM_Radio_Klemme_15 1;
BA_ "GenSigAutoGenDsp" SG_ 1081 NWM_Radio_Diagnose 1;
BA_ "GenSigAutoGenSnd" SG_ 1081 NWM_Radio_Diagnose 1;
BA_ "GenSigAutoGenDsp" SG_ 1081 NWM_Radio_MindestAktivZeit 1;
BA_ "GenSigAutoGenSnd" SG_ 1081 NWM_Radio_MindestAktivZeit 1;
BA_ "GenSigAutoGenDsp" SG_ 1081 NWM_Radio_Ursache_4 1;
BA_ "GenSigAutoGenSnd" SG_ 1081 NWM_Radio_Ursache_4 1;
BA_ "GenSigAutoGenDsp" SG_ 1081 NWM_Radio_Ursache_5 1;
BA_ "GenSigAutoGenSnd" SG_ 1081 NWM_Radio_Ursache_5 1;
BA_ "GenSigAutoGenDsp" SG_ 1081 NWM_Radio_Ursache_6 1;
BA_ "GenSigAutoGenSnd" SG_ 1081 NWM_Radio_Ursache_6 1;
BA_ "GenSigAutoGenDsp" SG_ 1081 NWM_Radio_Ursache_7 1;
BA_ "GenSigAutoGenSnd" SG_ 1081 NWM_Radio_Ursache_7 1;
BA_ "GenSigAutoGenDsp" SG_ 1081 NWM_Radio_Ursache_8 1;
BA_ "GenSigAutoGenSnd" SG_ 1081 NWM_Radio_Ursache_8 1;
BA_ "GenSigAutoGenDsp" SG_ 1081 NWM_Radio_Nachlauf_1 1;
BA_ "GenSigAutoGenSnd" SG_ 1081 NWM_Radio_Nachlauf_1 1;
BA_ "GenSigAutoGenDsp" SG_ 1081 NWM_Radio_Nachlauf_2 1;
BA_ "GenSigAutoGenSnd" SG_ 1081 NWM_Radio_Nachlauf_2 1;
BA_ "GenSigAutoGenDsp" SG_ 1081 NWM_Radio_Nachlauf_3 1;
BA_ "GenSigAutoGenSnd" SG_ 1081 NWM_Radio_Nachlauf_3 1;
BA_ "GenSigAutoGenDsp" SG_ 1081 NWM_Radio_Nachlauf_4 1;
BA_ "GenSigAutoGenSnd" SG_ 1081 NWM_Radio_Nachlauf_4 1;
BA_ "GenSigAutoGenDsp" SG_ 1081 NWM_Radio_Nachlauf_5 1;
BA_ "GenSigAutoGenSnd" SG_ 1081 NWM_Radio_Nachlauf_5 1;
BA_ "GenSigAutoGenDsp" SG_ 1081 NWM_Radio_Nachlauf_6 1;
BA_ "GenSigAutoGenSnd" SG_ 1081 NWM_Radio_Nachlauf_6 1;
BA_ "GenSigAutoGenDsp" SG_ 1081 NWM_Radio_Nachlauf_7 1;
BA_ "GenSigAutoGenSnd" SG_ 1081 NWM_Radio_Nachlauf_7 1;
BA_ "GenSigAutoGenDsp" SG_ 1081 NWM_Radio_Nachlauf_8 1;
BA_ "GenSigAutoGenSnd" SG_ 1081 NWM_Radio_Nachlauf_8 1;
BA_ "GenSigAutoGenDsp" SG_ 1081 NWM_Radio_TimeOut_Fehler 1;
BA_ "GenSigAutoGenSnd" SG_ 1081 NWM_Radio_TimeOut_Fehler 1;
BA_ "GenSigAutoGenDsp" SG_ 1081 NWM_Radio_CAN_Diag_deaktiv 1;
BA_ "GenSigAutoGenSnd" SG_ 1081 NWM_Radio_CAN_Diag_deaktiv 1;
BA_ "GenSigAutoGenDsp" SG_ 1081 NWM_Radio_KompSchutz 1;
BA_ "GenSigAutoGenSnd" SG_ 1081 NWM_Radio_KompSchutz 1;
BA_ "GenSigAutoGenDsp" SG_ 1081 NWM_Radio_Mute_Mode 1;
BA_ "GenSigAutoGenSnd" SG_ 1081 NWM_Radio_Mute_Mode 1;
BA_ "GenSigAutoGenDsp" SG_ 1081 NWM_Radio_Transport_Mode 1;
BA_ "GenSigAutoGenSnd" SG_ 1081 NWM_Radio_Transport_Mode 1;
BA_ "GenSigAutoGenDsp" SG_ 1081 NWM_Radio_Abschaltst_aktiv 1;
BA_ "GenSigAutoGenSnd" SG_ 1081 NWM_Radio_Abschaltst_aktiv 1;
BA_ "GenSigAutoGenDsp" SG_ 1081 NWM_Radio_Eindraht_Fehler 1;
BA_ "GenSigAutoGenSnd" SG_ 1081 NWM_Radio_Eindraht_Fehler 1;
BA_ "GenSigAutoGenDsp" SG_ 1081 NWM_Radio_Anf_1 1;
BA_ "GenSigAutoGenSnd" SG_ 1081 NWM_Radio_Anf_1 1;
BA_ "GenSigAutoGenDsp" SG_ 1081 NWM_Radio_Anf_2 1;
BA_ "GenSigAutoGenSnd" SG_ 1081 NWM_Radio_Anf_2 1;
BA_ "GenSigAutoGenDsp" SG_ 1081 NWM_Radio_Anf_3 1;
BA_ "GenSigAutoGenSnd" SG_ 1081 NWM_Radio_Anf_3 1;
BA_ "GenSigAutoGenDsp" SG_ 1081 NWM_Radio_Anf_4 1;
BA_ "GenSigAutoGenSnd" SG_ 1081 NWM_Radio_Anf_4 1;
BA_ "GenSigAutoGenDsp" SG_ 1081 NWM_Radio_Anf_5 1;
BA_ "GenSigAutoGenSnd" SG_ 1081 NWM_Radio_Anf_5 1;
BA_ "GenSigAutoGenDsp" SG_ 1081 NWM_Radio_Anf_6 1;
BA_ "GenSigAutoGenSnd" SG_ 1081 NWM_Radio_Anf_6 1;
BA_ "GenSigAutoGenDsp" SG_ 1081 NWM_Radio_Anf_7 1;
BA_ "GenSigAutoGenSnd" SG_ 1081 NWM_Radio_Anf_7 1;
BA_ "GenSigAutoGenDsp" SG_ 1081 NWM_Radio_Anf_8 1;
BA_ "GenSigAutoGenSnd" SG_ 1081 NWM_Radio_Anf_8 1;
BA_ "GenSigAutoGenDsp" SG_ 1081 NWM_Radio_Anf_9 1;
BA_ "GenSigAutoGenSnd" SG_ 1081 NWM_Radio_Anf_9 1;
BA_ "GenSigAutoGenDsp" SG_ 1081 NWM_Radio_Anf_10 1;
BA_ "GenSigAutoGenSnd" SG_ 1081 NWM_Radio_Anf_10 1;
BA_ "GenSigAutoGenDsp" SG_ 1081 NWM_Radio_Anf_11 1;
BA_ "GenSigAutoGenSnd" SG_ 1081 NWM_Radio_Anf_11 1;
BA_ "GenSigAutoGenDsp" SG_ 1081 NWM_Radio_Anf_12 1;
BA_ "GenSigAutoGenSnd" SG_ 1081 NWM_Radio_Anf_12 1;
BA_ "GenSigAutoGenDsp" SG_ 1081 NWM_Radio_Anf_13 1;
BA_ "GenSigAutoGenSnd" SG_ 1081 NWM_Radio_Anf_13 1;
BA_ "GenSigAutoGenDsp" SG_ 1081 NWM_Radio_Anf_14 1;
BA_ "GenSigAutoGenSnd" SG_ 1081 NWM_Radio_Anf_14 1;
BA_ "GenSigAutoGenDsp" SG_ 1081 NWM_Radio_Anf_15 1;
BA_ "GenSigAutoGenSnd" SG_ 1081 NWM_Radio_Anf_15 1;
BA_ "GenSigAutoGenDsp" SG_ 1081 NWM_Radio_Anf_16 1;
BA_ "GenSigAutoGenSnd" SG_ 1081 NWM_Radio_Anf_16 1;
BA_ "GenSigAutoGenDsp" SG_ 1065 NWM_RV_Receiver 1;
BA_ "GenSigAutoGenSnd" SG_ 1065 NWM_RV_Receiver 1;
BA_ "GenSigAutoGenDsp" SG_ 1065 NWM_RV_CmdRing 1;
BA_ "GenSigAutoGenSnd" SG_ 1065 NWM_RV_CmdRing 1;
BA_ "GenSigAutoGenDsp" SG_ 1065 NWM_RV_CmdAlive 1;
BA_ "GenSigAutoGenSnd" SG_ 1065 NWM_RV_CmdAlive 1;
BA_ "GenSigAutoGenDsp" SG_ 1065 NWM_RV_CmdLimpHome 1;
BA_ "GenSigAutoGenSnd" SG_ 1065 NWM_RV_CmdLimpHome 1;
BA_ "GenSigAutoGenDsp" SG_ 1065 NWM_RV_SleepInd 1;
BA_ "GenSigAutoGenSnd" SG_ 1065 NWM_RV_SleepInd 1;
BA_ "GenSigAutoGenDsp" SG_ 1065 NWM_RV_SleepAck 1;
BA_ "GenSigAutoGenSnd" SG_ 1065 NWM_RV_SleepAck 1;
BA_ "GenSigAutoGenDsp" SG_ 1065 NWM_RV_Per_WakeUp 1;
BA_ "GenSigAutoGenSnd" SG_ 1065 NWM_RV_Per_WakeUp 1;
BA_ "GenSigAutoGenDsp" SG_ 1065 NWM_RV_Fkt_WakeUp 1;
BA_ "GenSigAutoGenSnd" SG_ 1065 NWM_RV_Fkt_WakeUp 1;
BA_ "GenSigAutoGenDsp" SG_ 1065 NWM_RV_Klemme_15 1;
BA_ "GenSigAutoGenSnd" SG_ 1065 NWM_RV_Klemme_15 1;
BA_ "GenSigAutoGenDsp" SG_ 1065 NWM_RV_Diagnose 1;
BA_ "GenSigAutoGenSnd" SG_ 1065 NWM_RV_Diagnose 1;
BA_ "GenSigAutoGenDsp" SG_ 1065 NWM_RV_MindestAktivZeit 1;
BA_ "GenSigAutoGenSnd" SG_ 1065 NWM_RV_MindestAktivZeit 1;
BA_ "GenSigAutoGenDsp" SG_ 1065 NWM_RV_Ursache_4 1;
BA_ "GenSigAutoGenSnd" SG_ 1065 NWM_RV_Ursache_4 1;
BA_ "GenSigAutoGenDsp" SG_ 1065 NWM_RV_Ursache_5 1;
BA_ "GenSigAutoGenSnd" SG_ 1065 NWM_RV_Ursache_5 1;
BA_ "GenSigAutoGenDsp" SG_ 1065 NWM_RV_Ursache_6 1;
BA_ "GenSigAutoGenSnd" SG_ 1065 NWM_RV_Ursache_6 1;
BA_ "GenSigAutoGenDsp" SG_ 1065 NWM_RV_Ursache_7 1;
BA_ "GenSigAutoGenSnd" SG_ 1065 NWM_RV_Ursache_7 1;
BA_ "GenSigAutoGenDsp" SG_ 1065 NWM_RV_Ursache_8 1;
BA_ "GenSigAutoGenSnd" SG_ 1065 NWM_RV_Ursache_8 1;
BA_ "GenSigAutoGenDsp" SG_ 1065 NWM_RV_Nachlauf_1 1;
BA_ "GenSigAutoGenSnd" SG_ 1065 NWM_RV_Nachlauf_1 1;
BA_ "GenSigAutoGenDsp" SG_ 1065 NWM_RV_Nachlauf_2 1;
BA_ "GenSigAutoGenSnd" SG_ 1065 NWM_RV_Nachlauf_2 1;
BA_ "GenSigAutoGenDsp" SG_ 1065 NWM_RV_Nachlauf_3 1;
BA_ "GenSigAutoGenSnd" SG_ 1065 NWM_RV_Nachlauf_3 1;
BA_ "GenSigAutoGenDsp" SG_ 1065 NWM_RV_Nachlauf_4 1;
BA_ "GenSigAutoGenSnd" SG_ 1065 NWM_RV_Nachlauf_4 1;
BA_ "GenSigAutoGenDsp" SG_ 1065 NWM_RV_Nachlauf_5 1;
BA_ "GenSigAutoGenSnd" SG_ 1065 NWM_RV_Nachlauf_5 1;
BA_ "GenSigAutoGenDsp" SG_ 1065 NWM_RV_Nachlauf_6 1;
BA_ "GenSigAutoGenSnd" SG_ 1065 NWM_RV_Nachlauf_6 1;
BA_ "GenSigAutoGenDsp" SG_ 1065 NWM_RV_Nachlauf_7 1;
BA_ "GenSigAutoGenSnd" SG_ 1065 NWM_RV_Nachlauf_7 1;
BA_ "GenSigAutoGenDsp" SG_ 1065 NWM_RV_Nachlauf_8 1;
BA_ "GenSigAutoGenSnd" SG_ 1065 NWM_RV_Nachlauf_8 1;
BA_ "GenSigAutoGenDsp" SG_ 1065 NWM_RV_TimeOut_Fehler 1;
BA_ "GenSigAutoGenSnd" SG_ 1065 NWM_RV_TimeOut_Fehler 1;
BA_ "GenSigAutoGenDsp" SG_ 1065 NWM_RV_CAN_Diag_deaktiv 1;
BA_ "GenSigAutoGenSnd" SG_ 1065 NWM_RV_CAN_Diag_deaktiv 1;
BA_ "GenSigAutoGenDsp" SG_ 1065 NWM_RV_KompSchutz 1;
BA_ "GenSigAutoGenSnd" SG_ 1065 NWM_RV_KompSchutz 1;
BA_ "GenSigAutoGenDsp" SG_ 1065 NWM_RV_Mute_Mode 1;
BA_ "GenSigAutoGenSnd" SG_ 1065 NWM_RV_Mute_Mode 1;
BA_ "GenSigAutoGenDsp" SG_ 1065 NWM_RV_Transport_Mode 1;
BA_ "GenSigAutoGenSnd" SG_ 1065 NWM_RV_Transport_Mode 1;
BA_ "GenSigAutoGenDsp" SG_ 1065 NWM_RV_Abschaltst_aktiv 1;
BA_ "GenSigAutoGenSnd" SG_ 1065 NWM_RV_Abschaltst_aktiv 1;
BA_ "GenSigAutoGenDsp" SG_ 1065 NWM_RV_Eindraht_Fehler 1;
BA_ "GenSigAutoGenSnd" SG_ 1065 NWM_RV_Eindraht_Fehler 1;
BA_ "GenSigAutoGenDsp" SG_ 1065 NWM_RV_Anf_1 1;
BA_ "GenSigAutoGenSnd" SG_ 1065 NWM_RV_Anf_1 1;
BA_ "GenSigAutoGenDsp" SG_ 1065 NWM_RV_Anf_2 1;
BA_ "GenSigAutoGenSnd" SG_ 1065 NWM_RV_Anf_2 1;
BA_ "GenSigAutoGenDsp" SG_ 1065 NWM_RV_Anf_3 1;
BA_ "GenSigAutoGenSnd" SG_ 1065 NWM_RV_Anf_3 1;
BA_ "GenSigAutoGenDsp" SG_ 1065 NWM_RV_Anf_4 1;
BA_ "GenSigAutoGenSnd" SG_ 1065 NWM_RV_Anf_4 1;
BA_ "GenSigAutoGenDsp" SG_ 1065 NWM_RV_Anf_5 1;
BA_ "GenSigAutoGenSnd" SG_ 1065 NWM_RV_Anf_5 1;
BA_ "GenSigAutoGenDsp" SG_ 1065 NWM_RV_Anf_6 1;
BA_ "GenSigAutoGenSnd" SG_ 1065 NWM_RV_Anf_6 1;
BA_ "GenSigAutoGenDsp" SG_ 1065 NWM_RV_Anf_7 1;
BA_ "GenSigAutoGenSnd" SG_ 1065 NWM_RV_Anf_7 1;
BA_ "GenSigAutoGenDsp" SG_ 1065 NWM_RV_Anf_8 1;
BA_ "GenSigAutoGenSnd" SG_ 1065 NWM_RV_Anf_8 1;
BA_ "GenSigAutoGenDsp" SG_ 1065 NWM_RV_Anf_9 1;
BA_ "GenSigAutoGenSnd" SG_ 1065 NWM_RV_Anf_9 1;
BA_ "GenSigAutoGenDsp" SG_ 1065 NWM_RV_Anf_10 1;
BA_ "GenSigAutoGenSnd" SG_ 1065 NWM_RV_Anf_10 1;
BA_ "GenSigAutoGenDsp" SG_ 1065 NWM_RV_Anf_11 1;
BA_ "GenSigAutoGenSnd" SG_ 1065 NWM_RV_Anf_11 1;
BA_ "GenSigAutoGenDsp" SG_ 1065 NWM_RV_Anf_12 1;
BA_ "GenSigAutoGenSnd" SG_ 1065 NWM_RV_Anf_12 1;
BA_ "GenSigAutoGenDsp" SG_ 1065 NWM_RV_Anf_13 1;
BA_ "GenSigAutoGenSnd" SG_ 1065 NWM_RV_Anf_13 1;
BA_ "GenSigAutoGenDsp" SG_ 1065 NWM_RV_Anf_14 1;
BA_ "GenSigAutoGenSnd" SG_ 1065 NWM_RV_Anf_14 1;
BA_ "GenSigAutoGenDsp" SG_ 1065 NWM_RV_Anf_15 1;
BA_ "GenSigAutoGenSnd" SG_ 1065 NWM_RV_Anf_15 1;
BA_ "GenSigAutoGenDsp" SG_ 1065 NWM_RV_Anf_16 1;
BA_ "GenSigAutoGenSnd" SG_ 1065 NWM_RV_Anf_16 1;
BA_ "GenSigAutoGenDsp" SG_ 1078 NWM_RNS_Receiver 1;
BA_ "GenSigAutoGenSnd" SG_ 1078 NWM_RNS_Receiver 1;
BA_ "GenSigAutoGenDsp" SG_ 1078 NWM_RNS_CmdRing 1;
BA_ "GenSigAutoGenSnd" SG_ 1078 NWM_RNS_CmdRing 1;
BA_ "GenSigAutoGenDsp" SG_ 1078 NWM_RNS_CmdAlive 1;
BA_ "GenSigAutoGenSnd" SG_ 1078 NWM_RNS_CmdAlive 1;
BA_ "GenSigAutoGenDsp" SG_ 1078 NWM_RNS_CmdLimpHome 1;
BA_ "GenSigAutoGenSnd" SG_ 1078 NWM_RNS_CmdLimpHome 1;
BA_ "GenSigAutoGenDsp" SG_ 1078 NWM_RNS_SleepInd 1;
BA_ "GenSigAutoGenSnd" SG_ 1078 NWM_RNS_SleepInd 1;
BA_ "GenSigAutoGenDsp" SG_ 1078 NWM_RNS_SleepAck 1;
BA_ "GenSigAutoGenSnd" SG_ 1078 NWM_RNS_SleepAck 1;
BA_ "GenSigAutoGenDsp" SG_ 1078 NWM_RNS_Per_WakeUp 1;
BA_ "GenSigAutoGenSnd" SG_ 1078 NWM_RNS_Per_WakeUp 1;
BA_ "GenSigAutoGenDsp" SG_ 1078 NWM_RNS_Fkt_WakeUp 1;
BA_ "GenSigAutoGenSnd" SG_ 1078 NWM_RNS_Fkt_WakeUp 1;
BA_ "GenSigAutoGenDsp" SG_ 1078 NWM_RNS_Klemme_15 1;
BA_ "GenSigAutoGenSnd" SG_ 1078 NWM_RNS_Klemme_15 1;
BA_ "GenSigAutoGenDsp" SG_ 1078 NWM_RNS_Diagnose 1;
BA_ "GenSigAutoGenSnd" SG_ 1078 NWM_RNS_Diagnose 1;
BA_ "GenSigAutoGenDsp" SG_ 1078 NWM_RNS_MindestAktivZeit 1;
BA_ "GenSigAutoGenSnd" SG_ 1078 NWM_RNS_MindestAktivZeit 1;
BA_ "GenSigAutoGenDsp" SG_ 1078 NWM_RNS_Ursache_4 1;
BA_ "GenSigAutoGenSnd" SG_ 1078 NWM_RNS_Ursache_4 1;
BA_ "GenSigAutoGenDsp" SG_ 1078 NWM_RNS_Ursache_5 1;
BA_ "GenSigAutoGenSnd" SG_ 1078 NWM_RNS_Ursache_5 1;
BA_ "GenSigAutoGenDsp" SG_ 1078 NWM_RNS_Ursache_6 1;
BA_ "GenSigAutoGenSnd" SG_ 1078 NWM_RNS_Ursache_6 1;
BA_ "GenSigAutoGenDsp" SG_ 1078 NWM_RNS_Ursache_7 1;
BA_ "GenSigAutoGenSnd" SG_ 1078 NWM_RNS_Ursache_7 1;
BA_ "GenSigAutoGenDsp" SG_ 1078 NWM_RNS_Ursache_8 1;
BA_ "GenSigAutoGenSnd" SG_ 1078 NWM_RNS_Ursache_8 1;
BA_ "GenSigAutoGenDsp" SG_ 1078 NWM_RNS_Nachlauf_1 1;
BA_ "GenSigAutoGenSnd" SG_ 1078 NWM_RNS_Nachlauf_1 1;
BA_ "GenSigAutoGenDsp" SG_ 1078 NWM_RNS_Nachlauf_2 1;
BA_ "GenSigAutoGenSnd" SG_ 1078 NWM_RNS_Nachlauf_2 1;
BA_ "GenSigAutoGenDsp" SG_ 1078 NWM_RNS_Nachlauf_3 1;
BA_ "GenSigAutoGenSnd" SG_ 1078 NWM_RNS_Nachlauf_3 1;
BA_ "GenSigAutoGenDsp" SG_ 1078 NWM_RNS_Nachlauf_4 1;
BA_ "GenSigAutoGenSnd" SG_ 1078 NWM_RNS_Nachlauf_4 1;
BA_ "GenSigAutoGenDsp" SG_ 1078 NWM_RNS_Nachlauf_5 1;
BA_ "GenSigAutoGenSnd" SG_ 1078 NWM_RNS_Nachlauf_5 1;
BA_ "GenSigAutoGenDsp" SG_ 1078 NWM_RNS_Nachlauf_6 1;
BA_ "GenSigAutoGenSnd" SG_ 1078 NWM_RNS_Nachlauf_6 1;
BA_ "GenSigAutoGenDsp" SG_ 1078 NWM_RNS_Nachlauf_7 1;
BA_ "GenSigAutoGenSnd" SG_ 1078 NWM_RNS_Nachlauf_7 1;
BA_ "GenSigAutoGenDsp" SG_ 1078 NWM_RNS_Nachlauf_8 1;
BA_ "GenSigAutoGenSnd" SG_ 1078 NWM_RNS_Nachlauf_8 1;
BA_ "GenSigAutoGenDsp" SG_ 1078 NWM_RNS_TimeOut_Fehler 1;
BA_ "GenSigAutoGenSnd" SG_ 1078 NWM_RNS_TimeOut_Fehler 1;
BA_ "GenSigAutoGenDsp" SG_ 1078 NWM_RNS_CAN_Diag_deaktiv 1;
BA_ "GenSigAutoGenSnd" SG_ 1078 NWM_RNS_CAN_Diag_deaktiv 1;
BA_ "GenSigAutoGenDsp" SG_ 1078 NWM_RNS_KompSchutz 1;
BA_ "GenSigAutoGenSnd" SG_ 1078 NWM_RNS_KompSchutz 1;
BA_ "GenSigAutoGenDsp" SG_ 1078 NWM_RNS_Mute_Mode 1;
BA_ "GenSigAutoGenSnd" SG_ 1078 NWM_RNS_Mute_Mode 1;
BA_ "GenSigAutoGenDsp" SG_ 1078 NWM_RNS_Transport_Mode 1;
BA_ "GenSigAutoGenSnd" SG_ 1078 NWM_RNS_Transport_Mode 1;
BA_ "GenSigAutoGenDsp" SG_ 1078 NWM_RNS_Abschaltst_aktiv 1;
BA_ "GenSigAutoGenSnd" SG_ 1078 NWM_RNS_Abschaltst_aktiv 1;
BA_ "GenSigAutoGenDsp" SG_ 1078 NWM_RNS_Eindraht_Fehler 1;
BA_ "GenSigAutoGenSnd" SG_ 1078 NWM_RNS_Eindraht_Fehler 1;
BA_ "GenSigAutoGenDsp" SG_ 1078 NWM_RNS_Anf_1 1;
BA_ "GenSigAutoGenSnd" SG_ 1078 NWM_RNS_Anf_1 1;
BA_ "GenSigAutoGenDsp" SG_ 1078 NWM_RNS_Anf_2 1;
BA_ "GenSigAutoGenSnd" SG_ 1078 NWM_RNS_Anf_2 1;
BA_ "GenSigAutoGenDsp" SG_ 1078 NWM_RNS_Anf_3 1;
BA_ "GenSigAutoGenSnd" SG_ 1078 NWM_RNS_Anf_3 1;
BA_ "GenSigAutoGenDsp" SG_ 1078 NWM_RNS_Anf_4 1;
BA_ "GenSigAutoGenSnd" SG_ 1078 NWM_RNS_Anf_4 1;
BA_ "GenSigAutoGenDsp" SG_ 1078 NWM_RNS_Anf_5 1;
BA_ "GenSigAutoGenSnd" SG_ 1078 NWM_RNS_Anf_5 1;
BA_ "GenSigAutoGenDsp" SG_ 1078 NWM_RNS_Anf_6 1;
BA_ "GenSigAutoGenSnd" SG_ 1078 NWM_RNS_Anf_6 1;
BA_ "GenSigAutoGenDsp" SG_ 1078 NWM_RNS_Anf_7 1;
BA_ "GenSigAutoGenSnd" SG_ 1078 NWM_RNS_Anf_7 1;
BA_ "GenSigAutoGenDsp" SG_ 1078 NWM_RNS_Anf_8 1;
BA_ "GenSigAutoGenSnd" SG_ 1078 NWM_RNS_Anf_8 1;
BA_ "GenSigAutoGenDsp" SG_ 1078 NWM_RNS_Anf_9 1;
BA_ "GenSigAutoGenSnd" SG_ 1078 NWM_RNS_Anf_9 1;
BA_ "GenSigAutoGenDsp" SG_ 1078 NWM_RNS_Anf_10 1;
BA_ "GenSigAutoGenSnd" SG_ 1078 NWM_RNS_Anf_10 1;
BA_ "GenSigAutoGenDsp" SG_ 1078 NWM_RNS_Anf_11 1;
BA_ "GenSigAutoGenSnd" SG_ 1078 NWM_RNS_Anf_11 1;
BA_ "GenSigAutoGenDsp" SG_ 1078 NWM_RNS_Anf_12 1;
BA_ "GenSigAutoGenSnd" SG_ 1078 NWM_RNS_Anf_12 1;
BA_ "GenSigAutoGenDsp" SG_ 1078 NWM_RNS_Anf_13 1;
BA_ "GenSigAutoGenSnd" SG_ 1078 NWM_RNS_Anf_13 1;
BA_ "GenSigAutoGenDsp" SG_ 1078 NWM_RNS_Anf_14 1;
BA_ "GenSigAutoGenSnd" SG_ 1078 NWM_RNS_Anf_14 1;
BA_ "GenSigAutoGenDsp" SG_ 1078 NWM_RNS_Anf_15 1;
BA_ "GenSigAutoGenSnd" SG_ 1078 NWM_RNS_Anf_15 1;
BA_ "GenSigAutoGenDsp" SG_ 1078 NWM_RNS_Anf_16 1;
BA_ "GenSigAutoGenSnd" SG_ 1078 NWM_RNS_Anf_16 1;
BA_ "GenSigAutoGenDsp" SG_ 1082 NWM_TEL_Receiver 1;
BA_ "GenSigAutoGenSnd" SG_ 1082 NWM_TEL_Receiver 1;
BA_ "GenSigAutoGenDsp" SG_ 1082 NWM_TEL_CmdRing 1;
BA_ "GenSigAutoGenSnd" SG_ 1082 NWM_TEL_CmdRing 1;
BA_ "GenSigAutoGenDsp" SG_ 1082 NWM_TEL_CmdAlive 1;
BA_ "GenSigAutoGenSnd" SG_ 1082 NWM_TEL_CmdAlive 1;
BA_ "GenSigAutoGenDsp" SG_ 1082 NWM_TEL_CmdLimpHome 1;
BA_ "GenSigAutoGenSnd" SG_ 1082 NWM_TEL_CmdLimpHome 1;
BA_ "GenSigAutoGenDsp" SG_ 1082 NWM_TEL_SleepInd 1;
BA_ "GenSigAutoGenSnd" SG_ 1082 NWM_TEL_SleepInd 1;
BA_ "GenSigAutoGenDsp" SG_ 1082 NWM_TEL_SleepAck 1;
BA_ "GenSigAutoGenSnd" SG_ 1082 NWM_TEL_SleepAck 1;
BA_ "GenSigAutoGenDsp" SG_ 1082 NWM_TEL_Per_WakeUp 1;
BA_ "GenSigAutoGenSnd" SG_ 1082 NWM_TEL_Per_WakeUp 1;
BA_ "GenSigAutoGenDsp" SG_ 1082 NWM_TEL_Fkt_WakeUp 1;
BA_ "GenSigAutoGenSnd" SG_ 1082 NWM_TEL_Fkt_WakeUp 1;
BA_ "GenSigAutoGenDsp" SG_ 1082 NWM_TEL_Klemme_15 1;
BA_ "GenSigAutoGenSnd" SG_ 1082 NWM_TEL_Klemme_15 1;
BA_ "GenSigAutoGenDsp" SG_ 1082 NWM_TEL_Diagnose 1;
BA_ "GenSigAutoGenSnd" SG_ 1082 NWM_TEL_Diagnose 1;
BA_ "GenSigAutoGenDsp" SG_ 1082 NWM_TEL_MindestAktivZeit 1;
BA_ "GenSigAutoGenSnd" SG_ 1082 NWM_TEL_MindestAktivZeit 1;
BA_ "GenSigAutoGenDsp" SG_ 1082 NWM_TEL_Ursache_4 1;
BA_ "GenSigAutoGenSnd" SG_ 1082 NWM_TEL_Ursache_4 1;
BA_ "GenSigAutoGenDsp" SG_ 1082 NWM_TEL_Ursache_5 1;
BA_ "GenSigAutoGenSnd" SG_ 1082 NWM_TEL_Ursache_5 1;
BA_ "GenSigAutoGenDsp" SG_ 1082 NWM_TEL_Ursache_6 1;
BA_ "GenSigAutoGenSnd" SG_ 1082 NWM_TEL_Ursache_6 1;
BA_ "GenSigAutoGenDsp" SG_ 1082 NWM_TEL_Ursache_7 1;
BA_ "GenSigAutoGenSnd" SG_ 1082 NWM_TEL_Ursache_7 1;
BA_ "GenSigAutoGenDsp" SG_ 1082 NWM_TEL_Ursache_8 1;
BA_ "GenSigAutoGenSnd" SG_ 1082 NWM_TEL_Ursache_8 1;
BA_ "GenSigAutoGenDsp" SG_ 1082 NWM_TEL_Nachlauf_1 1;
BA_ "GenSigAutoGenSnd" SG_ 1082 NWM_TEL_Nachlauf_1 1;
BA_ "GenSigAutoGenDsp" SG_ 1082 NWM_TEL_Nachlauf_2 1;
BA_ "GenSigAutoGenSnd" SG_ 1082 NWM_TEL_Nachlauf_2 1;
BA_ "GenSigAutoGenDsp" SG_ 1082 NWM_TEL_Nachlauf_3 1;
BA_ "GenSigAutoGenSnd" SG_ 1082 NWM_TEL_Nachlauf_3 1;
BA_ "GenSigAutoGenDsp" SG_ 1082 NWM_TEL_Nachlauf_4 1;
BA_ "GenSigAutoGenSnd" SG_ 1082 NWM_TEL_Nachlauf_4 1;
BA_ "GenSigAutoGenDsp" SG_ 1082 NWM_TEL_Nachlauf_5 1;
BA_ "GenSigAutoGenSnd" SG_ 1082 NWM_TEL_Nachlauf_5 1;
BA_ "GenSigAutoGenDsp" SG_ 1082 NWM_TEL_Nachlauf_6 1;
BA_ "GenSigAutoGenSnd" SG_ 1082 NWM_TEL_Nachlauf_6 1;
BA_ "GenSigAutoGenDsp" SG_ 1082 NWM_TEL_Nachlauf_7 1;
BA_ "GenSigAutoGenSnd" SG_ 1082 NWM_TEL_Nachlauf_7 1;
BA_ "GenSigAutoGenDsp" SG_ 1082 NWM_TEL_Nachlauf_8 1;
BA_ "GenSigAutoGenSnd" SG_ 1082 NWM_TEL_Nachlauf_8 1;
BA_ "GenSigAutoGenDsp" SG_ 1082 NWM_TEL_TimeOut_Fehler 1;
BA_ "GenSigAutoGenSnd" SG_ 1082 NWM_TEL_TimeOut_Fehler 1;
BA_ "GenSigAutoGenDsp" SG_ 1082 NWM_TEL_CAN_Diag_deaktiv 1;
BA_ "GenSigAutoGenSnd" SG_ 1082 NWM_TEL_CAN_Diag_deaktiv 1;
BA_ "GenSigAutoGenDsp" SG_ 1082 NWM_TEL_KompSchutz 1;
BA_ "GenSigAutoGenSnd" SG_ 1082 NWM_TEL_KompSchutz 1;
BA_ "GenSigAutoGenDsp" SG_ 1082 NWM_TEL_Mute_Mode 1;
BA_ "GenSigAutoGenSnd" SG_ 1082 NWM_TEL_Mute_Mode 1;
BA_ "GenSigAutoGenDsp" SG_ 1082 NWM_TEL_Transport_Mode 1;
BA_ "GenSigAutoGenSnd" SG_ 1082 NWM_TEL_Transport_Mode 1;
BA_ "GenSigAutoGenDsp" SG_ 1082 NWM_TEL_Abschaltst_aktiv 1;
BA_ "GenSigAutoGenSnd" SG_ 1082 NWM_TEL_Abschaltst_aktiv 1;
BA_ "GenSigAutoGenDsp" SG_ 1082 NWM_TEL_Eindraht_Fehler 1;
BA_ "GenSigAutoGenSnd" SG_ 1082 NWM_TEL_Eindraht_Fehler 1;
BA_ "GenSigAutoGenDsp" SG_ 1082 NWM_TEL_Anf_1 1;
BA_ "GenSigAutoGenSnd" SG_ 1082 NWM_TEL_Anf_1 1;
BA_ "GenSigAutoGenDsp" SG_ 1082 NWM_TEL_Anf_2 1;
BA_ "GenSigAutoGenSnd" SG_ 1082 NWM_TEL_Anf_2 1;
BA_ "GenSigAutoGenDsp" SG_ 1082 NWM_TEL_Anf_3 1;
BA_ "GenSigAutoGenSnd" SG_ 1082 NWM_TEL_Anf_3 1;
BA_ "GenSigAutoGenDsp" SG_ 1082 NWM_TEL_Anf_4 1;
BA_ "GenSigAutoGenSnd" SG_ 1082 NWM_TEL_Anf_4 1;
BA_ "GenSigAutoGenDsp" SG_ 1082 NWM_TEL_Anf_5 1;
BA_ "GenSigAutoGenSnd" SG_ 1082 NWM_TEL_Anf_5 1;
BA_ "GenSigAutoGenDsp" SG_ 1082 NWM_TEL_Anf_6 1;
BA_ "GenSigAutoGenSnd" SG_ 1082 NWM_TEL_Anf_6 1;
BA_ "GenSigAutoGenDsp" SG_ 1082 NWM_TEL_Anf_7 1;
BA_ "GenSigAutoGenSnd" SG_ 1082 NWM_TEL_Anf_7 1;
BA_ "GenSigAutoGenDsp" SG_ 1082 NWM_TEL_Anf_8 1;
BA_ "GenSigAutoGenSnd" SG_ 1082 NWM_TEL_Anf_8 1;
BA_ "GenSigAutoGenDsp" SG_ 1082 NWM_TEL_Anf_9 1;
BA_ "GenSigAutoGenSnd" SG_ 1082 NWM_TEL_Anf_9 1;
BA_ "GenSigAutoGenDsp" SG_ 1082 NWM_TEL_Anf_10 1;
BA_ "GenSigAutoGenSnd" SG_ 1082 NWM_TEL_Anf_10 1;
BA_ "GenSigAutoGenDsp" SG_ 1082 NWM_TEL_Anf_11 1;
BA_ "GenSigAutoGenSnd" SG_ 1082 NWM_TEL_Anf_11 1;
BA_ "GenSigAutoGenDsp" SG_ 1082 NWM_TEL_Anf_12 1;
BA_ "GenSigAutoGenSnd" SG_ 1082 NWM_TEL_Anf_12 1;
BA_ "GenSigAutoGenDsp" SG_ 1082 NWM_TEL_Anf_13 1;
BA_ "GenSigAutoGenSnd" SG_ 1082 NWM_TEL_Anf_13 1;
BA_ "GenSigAutoGenDsp" SG_ 1082 NWM_TEL_Anf_14 1;
BA_ "GenSigAutoGenSnd" SG_ 1082 NWM_TEL_Anf_14 1;
BA_ "GenSigAutoGenDsp" SG_ 1082 NWM_TEL_Anf_15 1;
BA_ "GenSigAutoGenSnd" SG_ 1082 NWM_TEL_Anf_15 1;
BA_ "GenSigAutoGenDsp" SG_ 1082 NWM_TEL_Anf_16 1;
BA_ "GenSigAutoGenSnd" SG_ 1082 NWM_TEL_Anf_16 1;
BA_ "GenSigAutoGenDsp" SG_ 1079 NWM_TV_Receiver 1;
BA_ "GenSigAutoGenSnd" SG_ 1079 NWM_TV_Receiver 1;
BA_ "GenSigAutoGenDsp" SG_ 1079 NWM_TV_CmdRing 1;
BA_ "GenSigAutoGenSnd" SG_ 1079 NWM_TV_CmdRing 1;
BA_ "GenSigAutoGenDsp" SG_ 1079 NWM_TV_CmdAlive 1;
BA_ "GenSigAutoGenSnd" SG_ 1079 NWM_TV_CmdAlive 1;
BA_ "GenSigAutoGenDsp" SG_ 1079 NWM_TV_CmdLimpHome 1;
BA_ "GenSigAutoGenSnd" SG_ 1079 NWM_TV_CmdLimpHome 1;
BA_ "GenSigAutoGenDsp" SG_ 1079 NWM_TV_SleepInd 1;
BA_ "GenSigAutoGenSnd" SG_ 1079 NWM_TV_SleepInd 1;
BA_ "GenSigAutoGenDsp" SG_ 1079 NWM_TV_SleepAck 1;
BA_ "GenSigAutoGenSnd" SG_ 1079 NWM_TV_SleepAck 1;
BA_ "GenSigAutoGenDsp" SG_ 1079 NWM_TV_Per_WakeUp 1;
BA_ "GenSigAutoGenSnd" SG_ 1079 NWM_TV_Per_WakeUp 1;
BA_ "GenSigAutoGenDsp" SG_ 1079 NWM_TV_Fkt_WakeUp 1;
BA_ "GenSigAutoGenSnd" SG_ 1079 NWM_TV_Fkt_WakeUp 1;
BA_ "GenSigAutoGenDsp" SG_ 1079 NWM_TV_Klemme_15 1;
BA_ "GenSigAutoGenSnd" SG_ 1079 NWM_TV_Klemme_15 1;
BA_ "GenSigAutoGenDsp" SG_ 1079 NWM_TV_Diagnose 1;
BA_ "GenSigAutoGenSnd" SG_ 1079 NWM_TV_Diagnose 1;
BA_ "GenSigAutoGenDsp" SG_ 1079 NWM_TV_MindestAktivZeit 1;
BA_ "GenSigAutoGenSnd" SG_ 1079 NWM_TV_MindestAktivZeit 1;
BA_ "GenSigAutoGenDsp" SG_ 1079 NWM_TV_Ursache_4 1;
BA_ "GenSigAutoGenSnd" SG_ 1079 NWM_TV_Ursache_4 1;
BA_ "GenSigAutoGenDsp" SG_ 1079 NWM_TV_Ursache_5 1;
BA_ "GenSigAutoGenSnd" SG_ 1079 NWM_TV_Ursache_5 1;
BA_ "GenSigAutoGenDsp" SG_ 1079 NWM_TV_Ursache_6 1;
BA_ "GenSigAutoGenSnd" SG_ 1079 NWM_TV_Ursache_6 1;
BA_ "GenSigAutoGenDsp" SG_ 1079 NWM_TV_Ursache_7 1;
BA_ "GenSigAutoGenSnd" SG_ 1079 NWM_TV_Ursache_7 1;
BA_ "GenSigAutoGenDsp" SG_ 1079 NWM_TV_Ursache_8 1;
BA_ "GenSigAutoGenSnd" SG_ 1079 NWM_TV_Ursache_8 1;
BA_ "GenSigAutoGenDsp" SG_ 1079 NWM_TV_Nachlauf_1 1;
BA_ "GenSigAutoGenSnd" SG_ 1079 NWM_TV_Nachlauf_1 1;
BA_ "GenSigAutoGenDsp" SG_ 1079 NWM_TV_Nachlauf_2 1;
BA_ "GenSigAutoGenSnd" SG_ 1079 NWM_TV_Nachlauf_2 1;
BA_ "GenSigAutoGenDsp" SG_ 1079 NWM_TV_Nachlauf_3 1;
BA_ "GenSigAutoGenSnd" SG_ 1079 NWM_TV_Nachlauf_3 1;
BA_ "GenSigAutoGenDsp" SG_ 1079 NWM_TV_Nachlauf_4 1;
BA_ "GenSigAutoGenSnd" SG_ 1079 NWM_TV_Nachlauf_4 1;
BA_ "GenSigAutoGenDsp" SG_ 1079 NWM_TV_Nachlauf_5 1;
BA_ "GenSigAutoGenSnd" SG_ 1079 NWM_TV_Nachlauf_5 1;
BA_ "GenSigAutoGenDsp" SG_ 1079 NWM_TV_Nachlauf_6 1;
BA_ "GenSigAutoGenSnd" SG_ 1079 NWM_TV_Nachlauf_6 1;
BA_ "GenSigAutoGenDsp" SG_ 1079 NWM_TV_Nachlauf_7 1;
BA_ "GenSigAutoGenSnd" SG_ 1079 NWM_TV_Nachlauf_7 1;
BA_ "GenSigAutoGenDsp" SG_ 1079 NWM_TV_Nachlauf_8 1;
BA_ "GenSigAutoGenSnd" SG_ 1079 NWM_TV_Nachlauf_8 1;
BA_ "GenSigAutoGenDsp" SG_ 1079 NWM_TV_TimeOut_Fehler 1;
BA_ "GenSigAutoGenSnd" SG_ 1079 NWM_TV_TimeOut_Fehler 1;
BA_ "GenSigAutoGenDsp" SG_ 1079 NWM_TV_CAN_Diag_deaktiv 1;
BA_ "GenSigAutoGenSnd" SG_ 1079 NWM_TV_CAN_Diag_deaktiv 1;
BA_ "GenSigAutoGenDsp" SG_ 1079 NWM_TV_KompSchutz 1;
BA_ "GenSigAutoGenSnd" SG_ 1079 NWM_TV_KompSchutz 1;
BA_ "GenSigAutoGenDsp" SG_ 1079 NWM_TV_Mute_Mode 1;
BA_ "GenSigAutoGenSnd" SG_ 1079 NWM_TV_Mute_Mode 1;
BA_ "GenSigAutoGenDsp" SG_ 1079 NWM_TV_Transport_Mode 1;
BA_ "GenSigAutoGenSnd" SG_ 1079 NWM_TV_Transport_Mode 1;
BA_ "GenSigAutoGenDsp" SG_ 1079 NWM_TV_Abschaltst_aktiv 1;
BA_ "GenSigAutoGenSnd" SG_ 1079 NWM_TV_Abschaltst_aktiv 1;
BA_ "GenSigAutoGenDsp" SG_ 1079 NWM_TV_Eindraht_Fehler 1;
BA_ "GenSigAutoGenSnd" SG_ 1079 NWM_TV_Eindraht_Fehler 1;
BA_ "GenSigAutoGenDsp" SG_ 1079 NWM_TV_Anf_1 1;
BA_ "GenSigAutoGenSnd" SG_ 1079 NWM_TV_Anf_1 1;
BA_ "GenSigAutoGenDsp" SG_ 1079 NWM_TV_Anf_2 1;
BA_ "GenSigAutoGenSnd" SG_ 1079 NWM_TV_Anf_2 1;
BA_ "GenSigAutoGenDsp" SG_ 1079 NWM_TV_Anf_3 1;
BA_ "GenSigAutoGenSnd" SG_ 1079 NWM_TV_Anf_3 1;
BA_ "GenSigAutoGenDsp" SG_ 1079 NWM_TV_Anf_4 1;
BA_ "GenSigAutoGenSnd" SG_ 1079 NWM_TV_Anf_4 1;
BA_ "GenSigAutoGenDsp" SG_ 1079 NWM_TV_Anf_5 1;
BA_ "GenSigAutoGenSnd" SG_ 1079 NWM_TV_Anf_5 1;
BA_ "GenSigAutoGenDsp" SG_ 1079 NWM_TV_Anf_6 1;
BA_ "GenSigAutoGenSnd" SG_ 1079 NWM_TV_Anf_6 1;
BA_ "GenSigAutoGenDsp" SG_ 1079 NWM_TV_Anf_7 1;
BA_ "GenSigAutoGenSnd" SG_ 1079 NWM_TV_Anf_7 1;
BA_ "GenSigAutoGenDsp" SG_ 1079 NWM_TV_Anf_8 1;
BA_ "GenSigAutoGenSnd" SG_ 1079 NWM_TV_Anf_8 1;
BA_ "GenSigAutoGenDsp" SG_ 1079 NWM_TV_Anf_9 1;
BA_ "GenSigAutoGenSnd" SG_ 1079 NWM_TV_Anf_9 1;
BA_ "GenSigAutoGenDsp" SG_ 1079 NWM_TV_Anf_10 1;
BA_ "GenSigAutoGenSnd" SG_ 1079 NWM_TV_Anf_10 1;
BA_ "GenSigAutoGenDsp" SG_ 1079 NWM_TV_Anf_11 1;
BA_ "GenSigAutoGenSnd" SG_ 1079 NWM_TV_Anf_11 1;
BA_ "GenSigAutoGenDsp" SG_ 1079 NWM_TV_Anf_12 1;
BA_ "GenSigAutoGenSnd" SG_ 1079 NWM_TV_Anf_12 1;
BA_ "GenSigAutoGenDsp" SG_ 1079 NWM_TV_Anf_13 1;
BA_ "GenSigAutoGenSnd" SG_ 1079 NWM_TV_Anf_13 1;
BA_ "GenSigAutoGenDsp" SG_ 1079 NWM_TV_Anf_14 1;
BA_ "GenSigAutoGenSnd" SG_ 1079 NWM_TV_Anf_14 1;
BA_ "GenSigAutoGenDsp" SG_ 1079 NWM_TV_Anf_15 1;
BA_ "GenSigAutoGenSnd" SG_ 1079 NWM_TV_Anf_15 1;
BA_ "GenSigAutoGenDsp" SG_ 1079 NWM_TV_Anf_16 1;
BA_ "GenSigAutoGenSnd" SG_ 1079 NWM_TV_Anf_16 1;
BA_ "GenSigAutoGenDsp" SG_ 1175 PH_Abschaltursache 1;
BA_ "GenSigAutoGenSnd" SG_ 1175 PH_Abschaltursache 1;
BA_ "GenSigSendType" SG_ 1175 PH_Abschaltursache 3;
BA_ "GenSigSwitchedByIgnition" SG_ 1175 PH_Abschaltursache 1;
BA_ "Fehlerwert" SG_ 1175 PH_Abschaltursache 7;
BA_ "GenSigAutoGenDsp" SG_ 1175 PH_Opt_Anzeige_V_ein 1;
BA_ "GenSigAutoGenSnd" SG_ 1175 PH_Opt_Anzeige_V_ein 1;
BA_ "GenSigSendType" SG_ 1175 PH_Opt_Anzeige_V_ein 3;
BA_ "GenSigSwitchedByIgnition" SG_ 1175 PH_Opt_Anzeige_V_ein 1;
BA_ "GenSigAutoGenDsp" SG_ 1175 PH_Opt_Anzeige_H_ein 1;
BA_ "GenSigAutoGenSnd" SG_ 1175 PH_Opt_Anzeige_H_ein 1;
BA_ "GenSigSendType" SG_ 1175 PH_Opt_Anzeige_H_ein 3;
BA_ "GenSigSwitchedByIgnition" SG_ 1175 PH_Opt_Anzeige_H_ein 1;
BA_ "GenSigAutoGenDsp" SG_ 1175 PH_Opt_Anz_V_Hindernis 1;
BA_ "GenSigAutoGenSnd" SG_ 1175 PH_Opt_Anz_V_Hindernis 1;
BA_ "GenSigSendType" SG_ 1175 PH_Opt_Anz_V_Hindernis 3;
BA_ "GenSigSwitchedByIgnition" SG_ 1175 PH_Opt_Anz_V_Hindernis 1;
BA_ "GenSigAutoGenDsp" SG_ 1175 PH_Opt_Anz_H_Hindernis 1;
BA_ "GenSigAutoGenSnd" SG_ 1175 PH_Opt_Anz_H_Hindernis 1;
BA_ "GenSigSendType" SG_ 1175 PH_Opt_Anz_H_Hindernis 3;
BA_ "GenSigSwitchedByIgnition" SG_ 1175 PH_Opt_Anz_H_Hindernis 1;
BA_ "GenSigAutoGenDsp" SG_ 1175 PH_Tongeber_V_aktiv 1;
BA_ "GenSigAutoGenSnd" SG_ 1175 PH_Tongeber_V_aktiv 1;
BA_ "GenSigSendType" SG_ 1175 PH_Tongeber_V_aktiv 3;
BA_ "GenSigSwitchedByIgnition" SG_ 1175 PH_Tongeber_V_aktiv 1;
BA_ "GenSigAutoGenDsp" SG_ 1175 PH_Tongeber_H_aktiv 1;
BA_ "GenSigAutoGenSnd" SG_ 1175 PH_Tongeber_H_aktiv 1;
BA_ "GenSigSendType" SG_ 1175 PH_Tongeber_H_aktiv 3;
BA_ "GenSigSwitchedByIgnition" SG_ 1175 PH_Tongeber_H_aktiv 1;
BA_ "GenSigAutoGenDsp" SG_ 1175 PH_Tongeber_mute 1;
BA_ "GenSigAutoGenSnd" SG_ 1175 PH_Tongeber_mute 1;
BA_ "GenSigSendType" SG_ 1175 PH_Tongeber_mute 3;
BA_ "GenSigSwitchedByIgnition" SG_ 1175 PH_Tongeber_mute 1;
BA_ "GenSigAutoGenDsp" SG_ 1175 PH_Anf_Audioabsenkung 1;
BA_ "GenSigAutoGenSnd" SG_ 1175 PH_Anf_Audioabsenkung 1;
BA_ "GenSigSendType" SG_ 1175 PH_Anf_Audioabsenkung 3;
BA_ "GenSigSwitchedByIgnition" SG_ 1175 PH_Anf_Audioabsenkung 1;
BA_ "GenSigAutoGenDsp" SG_ 1175 PH_Frequenz_hinten 1;
BA_ "GenSigAutoGenSnd" SG_ 1175 PH_Frequenz_hinten 1;
BA_ "GenSigSendType" SG_ 1175 PH_Frequenz_hinten 0;
BA_ "GenSigSwitchedByIgnition" SG_ 1175 PH_Frequenz_hinten 1;
BA_ "GenSigAutoGenDsp" SG_ 1175 PH_Lautstaerke_hinten 1;
BA_ "GenSigAutoGenSnd" SG_ 1175 PH_Lautstaerke_hinten 1;
BA_ "GenSigSendType" SG_ 1175 PH_Lautstaerke_hinten 0;
BA_ "GenSigSwitchedByIgnition" SG_ 1175 PH_Lautstaerke_hinten 1;
BA_ "GenSigAutoGenDsp" SG_ 1175 PH_Frequenz_vorn 1;
BA_ "GenSigAutoGenSnd" SG_ 1175 PH_Frequenz_vorn 1;
BA_ "GenSigSendType" SG_ 1175 PH_Frequenz_vorn 0;
BA_ "GenSigSwitchedByIgnition" SG_ 1175 PH_Frequenz_vorn 1;
BA_ "GenSigAutoGenDsp" SG_ 1175 PH_Lautstaerke_vorn 1;
BA_ "GenSigAutoGenSnd" SG_ 1175 PH_Lautstaerke_vorn 1;
BA_ "GenSigSendType" SG_ 1175 PH_Lautstaerke_vorn 0;
BA_ "GenSigSwitchedByIgnition" SG_ 1175 PH_Lautstaerke_vorn 1;
BA_ "GenSigAutoGenDsp" SG_ 1175 PH_Trigger_Bildaufschaltung 1;
BA_ "GenSigAutoGenSnd" SG_ 1175 PH_Trigger_Bildaufschaltung 1;
BA_ "GenSigSendType" SG_ 1175 PH_Trigger_Bildaufschaltung 3;
BA_ "GenSigSwitchedByIgnition" SG_ 1175 PH_Trigger_Bildaufschaltung 1;
BA_ "GenSigAutoGenDsp" SG_ 1175 PH_StartStopp_Info 1;
BA_ "GenSigAutoGenSnd" SG_ 1175 PH_StartStopp_Info 1;
BA_ "GenSigSendType" SG_ 1175 PH_StartStopp_Info 3;
BA_ "GenSigSwitchedByIgnition" SG_ 1175 PH_StartStopp_Info 1;
BA_ "GenSigAutoGenDsp" SG_ 1175 PH_Aufbauten_erk 1;
BA_ "GenSigAutoGenSnd" SG_ 1175 PH_Aufbauten_erk 1;
BA_ "GenSigSendType" SG_ 1175 PH_Aufbauten_erk 3;
BA_ "GenSigSwitchedByIgnition" SG_ 1175 PH_Aufbauten_erk 1;
BA_ "GenSigAutoGenDsp" SG_ 1175 PH_BerErk_vorn 1;
BA_ "GenSigAutoGenSnd" SG_ 1175 PH_BerErk_vorn 1;
BA_ "GenSigSendType" SG_ 1175 PH_BerErk_vorn 3;
BA_ "GenSigSwitchedByIgnition" SG_ 1175 PH_BerErk_vorn 1;
BA_ "GenSigAutoGenDsp" SG_ 1175 PH_BerErk_hinten 1;
BA_ "GenSigAutoGenSnd" SG_ 1175 PH_BerErk_hinten 1;
BA_ "GenSigSendType" SG_ 1175 PH_BerErk_hinten 3;
BA_ "GenSigSwitchedByIgnition" SG_ 1175 PH_BerErk_hinten 1;
BA_ "GenSigAutoGenDsp" SG_ 1175 PH_defekt 1;
BA_ "GenSigAutoGenSnd" SG_ 1175 PH_defekt 1;
BA_ "GenSigSendType" SG_ 1175 PH_defekt 3;
BA_ "GenSigSwitchedByIgnition" SG_ 1175 PH_defekt 1;
BA_ "GenSigAutoGenDsp" SG_ 1175 PH_gestoert 1;
BA_ "GenSigAutoGenSnd" SG_ 1175 PH_gestoert 1;
BA_ "GenSigSendType" SG_ 1175 PH_gestoert 3;
BA_ "GenSigSwitchedByIgnition" SG_ 1175 PH_gestoert 1;
BA_ "GenSigAutoGenDsp" SG_ 1175 PH_Systemzustand 1;
BA_ "GenSigAutoGenSnd" SG_ 1175 PH_Systemzustand 1;
BA_ "GenSigSendType" SG_ 1175 PH_Systemzustand 3;
BA_ "GenSigSwitchedByIgnition" SG_ 1175 PH_Systemzustand 1;
BA_ "GenSigAutoGenDsp" SG_ 1175 PH_Display_Kundenwunsch 1;
BA_ "GenSigAutoGenSnd" SG_ 1175 PH_Display_Kundenwunsch 1;
BA_ "GenSigSendType" SG_ 1175 PH_Display_Kundenwunsch 3;
BA_ "GenSigSwitchedByIgnition" SG_ 1175 PH_Display_Kundenwunsch 1;
BA_ "GenSigAutoGenDsp" SG_ 1175 PH_KD_Fehler 1;
BA_ "GenSigAutoGenSnd" SG_ 1175 PH_KD_Fehler 1;
BA_ "GenSigSendType" SG_ 1175 PH_KD_Fehler 3;
BA_ "GenSigSwitchedByIgnition" SG_ 1175 PH_KD_Fehler 1;
BA_ "Fehlerwert" SG_ 1175 PH_KD_Fehler 1;
BA_ "GenSigAutoGenDsp" SG_ 929 PSD_Pos_Segment_ID 1;
BA_ "GenSigAutoGenSnd" SG_ 929 PSD_Pos_Segment_ID 1;
BA_ "GenSigSendType" SG_ 929 PSD_Pos_Segment_ID 0;
BA_ "GenSigAutoGenDsp" SG_ 929 PSD_Pos_Segmentlaenge 1;
BA_ "GenSigAutoGenSnd" SG_ 929 PSD_Pos_Segmentlaenge 1;
BA_ "GenSigSendType" SG_ 929 PSD_Pos_Segmentlaenge 0;
BA_ "GenSigAutoGenDsp" SG_ 929 PSD_Pos_Inhibitzeit 1;
BA_ "GenSigAutoGenSnd" SG_ 929 PSD_Pos_Inhibitzeit 1;
BA_ "GenSigSendType" SG_ 929 PSD_Pos_Inhibitzeit 0;
BA_ "GenSigAutoGenDsp" SG_ 929 PSD_Pos_Standort 1;
BA_ "GenSigAutoGenSnd" SG_ 929 PSD_Pos_Standort 1;
BA_ "GenSigSendType" SG_ 929 PSD_Pos_Standort 0;
BA_ "GenSigAutoGenDsp" SG_ 929 PSD_Pos_Laengsfehler 1;
BA_ "GenSigAutoGenSnd" SG_ 929 PSD_Pos_Laengsfehler 1;
BA_ "GenSigSendType" SG_ 929 PSD_Pos_Laengsfehler 0;
BA_ "GenSigAutoGenDsp" SG_ 929 PSD_Segment_ID 1;
BA_ "GenSigAutoGenSnd" SG_ 929 PSD_Segment_ID 1;
BA_ "GenSigSendType" SG_ 929 PSD_Segment_ID 0;
BA_ "GenSigAutoGenDsp" SG_ 929 PSD_Vorgaenger_Segment_ID 1;
BA_ "GenSigAutoGenSnd" SG_ 929 PSD_Vorgaenger_Segment_ID 1;
BA_ "GenSigSendType" SG_ 929 PSD_Vorgaenger_Segment_ID 0;
BA_ "GenSigAutoGenDsp" SG_ 929 PSD_Strassenklasse 1;
BA_ "GenSigAutoGenSnd" SG_ 929 PSD_Strassenklasse 1;
BA_ "GenSigSendType" SG_ 929 PSD_Strassenklasse 0;
BA_ "GenSigAutoGenDsp" SG_ 929 PSD_Segmentlaenge 1;
BA_ "GenSigAutoGenSnd" SG_ 929 PSD_Segmentlaenge 1;
BA_ "GenSigSendType" SG_ 929 PSD_Segmentlaenge 0;
BA_ "GenSigAutoGenDsp" SG_ 929 PSD_Rampe 1;
BA_ "GenSigAutoGenSnd" SG_ 929 PSD_Rampe 1;
BA_ "GenSigSendType" SG_ 929 PSD_Rampe 0;
BA_ "GenSigAutoGenDsp" SG_ 929 PSD_Endkruemmung 1;
BA_ "GenSigAutoGenSnd" SG_ 929 PSD_Endkruemmung 1;
BA_ "GenSigSendType" SG_ 929 PSD_Endkruemmung 0;
BA_ "GenSigAutoGenDsp" SG_ 929 PSD_Endkruemmung_Vorz 1;
BA_ "GenSigAutoGenSnd" SG_ 929 PSD_Endkruemmung_Vorz 1;
BA_ "GenSigSendType" SG_ 929 PSD_Endkruemmung_Vorz 0;
BA_ "GenSigAutoGenDsp" SG_ 929 PSD_Endsteigung 1;
BA_ "GenSigAutoGenSnd" SG_ 929 PSD_Endsteigung 1;
BA_ "GenSigSendType" SG_ 929 PSD_Endsteigung 0;
BA_ "GenSigAutoGenDsp" SG_ 929 PSD_Endsteigung_Vorz 1;
BA_ "GenSigAutoGenSnd" SG_ 929 PSD_Endsteigung_Vorz 1;
BA_ "GenSigSendType" SG_ 929 PSD_Endsteigung_Vorz 0;
BA_ "GenSigAutoGenDsp" SG_ 929 PSD_ADAS_Qualitaet 1;
BA_ "GenSigAutoGenSnd" SG_ 929 PSD_ADAS_Qualitaet 1;
BA_ "GenSigSendType" SG_ 929 PSD_ADAS_Qualitaet 0;
BA_ "GenSigAutoGenDsp" SG_ 929 PSD_Fahrspuren 1;
BA_ "GenSigAutoGenSnd" SG_ 929 PSD_Fahrspuren 1;
BA_ "GenSigSendType" SG_ 929 PSD_Fahrspuren 0;
BA_ "GenSigAutoGenDsp" SG_ 929 PSD_wahrscheinlichster_Pfad 1;
BA_ "GenSigAutoGenSnd" SG_ 929 PSD_wahrscheinlichster_Pfad 1;
BA_ "GenSigSendType" SG_ 929 PSD_wahrscheinlichster_Pfad 0;
BA_ "GenSigAutoGenDsp" SG_ 930 PSD_Multiplex 1;
BA_ "GenSigAutoGenSnd" SG_ 930 PSD_Multiplex 1;
BA_ "GenSigSendType" SG_ 930 PSD_Multiplex 0;
BA_ "GenSigAutoGenDsp" SG_ 930 PSD_Sys_Segment_ID 1;
BA_ "GenSigAutoGenSnd" SG_ 930 PSD_Sys_Segment_ID 1;
BA_ "GenSigAutoGenDsp" SG_ 930 PSD_Abz_Segment_ID 1;
BA_ "GenSigAutoGenSnd" SG_ 930 PSD_Abz_Segment_ID 1;
BA_ "GenSigAutoGenDsp" SG_ 930 PSD_Ges_Segment_ID 1;
BA_ "GenSigAutoGenSnd" SG_ 930 PSD_Ges_Segment_ID 1;
BA_ "GenSigAutoGenDsp" SG_ 930 PSD_Ort_Laenge_VZ 1;
BA_ "GenSigAutoGenSnd" SG_ 930 PSD_Ort_Laenge_VZ 1;
BA_ "GenSigAutoGenDsp" SG_ 930 PSD_Ort_Laenge 1;
BA_ "GenSigAutoGenSnd" SG_ 930 PSD_Ort_Laenge 1;
BA_ "GenSigAutoGenDsp" SG_ 930 PSD_Sys_Laendercode 1;
BA_ "GenSigAutoGenSnd" SG_ 930 PSD_Sys_Laendercode 1;
BA_ "GenSigAutoGenDsp" SG_ 930 PSD_Abz_Segmentlaenge 1;
BA_ "GenSigAutoGenSnd" SG_ 930 PSD_Abz_Segmentlaenge 1;
BA_ "GenSigAutoGenDsp" SG_ 930 PSD_Ges_Geschwindigkeit 1;
BA_ "GenSigAutoGenSnd" SG_ 930 PSD_Ges_Geschwindigkeit 1;
BA_ "GenSigAutoGenDsp" SG_ 930 PSD_Ges_Geschwindigkeit_Typ 1;
BA_ "GenSigAutoGenSnd" SG_ 930 PSD_Ges_Geschwindigkeit_Typ 1;
BA_ "GenSigAutoGenDsp" SG_ 930 PSD_Ges_Geschwindigkeit_Gespann 1;
BA_ "GenSigAutoGenSnd" SG_ 930 PSD_Ges_Geschwindigkeit_Gespann 1;
BA_ "GenSigAutoGenDsp" SG_ 930 PSD_Abz_Vorgaenger_Segment_ID 1;
BA_ "GenSigAutoGenSnd" SG_ 930 PSD_Abz_Vorgaenger_Segment_ID 1;
BA_ "GenSigAutoGenDsp" SG_ 930 PSD_Sys_Geschwindigkeit_Einheit 1;
BA_ "GenSigAutoGenSnd" SG_ 930 PSD_Sys_Geschwindigkeit_Einheit 1;
BA_ "GenSigAutoGenDsp" SG_ 930 PSD_Ges_Geschwindigkeit_Witter 1;
BA_ "GenSigAutoGenSnd" SG_ 930 PSD_Ges_Geschwindigkeit_Witter 1;
BA_ "GenSigAutoGenDsp" SG_ 930 PSD_Sys_Verkehrsrichtung 1;
BA_ "GenSigAutoGenSnd" SG_ 930 PSD_Sys_Verkehrsrichtung 1;
BA_ "GenSigAutoGenDsp" SG_ 930 PSD_Sys_Release_Monat 1;
BA_ "GenSigAutoGenSnd" SG_ 930 PSD_Sys_Release_Monat 1;
BA_ "GenSigAutoGenDsp" SG_ 930 PSD_Ges_Geschwindigkeit_Tag_Anf 1;
BA_ "GenSigAutoGenSnd" SG_ 930 PSD_Ges_Geschwindigkeit_Tag_Anf 1;
BA_ "GenSigAutoGenDsp" SG_ 930 PSD_Abz_Geschwindigkeit 1;
BA_ "GenSigAutoGenSnd" SG_ 930 PSD_Abz_Geschwindigkeit 1;
BA_ "GenSigAutoGenDsp" SG_ 930 PSD_Ges_Geschwindigkeit_Tag_Ende 1;
BA_ "GenSigAutoGenSnd" SG_ 930 PSD_Ges_Geschwindigkeit_Tag_Ende 1;
BA_ "GenSigAutoGenDsp" SG_ 930 PSD_Sys_Release_Jahr 1;
BA_ "GenSigAutoGenSnd" SG_ 930 PSD_Sys_Release_Jahr 1;
BA_ "GenSigAutoGenDsp" SG_ 930 PSD_Ges_Geschwindigkeit_Std_Anf 1;
BA_ "GenSigAutoGenSnd" SG_ 930 PSD_Ges_Geschwindigkeit_Std_Anf 1;
BA_ "GenSigAutoGenDsp" SG_ 930 PSD_Abz_Geschwindigkeit_Typ 1;
BA_ "GenSigAutoGenSnd" SG_ 930 PSD_Abz_Geschwindigkeit_Typ 1;
BA_ "GenSigAutoGenDsp" SG_ 930 PSD_Sys_Tunnel 1;
BA_ "GenSigAutoGenSnd" SG_ 930 PSD_Sys_Tunnel 1;
BA_ "GenSigAutoGenDsp" SG_ 930 PSD_Abz_Strassenklasse 1;
BA_ "GenSigAutoGenSnd" SG_ 930 PSD_Abz_Strassenklasse 1;
BA_ "GenSigAutoGenDsp" SG_ 930 PSD_Sys_Bruecke 1;
BA_ "GenSigAutoGenSnd" SG_ 930 PSD_Sys_Bruecke 1;
BA_ "GenSigAutoGenDsp" SG_ 930 PSD_Ort_Breite_VZ 1;
BA_ "GenSigAutoGenSnd" SG_ 930 PSD_Ort_Breite_VZ 1;
BA_ "GenSigAutoGenDsp" SG_ 930 PSD_Sys_Fahrsp_Gegenr 1;
BA_ "GenSigAutoGenSnd" SG_ 930 PSD_Sys_Fahrsp_Gegenr 1;
BA_ "GenSigAutoGenDsp" SG_ 930 PSD_Abz_ADAS_Qualitaet 1;
BA_ "GenSigAutoGenSnd" SG_ 930 PSD_Abz_ADAS_Qualitaet 1;
BA_ "GenSigAutoGenDsp" SG_ 930 PSD_Ges_Geschwindigkeit_Std_Ende 1;
BA_ "GenSigAutoGenSnd" SG_ 930 PSD_Ges_Geschwindigkeit_Std_Ende 1;
BA_ "GenSigAutoGenDsp" SG_ 930 PSD_Ort_Breite 1;
BA_ "GenSigAutoGenSnd" SG_ 930 PSD_Ort_Breite 1;
BA_ "GenSigAutoGenDsp" SG_ 930 PSD_Abz_Abzweigerichtung 1;
BA_ "GenSigAutoGenSnd" SG_ 930 PSD_Abz_Abzweigerichtung 1;
BA_ "GenSigAutoGenDsp" SG_ 930 PSD_Sys_TMC_Baustelle 1;
BA_ "GenSigAutoGenSnd" SG_ 930 PSD_Sys_TMC_Baustelle 1;
BA_ "GenSigAutoGenDsp" SG_ 930 PSD_Abz_Abzweigewinkel 1;
BA_ "GenSigAutoGenSnd" SG_ 930 PSD_Abz_Abzweigewinkel 1;
BA_ "GenSigAutoGenDsp" SG_ 930 PSD_Sys_TMC_Stau 1;
BA_ "GenSigAutoGenSnd" SG_ 930 PSD_Sys_TMC_Stau 1;
BA_ "GenSigAutoGenDsp" SG_ 930 PSD_Ges_alter_Geschw 1;
BA_ "GenSigAutoGenSnd" SG_ 930 PSD_Ges_alter_Geschw 1;
BA_ "GenSigAutoGenDsp" SG_ 930 PSD_Abz_Rampe 1;
BA_ "GenSigAutoGenSnd" SG_ 930 PSD_Abz_Rampe 1;
BA_ "GenSigAutoGenDsp" SG_ 930 PSD_Abz_Anfangskruemmung 1;
BA_ "GenSigAutoGenSnd" SG_ 930 PSD_Abz_Anfangskruemmung 1;
BA_ "GenSigAutoGenDsp" SG_ 930 PSD_Ges_alter_Geschw_Gespann 1;
BA_ "GenSigAutoGenSnd" SG_ 930 PSD_Ges_alter_Geschw_Gespann 1;
BA_ "GenSigAutoGenDsp" SG_ 930 PSD_Ges_alter_Geschw_Witter 1;
BA_ "GenSigAutoGenSnd" SG_ 930 PSD_Ges_alter_Geschw_Witter 1;
BA_ "GenSigAutoGenDsp" SG_ 930 PSD_Ges_alter_Geschw_Tag_Anf 1;
BA_ "GenSigAutoGenSnd" SG_ 930 PSD_Ges_alter_Geschw_Tag_Anf 1;
BA_ "GenSigAutoGenDsp" SG_ 930 PSD_Abz_Anfangskruemmung_Vorz 1;
BA_ "GenSigAutoGenSnd" SG_ 930 PSD_Abz_Anfangskruemmung_Vorz 1;
BA_ "GenSigAutoGenDsp" SG_ 930 PSD_Sys_Anfangskruemmung 1;
BA_ "GenSigAutoGenSnd" SG_ 930 PSD_Sys_Anfangskruemmung 1;
BA_ "GenSigAutoGenDsp" SG_ 930 PSD_Abz_Endkruemmung 1;
BA_ "GenSigAutoGenSnd" SG_ 930 PSD_Abz_Endkruemmung 1;
BA_ "GenSigAutoGenDsp" SG_ 930 PSD_Ges_alter_Geschw_Tag_Ende 1;
BA_ "GenSigAutoGenSnd" SG_ 930 PSD_Ges_alter_Geschw_Tag_Ende 1;
BA_ "GenSigAutoGenDsp" SG_ 930 PSD_Ges_alter_Geschw_Std_Anf 1;
BA_ "GenSigAutoGenSnd" SG_ 930 PSD_Ges_alter_Geschw_Std_Anf 1;
BA_ "GenSigAutoGenDsp" SG_ 930 PSD_Ort_Hoehe 1;
BA_ "GenSigAutoGenSnd" SG_ 930 PSD_Ort_Hoehe 1;
BA_ "GenSigAutoGenDsp" SG_ 930 PSD_Sys_Anfangskruemmung_Vorz 1;
BA_ "GenSigAutoGenSnd" SG_ 930 PSD_Sys_Anfangskruemmung_Vorz 1;
BA_ "GenSigAutoGenDsp" SG_ 930 PSD_Abz_Endkruemmung_Vorz 1;
BA_ "GenSigAutoGenSnd" SG_ 930 PSD_Abz_Endkruemmung_Vorz 1;
BA_ "GenSigAutoGenDsp" SG_ 930 PSD_Ges_alter_Geschw_Std_Ende 1;
BA_ "GenSigAutoGenSnd" SG_ 930 PSD_Ges_alter_Geschw_Std_Ende 1;
BA_ "GenSigAutoGenDsp" SG_ 930 PSD_Sys_Anfangssteigung 1;
BA_ "GenSigAutoGenSnd" SG_ 930 PSD_Sys_Anfangssteigung 1;
BA_ "GenSigAutoGenDsp" SG_ 930 PSD_Abz_Endsteigung 1;
BA_ "GenSigAutoGenSnd" SG_ 930 PSD_Abz_Endsteigung 1;
BA_ "GenSigAutoGenDsp" SG_ 930 PSD_Ges_Ueberholverbot 1;
BA_ "GenSigAutoGenSnd" SG_ 930 PSD_Ges_Ueberholverbot 1;
BA_ "GenSigAutoGenDsp" SG_ 930 PSD_Sys_Anfangssteigung_Vorz 1;
BA_ "GenSigAutoGenSnd" SG_ 930 PSD_Sys_Anfangssteigung_Vorz 1;
BA_ "GenSigAutoGenDsp" SG_ 930 PSD_Abz_Endsteigung_Vorz 1;
BA_ "GenSigAutoGenSnd" SG_ 930 PSD_Abz_Endsteigung_Vorz 1;
BA_ "GenSigAutoGenDsp" SG_ 930 PSD_Sys_Ortschaft 1;
BA_ "GenSigAutoGenSnd" SG_ 930 PSD_Sys_Ortschaft 1;
BA_ "GenSigAutoGenDsp" SG_ 930 PSD_Abz_Fahrspuren 1;
BA_ "GenSigAutoGenSnd" SG_ 930 PSD_Abz_Fahrspuren 1;
BA_ "GenSigAutoGenDsp" SG_ 930 PSD_Ges_Wechselverkehrszeichen 1;
BA_ "GenSigAutoGenSnd" SG_ 930 PSD_Ges_Wechselverkehrszeichen 1;
BA_ "GenSigAutoGenDsp" SG_ 930 PSD_Sys_Digitalisierung 1;
BA_ "GenSigAutoGenSnd" SG_ 930 PSD_Sys_Digitalisierung 1;
BA_ "GenSigAutoGenDsp" SG_ 930 PSD_Sys_Zielfuehrung 1;
BA_ "GenSigAutoGenSnd" SG_ 930 PSD_Sys_Zielfuehrung 1;
BA_ "GenSigAutoGenDsp" SG_ 930 PSD_Abz_wahrscheinlichster_Pfad 1;
BA_ "GenSigAutoGenSnd" SG_ 930 PSD_Abz_wahrscheinlichster_Pfad 1;
VAL_ 657 ZK1_LED_Steuerung 1 "Lampe_ein" 0 "Lampe_aus" ;
VAL_ 657 ZK1_Dongle_Freq 1 "_433MHZ" 0 "_315MHZ" ;
VAL_ 1075 NWM_DSP_CmdRing 1 "CmdRing" ;
VAL_ 1075 NWM_DSP_CmdAlive 1 "CmdAlive" ;
VAL_ 1075 NWM_DSP_CmdLimpHome 1 "CmdLimpHome" ;
VAL_ 1075 NWM_DSP_SleepInd 1 "SleepInd" ;
VAL_ 1075 NWM_DSP_SleepAck 1 "SleepAck" ;
VAL_ 1075 NWM_DSP_Per_WakeUp 0 "Funktionswakeup" 2 "P_WakeUp" 1 "CAN" ;
VAL_ 1075 NWM_DSP_Fkt_WakeUp 0 "Peripheriewakeup" ;
VAL_ 1075 NWM_DSP_Klemme_15 1 "KL15_ein" ;
VAL_ 1075 NWM_DSP_Diagnose 1 "Diagnose" ;
VAL_ 1075 NWM_DSP_MindestAktivZeit 1 "MindestAktivZeit" ;
VAL_ 1075 NWM_DSP_TimeOut_Fehler 1 "TimeOut_FSP" ;
VAL_ 1075 NWM_DSP_CAN_Diag_deaktiv 1 "Diag_inaktiv" ;
VAL_ 1075 NWM_DSP_KompSchutz 1 "Komponentenschutz" ;
VAL_ 1075 NWM_DSP_Mute_Mode 1 "Mute_Mode" ;
VAL_ 1075 NWM_DSP_Transport_Mode 1 "Transport_Mode" ;
VAL_ 1075 NWM_DSP_Abschaltst_aktiv 1 "Abschaltstufe" ;
VAL_ 1075 NWM_DSP_Eindraht_Fehler 1 "Eindraht" ;
VAL_ 1077 NWM_MDI_CmdRing 1 "CmdRing" ;
VAL_ 1077 NWM_MDI_CmdAlive 1 "CmdAlive" ;
VAL_ 1077 NWM_MDI_CmdLimpHome 1 "CmdLimpHome" ;
VAL_ 1077 NWM_MDI_SleepInd 1 "SleepInd" ;
VAL_ 1077 NWM_MDI_SleepAck 1 "SleepAck" ;
VAL_ 1077 NWM_MDI_Per_WakeUp 1 "CAN" 0 "Funktionswakeup" 2 "P_WakeUp" ;
VAL_ 1077 NWM_MDI_Fkt_WakeUp 0 "Peripheriewakeup" ;
VAL_ 1077 NWM_MDI_Klemme_15 1 "KL15_ein" ;
VAL_ 1077 NWM_MDI_Diagnose 1 "Diagnose" ;
VAL_ 1077 NWM_MDI_MindestAktivZeit 1 "MindestAktivZeit" ;
VAL_ 1077 NWM_MDI_TimeOut_Fehler 1 "TimeOut_FSP" ;
VAL_ 1077 NWM_MDI_CAN_Diag_deaktiv 1 "Diag_inaktiv" ;
VAL_ 1077 NWM_MDI_KompSchutz 1 "Komponentenschutz" ;
VAL_ 1077 NWM_MDI_Mute_Mode 1 "Mute_Mode" ;
VAL_ 1077 NWM_MDI_Transport_Mode 1 "Transport_Mode" ;
VAL_ 1077 NWM_MDI_Abschaltst_aktiv 1 "Abschaltstufe" ;
VAL_ 1077 NWM_MDI_Eindraht_Fehler 1 "Eindraht" ;
VAL_ 1081 NWM_Radio_CmdRing 1 "CmdRing" ;
VAL_ 1081 NWM_Radio_CmdAlive 1 "CmdAlive" ;
VAL_ 1081 NWM_Radio_CmdLimpHome 1 "CmdLimpHome" ;
VAL_ 1081 NWM_Radio_SleepInd 1 "SleepInd" ;
VAL_ 1081 NWM_Radio_SleepAck 1 "SleepAck" ;
VAL_ 1081 NWM_Radio_Per_WakeUp 2 "P_WakeUp" 3 "Radio_On" 1 "CAN" 30 "KL30_Reset" 4 "Radio_Off" 0 "Funktionswakeup" 5 "KL15_HW" ;
VAL_ 1081 NWM_Radio_Fkt_WakeUp 2 "Comm_Req" 1 "Dimmung" 0 "P_WakeUp" 4 "Telefon" 3 "S_Kontakt" ;
VAL_ 1081 NWM_Radio_Klemme_15 1 "KL15_ein" ;
VAL_ 1081 NWM_Radio_Diagnose 1 "Diagnose" ;
VAL_ 1081 NWM_Radio_MindestAktivZeit 1 "MindestAktivZeit" ;
VAL_ 1081 NWM_Radio_Ursache_4 1 "Radio_BAP_Comm" ;
VAL_ 1081 NWM_Radio_Ursache_5 1 "Comm_Req" ;
VAL_ 1081 NWM_Radio_Nachlauf_1 1 "deep_sleep" ;
VAL_ 1081 NWM_Radio_Nachlauf_2 1 "Dimmung" ;
VAL_ 1081 NWM_Radio_Nachlauf_3 1 "Radio_On" ;
VAL_ 1081 NWM_Radio_Nachlauf_4 1 "Tuner_On" ;
VAL_ 1081 NWM_Radio_Nachlauf_8 1 "Flash_Update" ;
VAL_ 1081 NWM_Radio_TimeOut_Fehler 1 "TimeOut_FSP" ;
VAL_ 1081 NWM_Radio_CAN_Diag_deaktiv 1 "Diag_inaktiv" ;
VAL_ 1081 NWM_Radio_KompSchutz 1 "Komponentenschutz" ;
VAL_ 1081 NWM_Radio_Mute_Mode 1 "Mute_Mode" ;
VAL_ 1081 NWM_Radio_Transport_Mode 1 "Transport_Mode" ;
VAL_ 1081 NWM_Radio_Abschaltst_aktiv 1 "Abschaltstufe" ;
VAL_ 1081 NWM_Radio_Eindraht_Fehler 1 "Eindraht" ;
VAL_ 1065 NWM_RV_CmdRing 1 "CmdRing" ;
VAL_ 1065 NWM_RV_CmdAlive 1 "CmdAlive" ;
VAL_ 1065 NWM_RV_CmdLimpHome 1 "CmdLimpHome" ;
VAL_ 1065 NWM_RV_SleepInd 1 "SleepInd" ;
VAL_ 1065 NWM_RV_SleepAck 1 "SleepAck" ;
VAL_ 1065 NWM_RV_Per_WakeUp 1 "CAN" 2 "P_WakeUp" 0 "Funktionswakeup" 4 "KL30_Reset" ;
VAL_ 1065 NWM_RV_Fkt_WakeUp 0 "Peripheriewakeup" ;
VAL_ 1065 NWM_RV_Klemme_15 1 "KL15_ein" ;
VAL_ 1065 NWM_RV_Diagnose 1 "Diagnose" ;
VAL_ 1065 NWM_RV_MindestAktivZeit 1 "MindestAktivZeit" ;
VAL_ 1065 NWM_RV_TimeOut_Fehler 1 "TimeOut_FSP" ;
VAL_ 1065 NWM_RV_CAN_Diag_deaktiv 1 "Diag_inaktiv" ;
VAL_ 1065 NWM_RV_KompSchutz 1 "Komponentenschutz" ;
VAL_ 1065 NWM_RV_Mute_Mode 1 "Mute_Mode" ;
VAL_ 1065 NWM_RV_Transport_Mode 1 "Transport_Mode" ;
VAL_ 1065 NWM_RV_Abschaltst_aktiv 1 "Abschaltstufe" ;
VAL_ 1065 NWM_RV_Eindraht_Fehler 1 "Eindraht" ;
VAL_ 1078 NWM_RNS_CmdRing 1 "CmdRing" ;
VAL_ 1078 NWM_RNS_CmdAlive 1 "CmdAlive" ;
VAL_ 1078 NWM_RNS_CmdLimpHome 1 "CmdLimpHome" ;
VAL_ 1078 NWM_RNS_SleepInd 1 "SleepInd" ;
VAL_ 1078 NWM_RNS_SleepAck 1 "SleepAck" ;
VAL_ 1078 NWM_RNS_Per_WakeUp 3 "KL15_HW" 4 "KL30_Reset" 8 "Eject" 7 "RTC" 5 "ON_Tipper" 1 "CAN" 9 "CD_Insert" 0 "Funktionswakeup" 2 "P_WakeUp" 6 "Telefon_Mute" ;
VAL_ 1078 NWM_RNS_Fkt_WakeUp 3 "Telefon_Mute" 1 "Dimmung" 2 "Comm_Req" 0 "P_WakeUp" ;
VAL_ 1078 NWM_RNS_Klemme_15 1 "KL15_ein" ;
VAL_ 1078 NWM_RNS_Diagnose 1 "Diagnose" ;
VAL_ 1078 NWM_RNS_MindestAktivZeit 1 "MindestAktivZeit" ;
VAL_ 1078 NWM_RNS_Ursache_4 1 "Radio_BAP_Comm" ;
VAL_ 1078 NWM_RNS_Ursache_5 1 "TP20_RNS" ;
VAL_ 1078 NWM_RNS_Ursache_6 1 "TP20_RADIO" ;
VAL_ 1078 NWM_RNS_Nachlauf_2 1 "Dimmung" ;
VAL_ 1078 NWM_RNS_Nachlauf_3 1 "Telefon_Mute" ;
VAL_ 1078 NWM_RNS_TimeOut_Fehler 1 "TimeOut_FSP" ;
VAL_ 1078 NWM_RNS_CAN_Diag_deaktiv 1 "Diag_inaktiv" ;
VAL_ 1078 NWM_RNS_KompSchutz 1 "Komponentenschutz" ;
VAL_ 1078 NWM_RNS_Mute_Mode 1 "Mute_Mode" ;
VAL_ 1078 NWM_RNS_Transport_Mode 1 "Transport_Mode" ;
VAL_ 1078 NWM_RNS_Abschaltst_aktiv 1 "Abschaltstufe" ;
VAL_ 1078 NWM_RNS_Eindraht_Fehler 1 "Eindraht" ;
VAL_ 1082 NWM_TEL_CmdRing 1 "CmdRing" ;
VAL_ 1082 NWM_TEL_CmdAlive 1 "CmdAlive" ;
VAL_ 1082 NWM_TEL_CmdLimpHome 1 "CmdLimpHome" ;
VAL_ 1082 NWM_TEL_SleepInd 1 "SleepInd" ;
VAL_ 1082 NWM_TEL_SleepAck 1 "SleepAck" ;
VAL_ 1082 NWM_TEL_Per_WakeUp 1 "CAN" 2 "P_WakeUp" 0 "Funktionswakeup" ;
VAL_ 1082 NWM_TEL_Fkt_WakeUp 0 "Peripheriewakeup" ;
VAL_ 1082 NWM_TEL_Klemme_15 1 "KL15_ein" ;
VAL_ 1082 NWM_TEL_Diagnose 1 "Diagnose" ;
VAL_ 1082 NWM_TEL_MindestAktivZeit 1 "MindestAktivZeit" ;
VAL_ 1082 NWM_TEL_Ursache_4 1 "active_call" ;
VAL_ 1082 NWM_TEL_Ursache_5 1 "A2DP_streaming" ;
VAL_ 1082 NWM_TEL_TimeOut_Fehler 1 "TimeOut_FSP" ;
VAL_ 1082 NWM_TEL_CAN_Diag_deaktiv 1 "Diag_inaktiv" ;
VAL_ 1082 NWM_TEL_KompSchutz 1 "Komponentenschutz" ;
VAL_ 1082 NWM_TEL_Mute_Mode 1 "Mute_Mode" ;
VAL_ 1082 NWM_TEL_Transport_Mode 1 "Transport_Mode" ;
VAL_ 1082 NWM_TEL_Abschaltst_aktiv 1 "Abschaltstufe" ;
VAL_ 1082 NWM_TEL_Eindraht_Fehler 1 "Eindraht" ;
VAL_ 1079 NWM_TV_CmdRing 1 "CmdRing" ;
VAL_ 1079 NWM_TV_CmdAlive 1 "CmdAlive" ;
VAL_ 1079 NWM_TV_CmdLimpHome 1 "CmdLimpHome" ;
VAL_ 1079 NWM_TV_SleepInd 1 "SleepInd" ;
VAL_ 1079 NWM_TV_SleepAck 1 "SleepAck" ;
VAL_ 1079 NWM_TV_Per_WakeUp 0 "Funktionswakeup" 2 "P_WakeUp" 1 "CAN" ;
VAL_ 1079 NWM_TV_Fkt_WakeUp 0 "Peripheriewakeup" ;
VAL_ 1079 NWM_TV_Klemme_15 1 "KL15_ein" ;
VAL_ 1079 NWM_TV_Diagnose 1 "Diagnose" ;
VAL_ 1079 NWM_TV_MindestAktivZeit 1 "MindestAktivZeit" ;
VAL_ 1079 NWM_TV_TimeOut_Fehler 1 "TimeOut_FSP" ;
VAL_ 1079 NWM_TV_CAN_Diag_deaktiv 1 "Diag_inaktiv" ;
VAL_ 1079 NWM_TV_KompSchutz 1 "Komponentenschutz" ;
VAL_ 1079 NWM_TV_Mute_Mode 1 "Mute_Mode" ;
VAL_ 1079 NWM_TV_Transport_Mode 1 "Transport_Mode" ;
VAL_ 1079 NWM_TV_Abschaltst_aktiv 1 "Abschaltstufe" ;
VAL_ 1079 NWM_TV_Eindraht_Fehler 1 "Eindraht" ;
VAL_ 1175 PH_Abschaltursache 3 "PDC_Taster_Absch" 1 "Absch_Herausn_RGang" 4 "PLA_Absch" 5 "Kl_15_Bit_Null" 0 "keine_Sys_aktiv" 2 "v_Absch" 7 "Fehler" ;
VAL_ 1175 PH_Opt_Anzeige_V_ein 1 "opt_Anzeige_vorn_aktiv" ;
VAL_ 1175 PH_Opt_Anzeige_H_ein 1 "opt_Anzeige_hinten_aktiv" ;
VAL_ 1175 PH_Opt_Anz_V_Hindernis 1 "vorn_Hind_im_Warnbereich" ;
VAL_ 1175 PH_Opt_Anz_H_Hindernis 1 "hinten_Hind_im_Warnbereich" ;
VAL_ 1175 PH_Tongeber_V_aktiv 1 "Tongeber_vorne_aktiv" ;
VAL_ 1175 PH_Tongeber_H_aktiv 1 "Tongeber_hinten_aktiv" ;
VAL_ 1175 PH_Tongeber_mute 1 "Tongeber_stumm" ;
VAL_ 1175 PH_Anf_Audioabsenkung 1 "Anf_Audioabsenkung" ;
VAL_ 1175 PH_StartStopp_Info 3 "Systemfehler" 0 "Motorlauf_nn" 1 "Stoppverbot_Motoranlauf_nn" 2 "Motoranlauf_notwendig" ;
VAL_ 1175 PH_BerErk_vorn 1 "Vorwarnbereich_nur_NFZ" 2 "Hauptwarnbereich" 0 "Init" 3 "Kollisionsbereich" ;
VAL_ 1175 PH_BerErk_hinten 0 "Init" 1 "Vorwarnbereich_nur_NFZ" 2 "Hauptwarnbereich" 3 "Kollisionsbereich" ;
VAL_ 1175 PH_defekt 1 "PH_wg_Defekt_deaktiv" ;
VAL_ 1175 PH_gestoert 1 "PH_wg_Stoerung_temp_deaktiv" ;
VAL_ 1175 PH_Systemzustand 7 "Fehler_gestoert" 1 "Anlage_wg_RGang_akt" 2 "Anlage_man_akt" 3 "Anlage_auto_akt" 0 "Anlage_aus" ;
VAL_ 1175 PH_Display_Kundenwunsch 2 "Rear_View" 0 "Anzeige_aus" 1 "Graphik" 3 "automatisch" ;
VAL_ 1175 PH_KD_Fehler 1 "Fehlerspeichereintrag" 0 "kein_Fehlerspeichereintrag" ;
VAL_ 929 PSD_Pos_Segment_ID 1 "Fehlerwert" 0 "keine Position gegeben" ;
VAL_ 929 PSD_Pos_Standort 0 "mehrdeutiger_Standort" 1 "eindeutiger_Standort" ;
VAL_ 929 PSD_Pos_Laengsfehler 2 "<5m" 4 "<20m" 0 "keine Prädiktion (off-road)" 6 ">50m" 1 "<2m" 7 "nicht erlaubt" 3 "<10m" 5 "<50m" ;
VAL_ 929 PSD_Segment_ID 1 "Fehlerwert" 0 "keine Segmentinformationen vorhanden" ;
VAL_ 929 PSD_Vorgaenger_Segment_ID 1 "Fehlerwert" 0 "keine Segmentinformation vorhanden" ;
VAL_ 929 PSD_Strassenklasse 1 "Ortsstrasse" 3 "Autobahn" 2 "Bundes_Landstrasse" 0 "Rest_Feldweg_Schotterweg_Privatweg" ;
VAL_ 929 PSD_Rampe 1 "Auffahrt_Einbahnstr" 2 "Abfahrt_Einbahnstr" 3 "Einbahnstrasse" 0 "Strasse_mit_Gegenverkehr" ;
VAL_ 929 PSD_Endkruemmung 255 "Gerade" ;
VAL_ 929 PSD_Endkruemmung_Vorz 1 "Kruemmung_negativ" 0 "Kruemmung_positiv" ;
VAL_ 929 PSD_Endsteigung 30 "gleich_oder_mehr_15_Prozent_Steigung" 31 "nicht_definiert" ;
VAL_ 929 PSD_Endsteigung_Vorz 1 "Steigung" 0 "Gefaelle" ;
VAL_ 929 PSD_ADAS_Qualitaet 0 "keine_ADAS_Qualitaet" 1 "ADAS_Qualitaet" ;
VAL_ 929 PSD_Fahrspuren 0 "Einbahnstrasse_in_falscher_Richtung" 1 "eine_Fahrspur" 3 "drei_Fahrspuren" 2 "zwei_Fahrspuren" ;
VAL_ 929 PSD_wahrscheinlichster_Pfad 0 "Pfad_mit_geringer_Wahrscheinlichkeit" 1 "wahrscheinlichster_Pfad" ;
VAL_ 930 PSD_Multiplex 0 "für System Informationen, die sich nur langsam ändern" 1 "Informationen über ein Streckensegment" 2 "für Informationen über Geschwindigkeitsbegrenzungen und mögliche Einschränkungen der Geschwindigkeitsbegrenzungen" 3 "Fahrzeugposition aus der Koppelortung" ;
VAL_ 930 PSD_Sys_Segment_ID 1 "nicht zulaessig" 0 "keine Segmentinformationen vorhanden" ;
VAL_ 930 PSD_Abz_Segment_ID 0 "keine Segmentinformationen vorhanden" 1 "nicht zulaessig" ;
VAL_ 930 PSD_Ges_Segment_ID 0 "keine Segmentinformationen vorhanden" 1 "nicht zulaessig" ;
VAL_ 930 PSD_Ort_Laenge_VZ 1 "West" 0 "Ost" ;
VAL_ 930 PSD_Ort_Laenge 33554431 "	Keine GPS Position verfuegbar" ;
VAL_ 930 PSD_Ges_Geschwindigkeit 1 "0 km/h < v_max <  5 km/h" 7 "30 km/h ¿ v_max < 35 km/h" 10 "45 km/h ¿ v_max < 50 km/h" 19 "130 km/h ¿ v_max < 140 km/h" 22 "160 km/h ¿ v_max" 13 "70 km/h ¿ v_max < 80 km/h" 18 "120 km/h ¿ v_max < 130 km/h" 14 "80 km/h ¿ v_max < 90 km/h" 15 "90 km/h ¿ v_max < 100 km/h" 6 "25 km/h ¿ v_max < 30 km/h" 20 "140 km/h ¿ v_max < 150 km/h" 11 "50 km/h ¿ v_max < 60 km/h" 23 "Geschwindigkeitsgebot aufgehoben" 3 "10 km/h ¿ v_max < 15 km/h" 12 "60 km/h ¿ v_max < 70 km/h" 24 "..0x1F ungültig" 5 "20 km/h ¿ v_max < 25 km/h" 16 "100 km/h ¿ v_max < 110 km/h" 17 "110 km/h ¿ v_max < 120 km/h" 9 "40 km/h ¿ v_max < 45 km/h" 21 "150 km/h ¿ v_max < 160 km/h" 2 "5 km/h ¿ v_max < 10km/h" 4 "15 km/h ¿ v_max < 20 km/h" 8 "35 km/h ¿ v_max < 40 km/h" 0 "Kein Geschwindigkeitsgebot" ;
VAL_ 930 PSD_Ges_Geschwindigkeit_Typ 1 "Der Wert im Attribut Geschwindigkeitsbegrenzung entspricht einer explizit angegebenen Begrenzung der Geschwindigkeit." 0 "Der Wert im Attribut Geschwindigkeitsbegrenzung entspricht der Geschwindigkeitsklasse von Navteq." ;
VAL_ 930 PSD_Ges_Geschwindigkeit_Gespann 2 "LKW, Busse, etc." 0 "alle Fahrzeuge" 1 "PKW mit Gespann" ;
VAL_ 930 PSD_Abz_Vorgaenger_Segment_ID 1 "nicht zulaessig" 0 "keine Segmentinformationen vorhanden" ;
VAL_ 930 PSD_Sys_Geschwindigkeit_Einheit 0 "km/h" 1 "mph" ;
VAL_ 930 PSD_Ges_Geschwindigkeit_Witter 3 "Nebel" 0 "Witterungsunabhängig" 1 "Nässe, Regen, Niederschlag" 2 "Glätte" ;
VAL_ 930 PSD_Sys_Verkehrsrichtung 0 "Rechtsverkehr" 1 "Linksverkehr" ;
VAL_ 930 PSD_Ges_Geschwindigkeit_Tag_Anf 3 "Mittwoch" 7 "Sonntag" 0 "kein Beginn definiert" 5 "Freitag" 6 "Samstag" 2 "Dienstag" 1 "Montag" 4 "Donnerstag" ;
VAL_ 930 PSD_Abz_Geschwindigkeit 19 "130 km/h ¿ v_max < 140 km/h" 12 "60 km/h ¿ v_max < 70 km/h" 7 "30 km/h ¿ v_max < 35 km/h" 16 "100 km/h ¿ v_max < 110 km/h" 23 "Geschwindigkeitsgebot aufgehoben" 15 "90 km/h ¿ v_max < 100 km/h" 11 "50 km/h ¿ v_max < 60 km/h" 6 "25 km/h ¿ v_max < 30 km/h" 8 "35 km/h ¿ v_max < 40 km/h" 0 "Kein Geschwindigkeitsgebot" 13 "70 km/h ¿ v_max < 80 km/h" 2 "5 km/h ¿ v_max < 10km/h" 17 "110 km/h ¿ v_max < 120 km/h" 24 "..0x1F ungültig" 22 "160 km/h ¿ v_max" 1 "0 km/h < v_max <  5 km/h" 10 "45 km/h ¿ v_max < 50 km/h" 18 "120 km/h ¿ v_max < 130 km/h" 4 "15 km/h ¿ v_max < 20 km/h" 3 "10 km/h ¿ v_max < 15 km/h" 9 "40 km/h ¿ v_max < 45 km/h" 5 "20 km/h ¿ v_max < 25 km/h" 21 "150 km/h ¿ v_max < 160 km/h" 20 "140 km/h ¿ v_max < 150 km/h" 14 "80 km/h ¿ v_max < 90 km/h" ;
VAL_ 930 PSD_Ges_Geschwindigkeit_Tag_Ende 6 "Samstag" 0 "kein Ende definiert" 2 "Dienstag" 1 "Montag" 7 "Sonntag" 3 "Mittwoch" 5 "Freitag" 4 "Donnerstag" ;
VAL_ 930 PSD_Ges_Geschwindigkeit_Std_Anf 25 "kein Beginn für stundenweise Einschränkungen" ;
VAL_ 930 PSD_Abz_Geschwindigkeit_Typ 0 "Der Wert im Attribut Geschwindigkeitsbegrenzung entspricht der Geschwindigkeitsklasse von Navteq." 1 "Der Wert im Attribut Geschwindigkeitsbegrenzung entspricht einer explizit angegebenen Begrenzung der Geschwindigkeit" ;
VAL_ 930 PSD_Sys_Tunnel 1 "Tunnel" 0 "kein Tunnel oder keine Information verfuegbar" ;
VAL_ 930 PSD_Abz_Strassenklasse 1 "Ortsstraße" 0 " Rest (Feldweg, Schotter, Privatweg)" 2 "Bundes-,Landstrasse" 3 "Autobahn" ;
VAL_ 930 PSD_Sys_Bruecke 1 "Bruecke" 0 "keine Bruecke oder keine Information verfuegbar" ;
VAL_ 930 PSD_Ort_Breite_VZ 1 "Sued" 0 "Nord" ;
VAL_ 930 PSD_Sys_Fahrsp_Gegenr 2 "mehr als eine Fahrspur" 0 "keine Fahrspur" 3 "keine Information verfuegbar" 1 "eine Fahrspur" ;
VAL_ 930 PSD_Abz_ADAS_Qualitaet 0 "keine ADAS Qualität" 1 "ADAS Qualität" ;
VAL_ 930 PSD_Ges_Geschwindigkeit_Std_Ende 25 "kein Ende für stundenweise Einschränkungen" ;
VAL_ 930 PSD_Abz_Abzweigerichtung 1 "links abzweigende Straße" 0 "rechts abzweigende Straße" ;
VAL_ 930 PSD_Sys_TMC_Baustelle 0 "keine Baustelle oder keine Information verfuegbar" 1 "Baustelle" ;
VAL_ 930 PSD_Abz_Abzweigewinkel 1 "0¿ < Winkel ¿ 12¿" 0 "0¿: Straße verläuft gerade aus" 6 "60¿ < Winkel ¿ 72¿" 9 "96¿ < Winkel ¿ 108¿" 5 "48¿ < Winkel ¿ 60¿" 15 "168¿ < Winkel ¿ 180¿" 3 "24¿ < Winkel ¿ 36¿" 12 "132¿ < Winkel ¿ 144¿" 14 "156¿ < Winkel ¿ 168¿" 13 "144¿ < Winkel ¿ 156¿" 4 "36¿ < Winkel ¿ 48¿" 2 "12¿ < Winkel ¿ 24¿" 11 "120¿ < Winkel ¿ 132¿" 10 "108¿ < Winkel ¿ 120¿" 7 "72¿ < Winkel ¿ 84¿" 8 "84¿ < Winkel ¿ 96¿" ;
VAL_ 930 PSD_Sys_TMC_Stau 1 "Stau" 0 "kein Stau oder keine Information verfuegbar" ;
VAL_ 930 PSD_Ges_alter_Geschw 19 "130 km/h ¿ v_max < 140 km/h" 15 "90 km/h ¿ v_max < 100 km/h" 20 "140 km/h ¿ v_max < 150 km/h" 3 "10 km/h ¿ v_max < 15 km/h" 0 "Kein Geschwindigkeitsgebot" 5 "20 km/h ¿ v_max < 25 km/h" 6 "25 km/h ¿ v_max < 30 km/h" 10 "45 km/h ¿ v_max < 50 km/h" 17 "110 km/h ¿ v_max < 120 km/h" 18 "120 km/h ¿ v_max < 130 km/h" 9 "40 km/h ¿ v_max < 45 km/h" 8 "35 km/h ¿ v_max < 40 km/h" 23 "Geschwindigkeitsgebot aufgehoben" 13 "70 km/h ¿ v_max < 80 km/h" 12 "60 km/h ¿ v_max < 70 km/h" 16 "100 km/h ¿ v_max < 110 km/h" 7 "30 km/h ¿ v_max < 35 km/h" 11 "50 km/h ¿ v_max < 60 km/h" 24 "..0x1F ungültig" 2 "5 km/h ¿ v_max < 10km/h" 21 "150 km/h ¿ v_max < 160 km/h" 4 "15 km/h ¿ v_max < 20 km/h" 14 "80 km/h ¿ v_max < 90 km/h" 1 "0 km/h < v_max <  5 km/h" 22 "160 km/h ¿ v_max" ;
VAL_ 930 PSD_Abz_Rampe 0 "Straße mit Gegenverkehr" 1 "Auffahrt (Einbahnstr.) " 2 "Abfahrt (Einbahnstr.)" 3 "Einbahnstraße" ;
VAL_ 930 PSD_Abz_Anfangskruemmung 255 "Gerade" ;
VAL_ 930 PSD_Ges_alter_Geschw_Gespann 0 "alle Fahrzeuge" 1 "PKW mit Gespann" 2 "LKW, Busse, etc." ;
VAL_ 930 PSD_Ges_alter_Geschw_Witter 1 "Nässe, Regen, Niederschlag" 2 "Glätte" 0 "Witterungsunabhängig" 3 "Nebel" ;
VAL_ 930 PSD_Ges_alter_Geschw_Tag_Anf 4 "Donnerstag" 0 "kein Beginn definiert" 5 "Freitag" 2 "Dienstag" 6 "Samstag" 7 "Sonntag" 1 "Montag" 3 "Mittwoch" ;
VAL_ 930 PSD_Abz_Anfangskruemmung_Vorz 0 "Krümmung positiv" 1 "Krümmung negativ" ;
VAL_ 930 PSD_Sys_Anfangskruemmung 255 "Gerade" ;
VAL_ 930 PSD_Abz_Endkruemmung 255 "Gerade" ;
VAL_ 930 PSD_Ges_alter_Geschw_Tag_Ende 5 "Freitag" 1 "Montag" 7 "Sonntag" 0 "kein Ende definiert" 3 "Mittwoch" 4 "Donnerstag" 6 "Samstag" 2 "Dienstag" ;
VAL_ 930 PSD_Ges_alter_Geschw_Std_Anf 25 "kein Beginn für stundenweise Einschränkungen" ;
VAL_ 930 PSD_Sys_Anfangskruemmung_Vorz 1 "Krümmung negativ" 0 "Krümmung positiv" ;
VAL_ 930 PSD_Abz_Endkruemmung_Vorz 1 "Krümmung negativ" 0 "Krümmung positiv" ;
VAL_ 930 PSD_Ges_alter_Geschw_Std_Ende 25 "kein Ende für stundenweise Einschränkungen" ;
VAL_ 930 PSD_Sys_Anfangssteigung 31 "ungültig" 30 "gleich oder mehr als 15 % Steigung" ;
VAL_ 930 PSD_Abz_Endsteigung 30 "gleich oder mehr als 15 % Steigung" 31 "ungültig" ;
VAL_ 930 PSD_Ges_Ueberholverbot 3 "Überholverbot für LKW, Busse, etc." 1 "alle Fahrzeuge" 2 "Überholverbot für PKW mit Gespann" 0 "kein Überholverbot" ;
VAL_ 930 PSD_Sys_Anfangssteigung_Vorz 1 "Steigung" 0 "Gefälle " ;
VAL_ 930 PSD_Abz_Endsteigung_Vorz 1 "Steigung" 0 "Gefälle" ;
VAL_ 930 PSD_Sys_Ortschaft 1 "innerhalb der Ortschaft" 0 "außerhalb der Ortschaft" ;
VAL_ 930 PSD_Abz_Fahrspuren 1 "eine Fahrspur" 3 "mehr als 2 Fahrspuren" 0 "Einbahnstraße in falscher Richtung" 2 "zwei Fahrspuren" ;
VAL_ 930 PSD_Ges_Wechselverkehrszeichen 2 "Wechselverkehrszeichen rechts" 3 "Wechselverkehrszeichen links und rechts" 0 "Kein Wechselverkehrszeichen" 1 "Wechselverkehrszeichen links" 4 "Wechselverkerhszeichen über der Fahrbahn" ;
VAL_ 930 PSD_Sys_Digitalisierung 0 "teildigitalisiert" 1 "volldigitalisiert" ;
VAL_ 930 PSD_Sys_Zielfuehrung 1 "Zielfuehrung aktiv" 0 "Zielfuehrung nicht aktiv" ;
VAL_ 930 PSD_Abz_wahrscheinlichster_Pfad 0 "Pfad mit geringer Wahrscheinlichkeit" 1 "wahrscheinlichster Pfad" ;
